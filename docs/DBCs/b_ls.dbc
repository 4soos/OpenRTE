VERSION ""

NS_ :

BS_:

BU_: IDCM ARC ARHUD WHUD VSP FSE_M CGW

BO_ 744 BDCM_FD_RT_2: 32 CGW
 SG_ DLP_LowerBeamLampSt_Rsp : 0|2@1+ (1,0) [0|3] ""  IDCM
 SG_ DLP_LeftLampErr_Rsp : 2|1@1+ (1,0) [0|1] ""  IDCM
 SG_ DLP_RightLampErr_Rsp : 3|1@1+ (1,0) [0|1] ""  IDCM
 SG_ DLP_HighBeamLampSt_Rsp : 4|2@1+ (1,0) [0|3] ""  IDCM
 SG_ DLP_PositionLampSt_Rsp : 6|2@1+ (1,0) [0|3] ""  IDCM
 SG_ DLP_FogLampSt_Rsp_OnlyForIV2 : 8|2@1+ (1,0) [0|3] ""  IDCM
 SG_ DLP_LogLampSt_Rsp : 10|2@1+ (1,0) [0|3] ""  IDCM
 SG_ DLP_ISDChargeConDisplayEn_Rsp : 12|2@1+ (1,0) [0|3] ""  IDCM
 SG_ DLP_DaytimeRunningLightSt_Rsp : 14|2@1+ (1,0) [0|3] ""  IDCM
 SG_ DLP_FLTurnLightSt_Rsp : 16|2@1+ (1,0) [0|3] ""  IDCM
 SG_ DLP_FLTurnLightErr_Rsp_OnlyForIV2 : 18|1@1+ (1,0) [0|1] ""  IDCM
 SG_ DLP_RLTurnLightSt_Rsp : 19|2@1+ (1,0) [0|3] ""  IDCM
 SG_ DLP_RLTurnLightErr_Rsp_OnlyForIV2 : 21|1@1+ (1,0) [0|1] ""  IDCM
 SG_ DLP_FRTurnLightSt_Rsp : 22|2@1+ (1,0) [0|3] ""  IDCM
 SG_ DLP_FRTurnLightErr_Rsp_OnlyForIV2 : 24|1@1+ (1,0) [0|1] ""  IDCM
 SG_ DLP_RRTurnLightSt_Rsp : 25|2@1+ (1,0) [0|3] ""  IDCM
 SG_ DLP_RRTurnLightErr_Rsp_OnlyForIV2 : 27|1@1+ (1,0) [0|1] ""  IDCM
 SG_ DLP_TailLampSt_Rsp : 28|2@1+ (1,0) [0|3] ""  IDCM
 SG_ DLP_BrakeLampSt_Rsp : 30|2@1+ (1,0) [0|3] ""  IDCM
 SG_ DLP_TailLampErr_Rsp : 32|1@1+ (1,0) [0|1] ""  IDCM
 SG_ DLP_BrakeLampErr_Rsp : 33|1@1+ (1,0) [0|1] ""  IDCM
 SG_ DLP_ReversingLampSt_Rsp : 34|2@1+ (1,0) [0|3] ""  IDCM
 SG_ DLP_LightingMasterErr_Rsp : 37|1@1+ (1,0) [0|1] ""  IDCM
 SG_ DLP_CameraErr_Rsp : 38|1@1+ (1,0) [0|1] ""  IDCM
 SG_ DLP_DHLErr_Rsp : 39|1@1+ (1,0) [0|1] ""  IDCM
 SG_ DLP_PreviewErr_Rsp : 40|2@1+ (1,0) [0|3] ""  IDCM
 SG_ DLP_VideoProjectErr_Rsp : 42|3@1+ (1,0) [0|7] ""  IDCM
 SG_ DLP_ADASHoldProjectSt_Rsp : 45|1@1+ (1,0) [0|1] ""  IDCM
 SG_ DLP_PedestrianFirstPromptButton_Req : 48|2@1+ (1,0) [0|3] ""  IDCM
 SG_ DLP_DrivingLinePromptTrigger_Req : 50|2@1+ (1,0) [0|1] ""  IDCM
 SG_ DLP_ActualLightShowMode_Rsp : 52|4@1+ (1,0) [0|15] ""  IDCM
 SG_ DLP_LightShowWorkingSt_Rsp : 56|2@1+ (1,0) [0|3] ""  IDCM
 SG_ DLP_ADBEN_Rsp : 58|1@1+ (1,0) [0|1] ""  IDCM
 SG_ DLP_LightPedestriansWarnEn_Rsp : 59|1@1+ (1,0) [0|1] ""  IDCM
 SG_ DLP_PedestrianFirstEn_Rsp : 60|1@1+ (1,0) [0|1] ""  IDCM
 SG_ DLP_LightFrontVehicleCollisionWarnEn_Rsp : 61|1@1+ (1,0) [0|1] ""  IDCM
 SG_ DLP_LightLaneChangeWarnEn_Res : 62|1@1+ (1,0) [0|1] ""  IDCM
 SG_ DLP_LightTurnWarnEn_Rsp : 63|1@1+ (1,0) [0|1] ""  IDCM
 SG_ DLP_LightLaneDepartureWarnEn_Rsp : 64|1@1+ (1,0) [0|1] ""  IDCM
 SG_ DLP_LightSpeedLimitWarnEn_Rsp : 65|1@1+ (1,0) [0|1] ""  IDCM
 SG_ DLP_LightSmartNavigationPromptEn_Rsp : 66|1@1+ (1,0) [0|1] ""  IDCM
 SG_ DLP_LightDrivingLinePromptEn_Rsp : 67|1@1+ (1,0) [0|1] ""  IDCM
 SG_ DLP_LightVideoProjectPlayEn_Rsp : 68|1@1+ (1,0) [0|1] ""  IDCM
 SG_ DLP_ISDSmartNavigationEN_Rsp : 69|1@1+ (1,0) [0|1] ""  IDCM
 SG_ DLP_ISDSpeedLimitPromptEN_Rsp : 70|1@1+ (1,0) [0|1] ""  IDCM
 SG_ DLP_PreviewState_Rsp : 71|1@1+ (1,0) [0|1] ""  IDCM
 SG_ DLP_ISDEnduranceMileagePromptEn_Rsp : 72|1@1+ (1,0) [0|1] ""  IDCM
 SG_ DLP_LightSignatureProjectEn_Rsp : 73|1@1+ (1,0) [0|1] ""  IDCM
 SG_ DLP_LightAutomaticPiolotPromptEn_Rsp : 74|1@1+ (1,0) [0|1] ""  IDCM
 SG_ DLP_DrivingLinePromptButton_Rsp : 75|1@1+ (1,0) [0|1] ""  IDCM
 SG_ DLP_ThanksButton_Rsp : 76|1@1+ (1,0) [0|1] ""  IDCM
 SG_ DLP_PedestrianFirsttButton_Rsp : 77|1@1+ (1,0) [0|1] ""  IDCM
 SG_ DLP_PrjctProjectLampSelact_Rsp : 78|2@1+ (1,0) [0|3] ""  IDCM
 SG_ DLP_ProjectAreaSelect_Rsp : 80|2@1+ (1,0) [0|3] ""  IDCM
 SG_ DLP_SaveButtone_Rsp : 82|2@1+ (1,0) [0|3] ""  IDCM
 SG_ DLP_ISDRearVehicleCollisionWarnEn_Rsp : 84|1@1+ (1,0) [0|1] ""  IDCM
 SG_ DLP_ISDCustomerEditeErr_Rsp : 85|3@1+ (1,0) [0|7] ""  IDCM
 SG_ DLP_ISDHighBeamLampOffRemainderEn_Rsp : 88|1@1+ (1,0) [0|1] ""  IDCM
 SG_ DLP_ISDPedestrianFirstEn_Rsp : 89|1@1+ (1,0) [0|1] ""  IDCM
 SG_ DLP_ISDLockStateRemainderEn_Rsp : 90|1@1+ (1,0) [0|1] ""  IDCM
 SG_ DLP_ISDChangeDrivingModeEn_Rsp : 91|1@1+ (1,0) [0|1] ""  IDCM
 SG_ DLP_ISDCustomersModeEN_Rsp : 92|1@1+ (1,0) [0|1] ""  IDCM
 SG_ DLP_ISDCustomerEditEN_Rsp : 93|1@1+ (1,0) [0|1] ""  IDCM
 SG_ DLP_Festival1_LightShowEn_Rsp : 94|1@1+ (1,0) [0|1] ""  IDCM
 SG_ DLP_Festival2_LightShowEn_Rsp : 95|1@1+ (1,0) [0|1] ""  IDCM
 SG_ DLP_Festival3_LightShowEn_Rsp : 96|1@1+ (1,0) [0|1] ""  IDCM
 SG_ DLP_Festival4_LightShowEn_Rsp : 97|1@1+ (1,0) [0|1] ""  IDCM
 SG_ DLP_Festival5_LightShowEn_Rsp : 98|1@1+ (1,0) [0|1] ""  IDCM
 SG_ DLP_WelcomeLightShowEn_Rsp : 99|1@1+ (1,0) [0|1] ""  IDCM
 SG_ DLP_FarewellLightShowEn_Rsp : 100|1@1+ (1,0) [0|1] ""  IDCM
 SG_ DLP_LightShow1En_Rsp_Reserved : 101|1@1+ (1,0) [0|1] ""  IDCM
 SG_ DLP_LightShow2En_Rsp_Reserved : 102|1@1+ (1,0) [0|1] ""  IDCM
 SG_ DLP_LightShow3En_Rsp_Reserved : 103|1@1+ (1,0) [0|1] ""  IDCM
 SG_ DLP_LightShow4En_Rsp_Reserved : 104|1@1+ (1,0) [0|1] ""  IDCM
 SG_ DLP_LightShow5En_Rsp_Reserved : 105|1@1+ (1,0) [0|1] ""  IDCM
 SG_ DLP_LightShow6En_Rsp_Reserved : 106|1@1+ (1,0) [0|1] ""  IDCM
 SG_ DLP_LightShow7En_Rsp_Reserved : 107|1@1+ (1,0) [0|1] ""  IDCM
 SG_ DLP_LightShow8En_Rsp_Reserved : 108|1@1+ (1,0) [0|1] ""  IDCM
 SG_ AVAS_SoundType : 109|3@1+ (1,0) [0|7] ""  IDCM
 SG_ AVAS_ErrInfo : 112|4@1+ (1,0) [0|15] ""  IDCM
 SG_ AVAS_ENSt_Rsp : 116|2@1+ (1,0) [0|3] ""  IDCM
 SG_ DLP_ProtocolVersion : 122|2@1+ (1,0) [0|3] ""  IDCM
 SG_ BDCM_FD_RT_2_AVAS_Available_St : 124|2@1+ (1,0) [0|3] ""  IDCM
 SG_ BDCM_FD_RT_2_DLP_Available_St : 126|2@1+ (1,0) [0|3] ""  IDCM
 SG_ BDCM_FDRT2_Checksum_1 : 128|8@1+ (1,0) [0|255] ""  IDCM
 SG_ BDCM_FDRT2_RollingCounter_1 : 136|4@1+ (1,0) [0|15] ""  IDCM
 SG_ DLP_FLTurnLightErr_Rsp : 144|2@1+ (1,0) [0|3] ""  IDCM
 SG_ DLP_RLTurnLightErr_Rsp : 146|2@1+ (1,0) [0|3] ""  IDCM
 SG_ DLP_FRTurnLightErr_Rsp : 148|2@1+ (1,0) [0|3] ""  IDCM
 SG_ DLP_RRTurnLightErr_Rsp : 150|2@1+ (1,0) [0|3] ""  IDCM

BO_ 555 BDCM_FD_10: 32 CGW
 SG_ SCMFL_FrontBackAdjMotorPosition_St : 0|8@1+ (0.5,0) [0|100] "%"  IDCM
 SG_ SCMFL_HeightAdjMotorPosition_St : 8|8@1+ (0.5,0) [0|100] "%"  IDCM
 SG_ SCMFL_CushionAngleAdjMotorPosition_St : 16|8@1+ (0.5,0) [0|100] "%"  IDCM
 SG_ SCMFL_BackCushionAdjMotorPosition_St : 24|8@1+ (0.5,0) [0|100] "%"  IDCM
 SG_ SCMFL_FrontBackAdjMotorCalibration_St_OnlyForIV2 : 40|2@1+ (1,0) [0|3] ""  IDCM
 SG_ SCMFL_HeightAdjMotorCalibration_St_OnlyForIV2 : 42|2@1+ (1,0) [0|3] ""  IDCM
 SG_ SCMFL_CushionAngleAdjMotorCalibration_St_OnlyForIV2 : 44|2@1+ (1,0) [0|3] ""  IDCM
 SG_ SCMFL_BackCushionAdjMotorCalibration_St_OnlyForIV2 : 46|2@1+ (1,0) [0|3] ""  IDCM
 SG_ SCMFR_FrontBackAdjMotorPosition_St : 48|8@1+ (0.5,0) [0|100] "%"  IDCM
 SG_ SCMFR_HeightAdjMotorPosition_St : 56|8@1+ (0.5,0) [0|100] "%"  IDCM
 SG_ SCMFR_SeatLegSupportAdjMotorPosition_St : 64|8@1+ (0.5,0) [0|100] "%"  IDCM
 SG_ SCMFR_BackCushionAdjMotorPosition_St : 72|8@1+ (0.5,0) [0|100] "%"  IDCM
 SG_ SCMFR_FrontBackAdjMotorCalibration_St_OnlyForIV2 : 88|2@1+ (1,0) [0|3] ""  IDCM
 SG_ SCMFR_HeightAdjMotorCalibration_St_OnlyForIV2 : 90|2@1+ (1,0) [0|3] ""  IDCM
 SG_ SCMFR_LegSupportAdjMotorCalibration_St_OnlyForIV2 : 92|2@1+ (1,0) [0|3] ""  IDCM
 SG_ SCMFR_BackCushionAdjMotorCalibration_St_OnlyForIV2 : 94|2@1+ (1,0) [0|3] ""  IDCM
 SG_ SCMSRL_FrontBackAdjMotorPosition_St : 96|8@1+ (0.5,0) [0|100] "%"  IDCM
 SG_ SCMSRL_BackCushionAdjMotorPosition_St : 104|8@1+ (0.5,0) [0|100] "%"  IDCM
 SG_ SCMSRL_LateralAdjustMotorPosition_St : 112|8@1+ (0.5,0) [0|100] "%"  IDCM
 SG_ SCMSRL_LegSupportAdjMotorPosition_St : 120|8@1+ (0.5,0) [0|100] "%"  IDCM
 SG_ SCMSRL_FrontBackAdjustSt_Rsp : 128|2@1+ (1,0) [0|3] ""  IDCM
 SG_ SCMSRL_LegSupportAdjustSt_Rsp : 130|2@1+ (1,0) [0|3] ""  IDCM
 SG_ SCMSRL_LateralAdjustSt_Rsp : 132|2@1+ (1,0) [0|3] ""  IDCM
 SG_ SCMSRL_BackCushionAdjustSt_Rsp : 134|2@1+ (1,0) [0|3] ""  IDCM
 SG_ SCMSRL_FrontBackAdjMotorCalibration_St_OnlyForIV2 : 136|2@1+ (1,0) [0|3] ""  IDCM
 SG_ SCMSRL_BackCushionAdjMotorCalibration_St_OnlyForIV2 : 138|2@1+ (1,0) [0|3] ""  IDCM
 SG_ SCMSRL_LateralAdjMotorCalibration_St_OnlyForIV2 : 140|2@1+ (1,0) [0|3] ""  IDCM
 SG_ SCMSRL_LegSupportAdjMotorCalibration_St_OnlyForIV2 : 142|2@1+ (1,0) [0|3] ""  IDCM
 SG_ SCMSRR_FrontBackAdjMotorPosition_St : 144|8@1+ (0.5,0) [0|100] "%"  IDCM
 SG_ SCMSRR_BackCushionAdjMotorPosition_St : 152|8@1+ (0.5,0) [0|100] "%"  IDCM
 SG_ SCMSRR_LateralAdjustMotorPosition_St : 160|8@1+ (0.5,0) [0|100] "%"  IDCM
 SG_ SCMSRR_LegSupportAdjMotorPosition_St : 168|8@1+ (0.5,0) [0|100] "%"  IDCM
 SG_ SCMSRR_FrontBackAdjustSt_Rsp : 176|2@1+ (1,0) [0|3] ""  IDCM
 SG_ SCMSRR_LegSupportAdjustSt_Rsp : 178|2@1+ (1,0) [0|3] ""  IDCM
 SG_ SCMSRR_LateralAdjustSt_Rsp : 180|2@1+ (1,0) [0|3] ""  IDCM
 SG_ SCMSRR_BackCushionAdjustSt_Rsp : 182|2@1+ (1,0) [0|3] ""  IDCM
 SG_ SCMSRR_FrontBackAdjMotorCalibration_St_OnlyForIV2 : 184|2@1+ (1,0) [0|3] ""  IDCM
 SG_ SCMSRR_BackCushionAdjMotorCalibration_St_OnlyForIV2 : 186|2@1+ (1,0) [0|3] ""  IDCM
 SG_ SCMSRR_LateralAdjMotorCalibration_St_OnlyForIV2 : 188|2@1+ (1,0) [0|3] ""  IDCM
 SG_ SCMSRR_LegSupportAdjMotorCalibration_St_OnlyForIV2 : 190|2@1+ (1,0) [0|3] ""  IDCM

BO_ 745 BDCM_FD_11: 32 CGW
 SG_ SCMFL_HeatTemp_Rsp : 8|8@1+ (0.5,20) [20|50] "℃"  IDCM
 SG_ SCMFL_HeatGearSt_Rsp : 16|3@1+ (1,0) [0|7] ""  IDCM
 SG_ SCMFL_VentilationSt_Rsp : 19|3@1+ (1,0) [0|7] ""  IDCM
 SG_ SCMFL_LumbarSupportFrontBackAdjSt_Rsp : 26|3@1+ (1,0) [0|7] ""  IDCM
 SG_ SCMFL_LumbarSupportUpDwnAdjSt_Rsp : 29|3@1+ (1,0) [0|7] ""  IDCM
 SG_ SCMFL_LeftShakeMotorSt_Rsp : 38|2@1+ (1,0) [0|3] ""  IDCM
 SG_ SCMFL_RightShakeMotorSt_Rsp : 40|2@1+ (1,0) [0|3] ""  IDCM
 SG_ SCMFL_MassageStrength_Rsp : 42|3@1+ (1,0) [0|7] ""  IDCM
 SG_ SCMFL_MassageMode_Rsp : 45|3@1+ (1,0) [0|7] ""  IDCM
 SG_ SCMFL_FrontBackMoveSt_Rsp : 48|2@1+ (1,0) [0|3] ""  IDCM
 SG_ SCMFL_HeightAdjustSt_Rsp : 50|2@1+ (1,0) [0|3] ""  IDCM
 SG_ SCMFL_CushionAngleAdjustSt_Rsp : 52|2@1+ (1,0) [0|3] ""  IDCM
 SG_ SCMFL_BackCushionAdjustSt_Rsp : 54|2@1+ (1,0) [0|3] ""  IDCM
 SG_ SCMFL_FrontBackAdjustStopRsn : 64|8@1+ (1,0) [0|255] ""  IDCM
 SG_ SCMFL_HeightAdjustStopRsn : 72|8@1+ (1,0) [0|255] ""  IDCM
 SG_ SCMFL_CushionAngleAdjustStopRsn : 80|8@1+ (1,0) [0|255] ""  IDCM
 SG_ SCMFL_BackCushionAdjustStopRsn : 88|8@1+ (1,0) [0|255] ""  IDCM
 SG_ SCMFL_HeatStopRsn : 96|8@1+ (1,0) [0|255] ""  IDCM
 SG_ SCMFL_VentilationStopRsn : 104|8@1+ (1,0) [0|255] ""  IDCM
 SG_ SCMFL_LeftShakeStopRsn : 112|8@1+ (1,0) [0|255] ""  IDCM
 SG_ SCMFL_RightShakeStopRsn : 120|8@1+ (1,0) [0|255] ""  IDCM
 SG_ SCMFL_LumbarSupportFrontBackAdjStopRsn : 144|8@1+ (1,0) [0|255] ""  IDCM
 SG_ SCMFL_LumbarSupportUpDwnAdjStopRsn : 152|8@1+ (1,0) [0|255] ""  IDCM
 SG_ SCMFL_MassageStopReason : 160|8@1+ (1,0) [0|255] ""  IDCM

BO_ 746 BDCM_FD_12: 32 CGW
 SG_ BDCM_FD_12_Checksum : 0|8@1+ (1,0) [0|255] ""  IDCM,VSP
 SG_ BDCM_FD_12_RollingCounter : 8|4@1+ (1,0) [0|15] ""  IDCM,VSP
 SG_ SCMFR_Occupied_St : 12|2@1+ (1,0) [0|3] ""  IDCM
 SG_ SCMFR_SeatBelt_St : 14|2@1+ (1,0) [0|3] ""  IDCM,VSP
 SG_ SCMFR_HeatTemp_Rsp : 16|8@1+ (0.5,20) [20|50] "℃"  IDCM
 SG_ SCMFR_FrontBackMoveSt_Rsp : 24|2@1+ (1,0) [0|3] ""  IDCM
 SG_ SCMFR_HeightAdjustSt_Rsp : 26|2@1+ (1,0) [0|3] ""  IDCM
 SG_ SCMFR_LegSupportAdjustSt_Rsp : 28|2@1+ (1,0) [0|3] ""  IDCM
 SG_ SCMFR_BackCushionAdjustSt_Rsp : 30|2@1+ (1,0) [0|3] ""  IDCM
 SG_ SCMFR_HeatGearSt_Rsp : 32|3@1+ (1,0) [0|7] ""  IDCM
 SG_ SCMFR_VentilationSt_Rsp : 35|3@1+ (1,0) [0|7] ""  IDCM
 SG_ SCMFR_LumbarSupportFrontBackAdjSt_Rsp : 42|3@1+ (1,0) [0|7] ""  IDCM
 SG_ SCMFR_LumbarSupportUpDwnAdjSt_Rsp : 45|3@1+ (1,0) [0|7] ""  IDCM
 SG_ SCMFR_MassageStrength_Rsp : 58|3@1+ (1,0) [0|7] ""  IDCM
 SG_ SCMFR_MassageMode_Rsp : 61|3@1+ (1,0) [0|7] ""  IDCM
 SG_ SCMFR_FrontBackAdjustStopRsn : 64|8@1+ (1,0) [0|255] ""  IDCM
 SG_ SCMFR_HeightAdjustStopRsn : 72|8@1+ (1,0) [0|255] ""  IDCM
 SG_ SCMFR_LegSupportAdjustStopRsn : 80|8@1+ (1,0) [0|255] ""  IDCM
 SG_ SCMFR_BackCushionAdjustStopRsn : 88|8@1+ (1,0) [0|255] ""  IDCM
 SG_ SCMFR_HeatStopRsn : 96|8@1+ (1,0) [0|255] ""  IDCM
 SG_ SCMFR_VentilationStopRsn : 104|8@1+ (1,0) [0|255] ""  IDCM
 SG_ SCMFR_LumbarSupportFrontBackAdjStopRsn : 144|8@1+ (1,0) [0|255] ""  IDCM
 SG_ SCMFR_LumbarSupportUpDwnAdjStopRsn : 152|8@1+ (1,0) [0|255] ""  IDCM
 SG_ SCMFR_MassageStopReason : 160|8@1+ (1,0) [0|255] ""  IDCM

BO_ 747 BDCM_FD_13: 32 CGW
 SG_ BDCM_FD_13_Checksum : 0|8@1+ (1,0) [0|255] ""  IDCM,VSP
 SG_ BDCM_FD_13_RollingCounter : 8|4@1+ (1,0) [0|15] ""  IDCM,VSP
 SG_ SCMSRL_HeatTemp_Rsp : 24|8@1+ (0.5,20) [20|50] "℃"  IDCM
 SG_ SCMSRL_HeatGearSt_Rsp : 32|3@1+ (1,0) [0|7] ""  IDCM
 SG_ SCMSRL_VentilationSt_Rsp : 35|3@1+ (1,0) [0|7] ""  IDCM
 SG_ SCMSRL_Occupied_St : 38|2@1+ (1,0) [0|3] ""  IDCM
 SG_ SCMSRL_SeatBelt_St : 40|2@1+ (1,0) [0|3] ""  IDCM,VSP
 SG_ SCMSRL_LumbarSupportFrontBackAdjSt_Rsp : 64|3@1+ (1,0) [0|7] ""  IDCM
 SG_ SCMSRL_LumbarSupportUpDwnAdjSt_Rsp : 67|3@1+ (1,0) [0|7] ""  IDCM
 SG_ SCMSRL_MassageStrength_Rsp : 80|3@1+ (1,0) [0|7] ""  IDCM
 SG_ SCMSRL_MassageMode_Rsp : 83|3@1+ (1,0) [0|7] ""  IDCM
 SG_ SCMSRL_FrontBackAdjustStopRsn : 128|8@1+ (1,0) [0|255] ""  IDCM
 SG_ SCMSRL_BackCushionAdjustStopRsn : 136|8@1+ (1,0) [0|255] ""  IDCM
 SG_ SCMSRL_LateralAdjustStopRsn : 144|8@1+ (1,0) [0|255] ""  IDCM
 SG_ SCMSRL_LegSupportAdjustStopRsn : 152|8@1+ (1,0) [0|255] ""  IDCM
 SG_ SCMSRL_HeatStopRsn : 160|8@1+ (1,0) [0|255] ""  IDCM
 SG_ SCMSRL_VentilationStopRsn : 168|8@1+ (1,0) [0|255] ""  IDCM
 SG_ SCMSRL_LumbarSupportFrontBackAdjStopRsn : 192|8@1+ (1,0) [0|255] ""  IDCM
 SG_ SCMSRL_LumbarSupportUpDwnAdjStopRsn : 200|8@1+ (1,0) [0|255] ""  IDCM
 SG_ SCMSRL_MassageStopReason : 208|8@1+ (1,0) [0|255] ""  IDCM

BO_ 748 BDCM_FD_14: 32 CGW
 SG_ BDCM_FD_14_Checksum : 0|8@1+ (1,0) [0|255] ""  IDCM,VSP
 SG_ BDCM_FD_14_RollingCounter : 8|4@1+ (1,0) [0|15] ""  IDCM,VSP
 SG_ SCMSRR_HeatTemp_Rsp : 24|8@1+ (0.5,20) [20|50] "℃"  IDCM
 SG_ SCMSRR_HeatGearSt_Rsp : 32|3@1+ (1,0) [0|7] ""  IDCM
 SG_ SCMSRR_VentilationSt_Rsp : 35|3@1+ (1,0) [0|7] ""  IDCM
 SG_ SCMSRR_Occupied_St : 38|2@1+ (1,0) [0|3] ""  IDCM
 SG_ SCMSRR_SeatBelt_St : 40|2@1+ (1,0) [0|3] ""  IDCM,VSP
 SG_ SCMSRR_LumbarSupportFrontBackAdjSt_Rsp : 64|3@1+ (1,0) [0|7] ""  IDCM
 SG_ SCMSRR_LumbarSupportUpDwnAdjSt_Rsp : 67|3@1+ (1,0) [0|7] ""  IDCM
 SG_ SCMSRR_MassageStrength_Rsp : 80|3@1+ (1,0) [0|7] ""  IDCM
 SG_ SCMSRR_MassageMode_Rsp : 83|3@1+ (1,0) [0|7] ""  IDCM
 SG_ SCMSRR_FrontBackAdjustStopRsn : 128|8@1+ (1,0) [0|255] ""  IDCM
 SG_ SCMSRR_BackCushionAdjustStopRsn : 136|8@1+ (1,0) [0|255] ""  IDCM
 SG_ SCMSRR_LateralAdjustStopRsn : 144|8@1+ (1,0) [0|255] ""  IDCM
 SG_ SCMSRR_LegSupportAdjustStopRsn : 152|8@1+ (1,0) [0|255] ""  IDCM
 SG_ SCMSRR_HeatStopRsn : 160|8@1+ (1,0) [0|255] ""  IDCM
 SG_ SCMSRR_VentilationStopRsn : 168|8@1+ (1,0) [0|255] ""  IDCM
 SG_ SCMSRR_LumbarSupportFrontBackAdjStopRsn : 192|8@1+ (1,0) [0|255] ""  IDCM
 SG_ SCMSRR_LumbarSupportUpDwnAdjStopRsn : 200|8@1+ (1,0) [0|255] ""  IDCM
 SG_ SCMSRR_MassageStopReason : 208|8@1+ (1,0) [0|255] ""  IDCM

BO_ 310 BDCM_FD_RT_8: 32 CGW
 SG_ BDCM_FD_RT_8_CheckSum : 0|8@1+ (1,0) [0|255] ""  IDCM
 SG_ BDCM_FD_RT_8_RollingCounter : 8|4@1+ (1,0) [0|15] ""  IDCM
 SG_ CSM_SAS_SteeringWheelAngle : 16|16@1+ (0.1,-780) [-780|780] "degree"  IDCM
 SG_ CSM_SAS_SteeringWheelSpeed : 32|8@1+ (4,0) [0|1016] "degree/s"  IDCM
 SG_ CSM_SAS_SteeringWheelAngle_Valid : 40|2@1+ (1,0) [0|3] ""  IDCM
 SG_ CSM_SAS_Calibrating_St : 42|2@1+ (1,0) [0|3] ""  IDCM
 SG_ CSM_SAS_Trimmed_St : 44|2@1+ (1,0) [0|3] ""  IDCM
 SG_ BDCM_FD_RT_8_CSM_Available_St : 51|2@1+ (1,0) [0|3] ""  IDCM

BO_ 700 BDCM_FD_RT_9: 32 CGW
 SG_ OLM_FLAirOutletFanLeftRightAngle_Rsp : 0|8@1+ (1,0) [0|60] "度"  IDCM
 SG_ OLM_FLAirOutletFanUpDownAngle_Rsp : 8|6@1+ (1,0) [0|40] "度"  IDCM
 SG_ OLM_FLAirOutletOpenCtl_Rsp : 14|2@1+ (1,0) [0|3] ""  IDCM
 SG_ OLM_LCAirOutletOpenCtl_Rsp : 20|2@1+ (1,0) [0|3] ""  IDCM
 SG_ OLM_LCAirOutletFanUpDownAngle_Rsp : 26|6@1+ (1,0) [0|40] "度"  IDCM
 SG_ OLM_LCAirOutletFanLeftRightAngle_Rsp : 32|8@1+ (1,0) [0|60] "度"  IDCM
 SG_ OLM_PanelAirOutletFanLeftRightAngle_Rsp : 40|8@1+ (1,0) [0|60] "度"  IDCM
 SG_ OLM_PanelAirOutletFanUpDownAngle_Rsp : 48|6@1+ (1,0) [0|40] "度"  IDCM
 SG_ OLM_PanelAirOutletOpenCtl_Rsp : 54|2@1+ (1,0) [0|3] ""  IDCM
 SG_ OLM_RCAirOutletFanLeftRightAngle_Rsp : 64|8@1+ (1,0) [0|60] "度"  IDCM
 SG_ OLM_RCAirOutletFanUpDownAngle_Rsp : 72|6@1+ (1,0) [0|40] "度"  IDCM
 SG_ OLM_RCAirOutletOpenCtl_Rsp : 78|2@1+ (1,0) [0|3] ""  IDCM
 SG_ OLM_FRAirOutletOpenCtl_Rsp : 84|2@1+ (1,0) [0|3] ""  IDCM
 SG_ OLM_FRAirOutletFanUpDownAngle_Rsp : 90|6@1+ (1,0) [0|40] "度"  IDCM
 SG_ OLM_FRAirOutletFanLeftRightAngle_Rsp : 96|8@1+ (1,0) [0|60] "度"  IDCM
 SG_ OLM_FanOpenSt_Rsp : 104|2@1+ (1,0) [0|3] ""  IDCM
 SG_ OLM_FanMode_Rsp : 106|2@1+ (1,0) [0|3] ""  IDCM
 SG_ OLM_FLMotorErrSt_Rsp : 112|3@1+ (1,0) [0|7] ""  IDCM
 SG_ OLM_LCMotorErrSt_Rsp : 115|3@1+ (1,0) [0|7] ""  IDCM
 SG_ OLM_PanelMotorErrSt_Rsp : 120|3@1+ (1,0) [0|7] ""  IDCM
 SG_ OLM_RCMotorErrSt_Rsp : 123|3@1+ (1,0) [0|7] ""  IDCM
 SG_ OLM_FRMotorErrSt_Rsp : 128|3@1+ (1,0) [0|7] ""  IDCM
 SG_ BDCM_FD_RT_9_OLM_Available_St : 132|2@1+ (1,0) [0|3] ""  IDCM
 SG_ SCAM_TiltPosition : 136|16@1+ (1,0) [32768|33290] "edge"  IDCM
 SG_ SCAM_TelescopePosition : 152|16@1+ (1,0) [32768|33393] "edge"  IDCM
 SG_ BDCM_FD_RT_9_SCAM_Available_St : 169|2@1+ (1,0) [0|3] ""  IDCM

BO_ 697 BDCM_FD_RT_10: 32 CGW
 SG_ NTDM_RL_DoorOpenDegree_Rsp : 0|8@1+ (0.5,0) [0|100] "%"  IDCM
 SG_ NTDM_RL_NTDoorOpenDegree_Rsp : 8|8@1+ (0.5,0) [0|100] "%"  IDCM
 SG_ NTDM_RL_DoorWorkSt_Rsp : 16|2@1+ (1,0) [0|3] ""  IDCM
 SG_ NTDM_RL_NTDoorLight_St : 18|2@1+ (1,0) [0|3] ""  IDCM
 SG_ NTDM_RL_DoorStopReason : 20|4@1+ (1,0) [0|15] ""  IDCM
 SG_ NTDM_RL_NTDoorStopReason : 24|4@1+ (1,0) [0|15] ""  IDCM
 SG_ NTDM_RL_DoorObstacleAvoid_St : 28|2@1+ (1,0) [0|3] ""  IDCM
 SG_ NTDM_RL_NTDoorObstacleAvoid_St : 30|2@1+ (1,0) [0|3] ""  IDCM
 SG_ NTDM_RL_DoorobstacleDistance_Rsp : 32|8@1+ (1,20) [20|120] "cm"  IDCM
 SG_ NTDM_RL_NTDoorobstacleDistance_Rsp : 40|8@1+ (1,20) [20|120] "cm"  IDCM
 SG_ NTDM_RL_NTDoorWorkSt_Rsp : 48|2@1+ (1,0) [0|3] ""  IDCM
 SG_ NTDM_RL_NTDoorAntiClamp_St : 50|2@1+ (1,0) [0|3] ""  IDCM
 SG_ NTDM_RL_DoorAntiClamp_St : 52|3@1+ (1,0) [0|7] ""  IDCM
 SG_ BDCM_FD_RT_10_NTDM_RL_Available_St : 56|2@1+ (1,0) [0|3] ""  IDCM
 SG_ BDCM_FD_RT_10_NTDM_RR_Available_St : 62|2@1+ (1,0) [0|3] ""  IDCM
 SG_ NTDM_RR_DoorOpenDegree_Rsp : 64|8@1+ (0.5,0) [0|100] "%"  IDCM
 SG_ NTDM_RR_NTDoorOpenDegree_Rsp : 72|8@1+ (0.5,0) [0|100] "%"  IDCM
 SG_ NTDM_RR_DoorWorkSt_Rsp : 80|2@1+ (1,0) [0|3] ""  IDCM
 SG_ NTDM_RR_NTDooRRight_St : 82|2@1+ (1,0) [0|3] ""  IDCM
 SG_ NTDM_RR_DoorStopReason : 84|4@1+ (1,0) [0|15] ""  IDCM
 SG_ NTDM_RR_NTDoorStopReason : 88|4@1+ (1,0) [0|15] ""  IDCM
 SG_ NTDM_RR_DoorObstacleAvoid_St : 92|2@1+ (1,0) [0|3] ""  IDCM
 SG_ NTDM_RR_NTDoorObstacleAvoid_St : 94|2@1+ (1,0) [0|3] ""  IDCM
 SG_ NTDM_RR_DoorobstacleDistance_Rsp : 96|8@1+ (1,20) [20|120] "cm"  IDCM
 SG_ NTDM_RR_NTDoorobstacleDistance_Rsp : 104|8@1+ (1,20) [20|120] "cm"  IDCM
 SG_ NTDM_RR_NTDoorWorkSt_Rsp : 112|2@1+ (1,0) [0|3] ""  IDCM
 SG_ NTDM_RR_NTDoorAntiClamp_St : 114|2@1+ (1,0) [0|3] ""  IDCM
 SG_ NTDM_RR_DoorAntiClamp_St : 116|3@1+ (1,0) [0|7] ""  IDCM
 SG_ BDCM_FD_RT_10_PLGM_Available_St : 126|2@1+ (1,0) [0|3] ""  IDCM
 SG_ PLGM_TravelPosition_Rsp : 128|8@1+ (0.5,0) [0|100] "%"  IDCM
 SG_ PLGM_RearDoorMove_St : 136|2@1+ (1,0) [0|3] ""  IDCM
 SG_ PLGM_RearDoorPosition_St : 138|3@1+ (1,0) [0|7] ""  IDCM
 SG_ PLGM_PinchEvent_St : 141|2@1+ (1,0) [0|3] ""  IDCM
 SG_ PLGM_RearLatchSwitch_St : 144|4@1+ (1,0) [0|15] ""  IDCM

BO_ 208 VDCM_FD_1: 32 CGW
 SG_ VDCM_FD1_Checksum1 : 0|8@1+ (1,0) [0|255] ""  IDCM
 SG_ VDCM_FD1_RollingCounter1 : 8|4@1+ (1,0) [0|15] ""  IDCM
 SG_ VDCM_VirtualPedPstn : 16|8@1+ (0.392,0) [0|99.568] "％"  IDCM
 SG_ VDCM_AccrPedPstn : 24|8@1+ (0.392,0) [0|99.568] "％"  IDCM,ARC
 SG_ VDCM_VirtualAccrPedPstn_Valid : 32|1@1+ (1,0) [0|1] ""  IDCM
 SG_ VDCM_AccrPedPstn_Valid : 33|1@1+ (1,0) [0|1] ""  IDCM,ARC
 SG_ VDCM_ActlGear : 34|3@1+ (1,0) [0|7] ""  IDCM,ARC,WHUD
 SG_ VDCM_ActlGear_Valid : 37|1@1+ (1,0) [0|1] ""  IDCM,ARC,WHUD
 SG_ VDCM_DriveSwitchPosition : 38|2@1+ (1,0) [0|3] ""  IDCM
 SG_ VDCM_BrakeSw_St : 40|1@1+ (1,0) [0|1] ""  IDCM
 SG_ VDCM_BrakeFluidWarning_St : 45|1@1+ (1,0) [0|1] ""  IDCM
 SG_ VDCM_FrontBrakePadWarning_St : 46|1@1+ (1,0) [0|1] ""  IDCM
 SG_ VDCM_RearBrakePadWarning_St : 47|1@1+ (1,0) [0|1] ""  IDCM
 SG_ VDCM_BrakeSwStValid : 56|1@1+ (1,0) [0|1] ""  IDCM

BO_ 220 VDCM_FD_4: 32 CGW
 SG_ VDCM_FD4_Checksum : 0|8@1+ (1,0) [0|255] ""  IDCM
 SG_ VDCM_FD4_RollingCounter : 8|4@1+ (1,0) [0|15] ""  IDCM
 SG_ VDCM_Ready : 17|1@1+ (1,0) [0|1] ""  IDCM
 SG_ VDCM_HighVoltage_St : 18|2@1+ (1,0) [0|3] ""  IDCM

BO_ 663 VDCM_FD_6: 32 CGW
 SG_ VDCM_BookingCharge_St : 0|3@1+ (1,0) [0|7] ""  IDCM
 SG_ VDCM_BookingChargeStopReason : 3|3@1+ (1,0) [0|7] ""  IDCM
 SG_ VDCM_BookingChargeAvailable_St_OnlyForIV2 : 6|1@1+ (1,0) [0|1] ""  IDCM
 SG_ VDCM_ExclusiveChargePileContact_St : 7|1@1+ (1,0) [0|1] ""  IDCM
 SG_ VDCM_MaxRemainRange : 8|12@1+ (1,0) [0|4000] "Km"  IDCM,VSP
 SG_ VDCM_MinRemainRange : 20|12@1+ (1,0) [0|4000] "Km"  IDCM,VSP
 SG_ VDCM_EstimateRange : 32|12@1+ (1,0) [0|4000] "Km"  IDCM,VSP
 SG_ VDCM_TravelChargePileContact_St : 44|1@1+ (1,0) [0|1] ""  IDCM
 SG_ VDCM_RegenAvaible_Status : 45|1@1+ (1,0) [0|1] ""  IDCM
 SG_ VDCM_CreepModeSet_Rsp_OnlyForIV2 : 46|2@1+ (1,0) [0|3] ""  IDCM
 SG_ VDCM_PullOver_St : 48|1@1+ (1,0) [0|1] ""  IDCM
 SG_ VDCM_HighVoltageWarning_St : 49|1@1+ (1,0) [0|1] ""  IDCM
 SG_ VDCM_HVOffConfirmRequest : 50|1@1+ (1,0) [0|1] ""  IDCM
 SG_ VDCM_ServiceReminder_St : 51|1@1+ (1,0) [0|1] ""  IDCM
 SG_ VDCM_LowVoltagePowerNetFault_OnlyForIV2 : 56|4@1+ (1,0) [0|15] ""  IDCM
 SG_ VDCM_LowVoltageSystemError : 60|1@1+ (1,0) [0|1] ""  IDCM
 SG_ VDCM_CreepSetAvailable_St : 61|1@1+ (1,0) [0|1] ""  IDCM
 SG_ VDCM_CreepSet_Rsp : 62|1@1+ (1,0) [0|1] ""  IDCM
 SG_ VDCM_PTSystemFault_OnlyForIV2 : 64|1@1+ (1,0) [0|1] ""  IDCM
 SG_ VDCM_AbnormalShiftInfo : 65|4@1+ (1,0) [0|15] ""  IDCM
 SG_ VDCM_AntiTheft : 69|3@1+ (1,0) [0|7] ""  IDCM
 SG_ VDCM_LimpHomeRemind_OnlyForIV2 : 72|1@1+ (1,0) [0|1] ""  IDCM
 SG_ VDCM_HighVItgInterlockFault : 73|1@1+ (1,0) [0|1] ""  IDCM
 SG_ VDCM_ChargeCon_St_OnlyForIV2 : 74|3@1+ (1,0) [0|7] ""  IDCM
 SG_ VDCM_ThermalRunawayWarn_St : 77|1@1+ (1,0) [0|1] ""  IDCM
 SG_ VDCM_PLCUFault_St : 78|1@1+ (1,0) [0|1] ""  IDCM
 SG_ VDCM_FD_6_Checksum1 : 104|8@1+ (1,0) [0|255] ""  IDCM
 SG_ VDCM_FD_6_RollingCounter1 : 112|4@1+ (1,0) [0|15] ""  IDCM
 SG_ VDCM_PTSystemFault : 119|1@1+ (1,0) [0|1] ""  IDCM
 SG_ VDCM_DisplaySOC : 120|8@1+ (0.5,0) [0|100] "%"  IDCM
 SG_ VDCM_AverageEnergyConsume : 128|12@1+ (0.1,0) [0|409.5] "kWh/100km"  IDCM
 SG_ VDCM_ChargeCon_St : 140|3@1+ (1,0) [0|7] ""  IDCM
 SG_ VDCM_LimpHomeRemind : 143|1@1+ (1,0) [0|1] ""  IDCM
 SG_ VDCM_InstantEnergyConsume : 144|12@1+ (0.1,0) [0|409.5] "kWh/100km"  IDCM
 SG_ VDCM_EGSMFault : 156|1@1+ (1,0) [0|1] ""  IDCM
 SG_ VDCM_CampingModeSOC_Rsp : 158|10@1+ (0.1,0) [0|100] "%"  IDCM
 SG_ VDCM_RegenSettingPercent_Rsp : 168|8@1+ (0.4,0) [0|100] "%"  IDCM
 SG_ VDCM_ValetModeMaxSpeedLimit_St : 176|1@1+ (1,0) [0|1] ""  IDCM
 SG_ VDCM_CampingMode_Rsp : 177|1@1+ (1,0) [0|1] ""  IDCM
 SG_ VDCM_DischargeRemainTime : 180|12@1+ (1,0) [0|1440] "min"  IDCM
 SG_ VDCM_ACHeatLiquidCircuitLackWarn : 192|2@1+ (1,0) [0|3] ""  IDCM
 SG_ VDCM_PTThermalLiquidCircuitLackWarn : 194|2@1+ (1,0) [0|3] ""  IDCM
 SG_ VDCM_TractionModeAvailable_St : 198|2@1+ (1,0) [0|3] ""  IDCM
 SG_ VDCM_TractionModeSetting_Rsp : 202|2@1+ (1,0) [0|3] ""  IDCM

BO_ 540 VDCM_FD_11: 32 CGW
 SG_ VDCM_DrivePowerPercent : 0|8@1+ (0.4,0) [0|100] "%"  IDCM,ARC
 SG_ VDCM_RegenPowerPercent : 8|8@1+ (0.4,0) [0|100] "%"  IDCM
 SG_ VDCM_CurrentActDrivePower : 16|8@1+ (2,0) [0|500] "KW"  IDCM
 SG_ VDCM_CurrentLimitDrivePower : 24|8@1+ (2,0) [0|500] "KW"  IDCM
 SG_ VDCM_CurrentActBrakePower : 32|8@1+ (2,0) [0|500] "KW"  IDCM
 SG_ VDCM_CurrentLimitBrakePower_OnlyForIV2 : 40|8@1+ (2,0) [0|500] "KW"  IDCM
 SG_ VDCM_DriveLimpSpdLmt_Status : 48|1@1+ (1,0) [0|1] ""  IDCM
 SG_ VDCM_DriveLimpPwrLmt_Status_OnlyForIV2 : 49|1@1+ (1,0) [0|1] ""  IDCM
 SG_ VDCM_DriveLimpCnstSpd_Status : 50|1@1+ (1,0) [0|1] ""  IDCM
 SG_ VDCM_DriveConflictRemindInfo : 51|4@1+ (1,0) [0|15] ""  IDCM

BO_ 222 VDCM_FD_12: 32 CGW
 SG_ VDCM_FD_12_Checksum : 0|8@1+ (1,0) [0|255] ""  IDCM
 SG_ VDCM_FD_12_RollingCounter : 8|4@1+ (1,0) [0|15] ""  IDCM
 SG_ VDCM_PTAvailableforADAS_St : 19|3@1+ (1,0) [0|7] ""  IDCM

BO_ 244 VDCM_FD_14: 32 CGW
 SG_ VDCM_VehicleMaxSpeedLimit : 0|13@1+ (0.05625,0) [0|300] "km/h"  IDCM
 SG_ VDCM_OffroadMode_St : 22|1@1+ (1,0) [0|1] ""  IDCM
 SG_ VDCM_SWSDisable_St : 23|1@1+ (1,0) [0|1] ""  IDCM
 SG_ VDCM_DMSVehicleModeInfo : 24|4@1+ (1,0) [0|15] ""  IDCM,ARC
 SG_ VDCM_DMSModeChangeEnable : 28|1@1+ (1,0) [0|1] ""  IDCM
 SG_ VDCM_DMSPTModeInfo : 29|3@1+ (1,0) [0|7] ""  IDCM
 SG_ VDCM_FaultLevel : 32|3@1+ (1,0) [0|7] ""  IDCM
 SG_ VDCM_AirSOffRoadExitCommand : 35|1@1+ (1,0) [0|1] ""  IDCM
 SG_ VDCM_AirSOffRoadAvaliability : 36|1@1+ (1,0) [0|1] ""  IDCM
 SG_ VDCM_ProtocolVersion : 78|2@1+ (1,0) [0|3] ""  IDCM
 SG_ VDCM_PowernetLowVoltageFault : 80|8@1+ (1,0) [0|255] ""  IDCM
 SG_ VDCM_PowernetWarning_St : 90|2@1+ (1,0) [0|3] ""  IDCM

BO_ 232 VDCM_FD_RT_4: 32 CGW
 SG_ BMS_Current : 0|16@1+ (0.1,-1500) [-1500|1500] "A"  IDCM
 SG_ BMS_BatteryVoltage : 16|12@1+ (0.25,0) [0|1023.25] "V"  IDCM
 SG_ BMS_HVBusVoltage : 28|12@1+ (0.25,0) [0|1023.25] "V"  IDCM
 SG_ BMS_FastChargeConnector_St : 43|2@1+ (1,0) [0|3] ""  IDCM
 SG_ BMS_DCCharge_St : 46|2@1+ (1,0) [0|3] ""  IDCM,FSE_M
 SG_ BMS_ACCharge_St : 48|2@1+ (1,0) [0|3] ""  IDCM,FSE_M
 SG_ BMS_V2L_Req : 50|2@1+ (1,0) [0|3] ""  IDCM
 SG_ BMS_CC2_St_OnlyForIV2 : 52|1@1+ (1,0) [0|1] ""  IDCM
 SG_ BMS_UnderTemp_Err : 54|1@1+ (1,0) [0|1] ""  IDCM
 SG_ BMS_ChargerPowerSupplyMode_St : 55|1@1+ (1,0) [0|1] ""  IDCM
 SG_ OBC_ACVltg : 56|10@1+ (1,0) [0|500] "V"  IDCM
 SG_ OBC_ACCurrent : 66|10@1+ (0.1,0) [0|100] "A"  IDCM
 SG_ BMS_ProtocolVersion : 98|2@1+ (1,0) [0|3] ""  IDCM
 SG_ VDCM_FD_RT_4_BMS_Available_St : 100|2@1+ (1,0) [0|3] ""  IDCM,FSE_M
 SG_ VDCM_FD_RT_4_IPEU_Available_St : 102|2@1+ (1,0) [0|3] ""  IDCM
 SG_ VDCM_FD_RT_4_Checksum1 : 112|8@1+ (1,0) [0|255] ""  IDCM,ARC,WHUD
 SG_ VDCM_FD_RT_4_RollingCounter1 : 120|4@1+ (1,0) [0|15] ""  IDCM,ARC,WHUD
 SG_ VDCM_FD_RT_4_ADCM_Available_St : 126|2@1+ (1,0) [0|3] ""  IDCM,ARC,WHUD
 SG_ ADCM_BU_Pilot_Warn_St : 128|4@1+ (1,0) [0|15] ""  IDCM,ARC,WHUD

BO_ 648 VDCM_FD_RT_5: 32 CGW
 SG_ VDCM_FD_RT_5_Checksum : 0|8@1+ (1,0) [0|255] ""  IDCM
 SG_ VDCM_FD_RT_5_RollingCounter : 8|4@1+ (1,0) [0|15] ""  IDCM
 SG_ BMS_RemainChargeTime : 12|12@1+ (1,0) [0|1440] "min"  IDCM
 SG_ ACM_InvehicleTemp : 40|8@1+ (0.5,-40) [-40|80] "℃"  IDCM
 SG_ ACM_EnvironmentTemp : 48|8@1+ (0.5,-40) [-40|80] "℃"  IDCM
 SG_ BMS_SOCReal : 56|10@1+ (0.1,0) [0|100] "%"  IDCM,ARC,WHUD,VSP
 SG_ BMS_SOCDisplay : 66|10@1+ (0.1,0) [0|100] "%"  IDCM,ARC,WHUD,VSP
 SG_ OBC_DischargeRatedPower : 76|8@1+ (0.1,0) [0|10] "KW"  IDCM
 SG_ OBC_CurrentACDischargedPower : 86|10@1+ (0.1,0) [0|100] "Kwh"  IDCM
 SG_ VDCM_FD_RT_5_BMS_Available_St : 96|2@1+ (1,0) [0|3] ""  IDCM,ARC,WHUD,VSP
 SG_ VDCM_FD_RT_5_ACM_Available_St : 98|2@1+ (1,0) [0|3] ""  IDCM
 SG_ VDCM_FD_RT_5_IPEU_Available_St : 100|2@1+ (1,0) [0|3] ""  IDCM
 SG_ OBC_ACDischarge_St : 104|2@1+ (1,0) [0|3] ""  IDCM
 SG_ OBC_ACChargerConnect_St : 106|2@1+ (1,0) [0|3] ""  IDCM
 SG_ OBC_ACChargerConnectSt_Valid : 108|1@1+ (1,0) [0|1] ""  IDCM
 SG_ BMS_ACDischarge_St : 109|3@1+ (1,0) [0|7] ""  IDCM
 SG_ OBC_ACChargerMode : 124|4@1+ (1,0) [0|15] ""  IDCM
 SG_ BMS_VehicleDischargeAbortReason : 128|3@1+ (1,0) [0|7] ""  IDCM
 SG_ OBC_DischargeAbortReason : 131|3@1+ (1,0) [0|7] ""  IDCM
 SG_ OBC_ACSocketLock_St : 144|3@1+ (1,0) [0|7] ""  IDCM
 SG_ BMS_FaultLevel : 147|4@1+ (1,0) [0|15] ""  IDCM
 SG_ BMS_Isolation_Err : 156|2@1+ (1,0) [0|3] ""  IDCM
 SG_ BMS_CellOverVoltage : 158|1@1+ (1,0) [0|1] ""  IDCM
 SG_ BMS_CellUnderVoltage : 159|1@1+ (1,0) [0|1] ""  IDCM
 SG_ IPEU_DischargerConnectSt : 163|2@1+ (1,0) [0|3] ""  IDCM
 SG_ IPEU_DischargerConnectSt_Valid : 165|1@1+ (1,0) [0|1] ""  IDCM
 SG_ BMS_CellOverTemp : 166|1@1+ (1,0) [0|1] ""  IDCM
 SG_ DCDC_ErrorLevel : 171|3@1+ (1,0) [0|7] ""  IDCM
 SG_ BMS_SOCLow : 175|1@1+ (1,0) [0|1] ""  IDCM
 SG_ BMS_SOCHigh : 176|1@1+ (1,0) [0|1] ""  IDCM
 SG_ IPEU_OverTemp : 181|1@1+ (1,0) [0|1] ""  IDCM
 SG_ EBS_F_U_BATT : 184|14@1+ (0.001,3) [3|18] "V"  IDCM
 SG_ EBS_F_St_Vltg : 198|2@1+ (1,0) [0|3] ""  IDCM
 SG_ VDCM_VehicleTotalMileageBackup : 200|24@1+ (0.1,0) [0|999999.9] ""  IDCM

BO_ 653 VDCM_FD_RT_6: 32 CGW
 SG_ ACM_FragSwitchEN_Rsp : 0|2@1+ (1,0) [0|3] ""  IDCM
 SG_ ACM_FragChannel1Switch_St : 2|2@1+ (1,0) [0|3] ""  IDCM
 SG_ ACM_FragChannel2Switch_St : 4|2@1+ (1,0) [0|3] ""  IDCM
 SG_ ACM_FragChannel3Switch_St : 6|2@1+ (1,0) [0|3] ""  IDCM
 SG_ ACM_FragConcLevel_Rsp : 8|3@1+ (1,0) [0|7] ""  IDCM
 SG_ ACM_FrontACMode_St : 11|3@1+ (1,0) [0|7] ""  IDCM
 SG_ ACM_InOutLoopMode_St : 14|2@1+ (1,0) [0|3] ""  IDCM
 SG_ ACM_DriveTempSet_St : 16|6@1+ (1,0) [0|63] ""  IDCM
 SG_ ACM_TempAreaSync_St : 22|2@1+ (1,0) [0|3] ""  IDCM
 SG_ ACM_PassengerTempSet_St : 24|6@1+ (1,0) [0|63] ""  IDCM
 SG_ ACM_ACOperateMode_St : 30|2@1+ (1,0) [0|3] ""  IDCM
 SG_ ACM_FrontACAirFlowLevel_St : 32|4@1+ (1,0) [0|15] ""  IDCM
 SG_ ACM_RearACAirFlowLevel_St : 36|4@1+ (1,0) [0|15] ""  IDCM
 SG_ ACM_RearRowTempSet_St : 40|6@1+ (1,0) [0|63] ""  IDCM
 SG_ ACM_AutoDefrostSet_St : 46|2@1+ (1,0) [0|3] ""  IDCM
 SG_ ACM_RearACMode_St : 48|3@1+ (1,0) [0|7] ""  IDCM
 SG_ ACM_IONSet_St : 51|2@1+ (1,0) [0|3] ""  IDCM
 SG_ ACM_ConsumeMileagePredict : 56|8@1+ (1,0) [0|254] "km"  IDCM
 SG_ ACM_ConsumeDriveTimePredict : 64|8@1+ (1,0) [0|254] "min"  IDCM
 SG_ ACM_AQSAirQuality_St : 72|4@1+ (1,0) [0|15] ""  IDCM
 SG_ ACM_PM25Set_St : 76|2@1+ (1,0) [0|3] ""  IDCM
 SG_ ACM_PM25CarConc : 78|10@1+ (1,0) [0|1023] ""  IDCM
 SG_ ACM_AQSSet_St : 88|2@1+ (1,0) [0|3] ""  IDCM
 SG_ ACM_HepaActive : 90|2@1+ (1,0) [0|3] ""  IDCM
 SG_ ACM_ACSt_St : 94|2@1+ (1,0) [0|3] ""  IDCM
 SG_ ACM_FragChannel1Life : 96|9@1+ (1,0) [0|360] "h"  IDCM
 SG_ ACM_FragChannel2Life : 105|9@1+ (1,0) [0|360] "h"  IDCM
 SG_ ACM_FragChannel3Life : 114|9@1+ (1,0) [0|360] "h"  IDCM
 SG_ ACM_FragChannel1Type : 128|4@1+ (1,0) [0|15] ""  IDCM
 SG_ ACM_FragChannel2Type : 132|4@1+ (1,0) [0|15] ""  IDCM
 SG_ ACM_FragChannel3Type : 136|4@1+ (1,0) [0|15] ""  IDCM
 SG_ ACM_InFilterLifeRemind : 144|4@1+ (1,0) [0|15] ""  IDCM
 SG_ ACM_OutsideFilterLifeRemind : 148|4@1+ (1,0) [0|15] ""  IDCM
 SG_ ACM_FrontACSwitch_Rsp : 152|2@1+ (1,0) [0|3] ""  IDCM
 SG_ ACM_RearACSwitch_Rsp : 154|2@1+ (1,0) [0|3] ""  IDCM
 SG_ ACM_FrontACAuto_Rsp : 156|2@1+ (1,0) [0|3] ""  IDCM
 SG_ ACM_RearACAuto_Rsp : 158|2@1+ (1,0) [0|3] ""  IDCM
 SG_ ACM_FrontDeiceDefrost_Rsp : 166|2@1+ (1,0) [0|3] ""  IDCM
 SG_ VDCM_FD_RT_6_ACM_Available_St : 190|2@1+ (1,0) [0|3] ""  IDCM

BO_ 938 VDCM_FD_RT_9: 32 CGW
 SG_ VDCM_FD_RT_9_BMS_Available_St : 54|2@1+ (1,0) [0|3] ""  IDCM
 SG_ BMS_SOE : 72|12@1+ (0.1,0) [0|408] "kwh"  IDCM

BO_ 527 VDCM_FD_RT_11: 32 CGW
 SG_ VDCM_FD_RT_11_Checksum : 0|8@1+ (1,0) [0|255] ""  IDCM,ARC,WHUD
 SG_ VDCM_FD_RT_11_RollingCounter : 8|4@1+ (1,0) [0|15] ""  IDCM,ARC,WHUD
 SG_ IFV300_Pilot_Warning_St : 12|4@1+ (1,0) [0|15] ""  IDCM,ARC,WHUD
 SG_ IFV300_CameraBlocked : 16|1@1+ (1,0) [0|1] ""  IDCM
 SG_ IFV300_CameraCalibratinSts : 17|1@1+ (1,0) [0|1] ""  IDCM
 SG_ IFV300_CamreaFailureSts : 18|1@1+ (1,0) [0|1] ""  IDCM
 SG_ VDCM_FD_RT_11_IFV300_Available_St : 20|2@1+ (1,0) [0|3] ""  IDCM,ARC,WHUD

BO_ 224 MCUF_FD_1: 32 CGW
 SG_ MCUF_FD1_Checksum1 : 0|8@1+ (1,0) [0|255] ""  IDCM
 SG_ MCUF_FD1_RollingCounter1 : 8|4@1+ (1,0) [0|15] ""  IDCM
 SG_ MCUF_ActOutputTq : 16|11@1+ (1,-1023) [-1023|1023] "Nm"  IDCM
 SG_ MCUF_FD1_Checksum2 : 64|8@1+ (1,0) [0|255] ""  IDCM
 SG_ MCUF_FD1_RollingCounter2 : 72|4@1+ (1,0) [0|15] ""  IDCM
 SG_ MCUF_Speed : 80|16@1+ (1,-32767) [-32767|32767] "rpm"  IDCM
 SG_ MCUF_ErrSt : 108|3@1+ (1,0) [0|7] ""  IDCM
 SG_ MCUF_InverterOverTemp : 124|1@1+ (1,0) [0|1] ""  IDCM
 SG_ MCUF_MotorOverTemp : 125|1@1+ (1,0) [0|1] ""  IDCM
 SG_ MCUF_FD1_Checksum3 : 128|8@1+ (1,0) [0|255] ""  IDCM
 SG_ MCUF_FD1_RollingCounter3 : 136|4@1+ (1,0) [0|15] ""  IDCM
 SG_ MCUF_CurrentHV : 144|11@1+ (1,-1023) [-1023|1024] "A"  IDCM
 SG_ MCUF_VltgHV : 155|10@1+ (1,0) [0|1023] "V"  IDCM

BO_ 658 MCUF_FD_3: 32 CGW
 SG_ MCUF_ElectricMachineTemp : 0|8@1+ (1,-40) [-40|213] "℃"  IDCM
 SG_ MCUF_InverterTemp : 8|8@1+ (1,-40) [-40|213] "℃"  IDCM
 SG_ MCUF_TractionModeSetting_Rsp : 83|2@1+ (1,0) [0|3] ""  IDCM

BO_ 225 MCUR_FD_1: 32 CGW
 SG_ MCUR_FD1_Checksum1 : 0|8@1+ (1,0) [0|255] ""  IDCM
 SG_ MCUR_FD1_RollingCounter1 : 8|4@1+ (1,0) [0|15] ""  IDCM
 SG_ MCUR_ActOutputTq : 16|11@1+ (1,-1023) [-1023|1023] "Nm"  IDCM
 SG_ MCUR_FD1_Checksum2 : 64|8@1+ (1,0) [0|255] ""  IDCM
 SG_ MCUR_FD1_RollingCounter2 : 72|4@1+ (1,0) [0|15] ""  IDCM
 SG_ MCUR_Speed : 80|16@1+ (1,-32767) [-32767|32767] "rpm"  IDCM
 SG_ MCUR_ErrSt : 108|3@1+ (1,0) [0|7] ""  IDCM
 SG_ MCUR_InverterOverTemp : 124|1@1+ (1,0) [0|1] ""  IDCM
 SG_ MCUR_MotorOverTemp : 125|1@1+ (1,0) [0|1] ""  IDCM
 SG_ MCUR_FD1_Checksum3 : 128|8@1+ (1,0) [0|255] ""  IDCM
 SG_ MCUR_FD1_RollingCounter3 : 136|4@1+ (1,0) [0|15] ""  IDCM
 SG_ MCUR_CurrentHV : 144|11@1+ (1,-1023) [-1023|1024] "A"  IDCM
 SG_ MCUR_VltgHV : 155|10@1+ (1,0) [0|1023] "V"  IDCM

BO_ 659 MCUR_FD_3: 32 CGW
 SG_ MCUR_ElectricMachineTemp : 0|8@1+ (1,-40) [-40|213] "℃"  IDCM
 SG_ MCUR_InverterTemp : 8|8@1+ (1,-40) [-40|213] "℃"  IDCM
 SG_ MCUR_TractionModeSetting_Rsp : 83|2@1+ (1,0) [0|3] ""  IDCM

BO_ 880 TBOX_FD_1: 32 CGW
 SG_ TBOX_AbsoluteTime_Year : 0|8@1+ (1,1970) [1970|2100] "Year"  IDCM,ARC,ARHUD,WHUD,VSP
 SG_ TBOX_AbsoluteTime_Month : 8|4@1+ (1,0) [1|12] "Month"  IDCM,ARC,ARHUD,WHUD,VSP
 SG_ TBOX_AbsoluteTime_Day : 16|6@1+ (1,0) [1|31] "Day"  IDCM,ARC,ARHUD,WHUD,VSP
 SG_ TBOX_AbsoluteTime_Hour : 24|5@1+ (1,0) [0|23] "Hour"  IDCM,ARC,ARHUD,WHUD,VSP
 SG_ TBOX_AbsoluteTime_Minute : 32|6@1+ (1,0) [0|59] "Minute"  IDCM,ARC,ARHUD,WHUD,VSP
 SG_ TBOX_AbsoluteTime_Second : 40|6@1+ (1,0) [0|59] "Second"  IDCM,ARC,ARHUD,WHUD,VSP

BO_ 378 TBOX_FD_2: 32 CGW
 SG_ TBOX_FD_2_Checksum1 : 0|8@1+ (1,0) [0|255] ""  IDCM
 SG_ TBOX_FD_2_RollingCounter1 : 8|4@1+ (1,0) [0|15] ""  IDCM
 SG_ TBOX_ChargeReservationSource : 16|3@1+ (1,0) [0|7] ""  IDCM
 SG_ TBOX_ReservationChargeActive : 22|2@1+ (1,0) [0|3] ""  IDCM
 SG_ TBOX_ReservationChargeEnable : 24|2@1+ (1,0) [0|3] ""  IDCM
 SG_ TBOX_ReservationChargeTimeHour : 26|6@1+ (1,0) [0|23] "h"  IDCM
 SG_ TBOX_ReservationChargeTimeMinute : 32|6@1+ (1,0) [0|59] "min"  IDCM
 SG_ TBOX_ReservationChargeDurationSet : 40|16@1+ (1,0) [0|65534] "min"  IDCM
 SG_ TBOX_ReservationChargCutoffSOCSet : 56|8@1+ (0.5,0) [0|100] "％"  IDCM
 SG_ TBOX_ReservationChargeStopHour : 80|6@1+ (1,0) [0|23] "h"  IDCM
 SG_ TBOX_ReservationChargeStopMinute : 88|6@1+ (1,0) [0|59] "min"  IDCM

BO_ 761 TBOX_FD_5: 32 CGW
 SG_ TBOX_FD_5_Checksum1 : 0|8@1+ (1,0) [0|255] ""  IDCM
 SG_ TBOX_FD_5_RollingCounter1 : 8|4@1+ (1,0) [0|15] ""  IDCM
 SG_ TBOX_BluetoothKey1Availability : 16|2@1+ (1,0) [0|3] ""  IDCM
 SG_ TBOX_BluetoothKey1ZoneID : 18|4@1+ (1,0) [0|15] ""  IDCM
 SG_ TBOX_BluetoothKey2ZoneID : 34|4@1+ (1,0) [0|15] ""  IDCM
 SG_ TBOX_VehicleTotalMileageBackup : 64|24@1+ (0.1,0) [0|999999.9] "Km"  IDCM
 SG_ TBOX_ECall_St : 128|2@1+ (1,0) [0|3] ""  IDCM
 SG_ TBOX_BLEConnected_St : 130|2@1+ (1,0) [0|3] ""  IDCM,VSP
 SG_ TBOX_BCall_St : 132|2@1+ (1,0) [0|3] ""  IDCM
 SG_ TBOX_GuardWakeup : 134|2@1+ (1,0) [0|3] ""  IDCM
 SG_ TBOX_AbnormalMoveWakeup : 136|2@1+ (1,0) [0|3] ""  IDCM
 SG_ TBOX_ScratchWakeup : 138|2@1+ (1,0) [0|3] ""  IDCM
 SG_ TBOX_SVTWakeup : 140|2@1+ (1,0) [0|3] ""  IDCM
 SG_ TBOX_CrashWakeup : 142|2@1+ (1,0) [0|3] ""  IDCM

BO_ 762 TBOX_FD_7: 32 CGW
 SG_ TBOX_FD_7_Checksum1 : 0|8@1+ (1,0) [0|255] ""  IDCM,ARC,WHUD
 SG_ TBOX_FD_7_RollingCounter1 : 8|4@1+ (1,0) [0|15] ""  IDCM,ARC,WHUD
 SG_ TBOX_V2XFrontCollisionWarn_St : 16|2@1+ (1,0) [0|3] ""  IDCM,ARC,WHUD
 SG_ TBOX_V2XFrontCollisionWarn_Direction : 18|4@1+ (1,0) [0|15] ""  IDCM,ARC,WHUD
 SG_ TBOX_V2XFrontCollisionWarn_AlarmLevel : 22|2@1+ (1,0) [0|3] ""  IDCM,ARC,WHUD
 SG_ TBOX_V2XFrontCollisionWarn_Distance : 24|8@1+ (1,0) [0|254] "m"  IDCM,ARC,WHUD
 SG_ TBOX_V2XIntersectionCollisionWarn_St : 40|2@1+ (1,0) [0|3] ""  IDCM,ARC,WHUD
 SG_ TBOX_V2XIntersectionCollisionWarn_Direction : 42|4@1+ (1,0) [0|15] ""  IDCM,ARC,WHUD
 SG_ TBOX_V2XIntersectionCollisionWarn_AlarmLevel : 46|2@1+ (1,0) [0|3] ""  IDCM,ARC,WHUD
 SG_ TBOX_V2XIntersectionCollisionWarn_Distance : 48|8@1+ (1,0) [0|254] "m"  IDCM,ARC,WHUD
 SG_ TBOX_FD_7_Checksum2 : 64|8@1+ (1,0) [0|255] ""  IDCM,ARC,WHUD
 SG_ TBOX_FD_7_RollingCounter2 : 72|4@1+ (1,0) [0|15] ""  IDCM,ARC,WHUD
 SG_ TBOX_V2XTurnLeftAssist_Distance : 80|8@1+ (1,0) [0|254] "m"  IDCM,ARC,WHUD
 SG_ TBOX_V2XTurnLeftAssist_St : 88|2@1+ (1,0) [0|3] ""  IDCM,ARC,WHUD
 SG_ TBOX_V2XTurnLeftAssist_AlarmLevel : 90|2@1+ (1,0) [0|3] ""  IDCM,ARC,WHUD
 SG_ TBOX_V2XReverseOvertakeWarn_Distance : 104|8@1+ (1,0) [0|254] "m"  IDCM,ARC,WHUD
 SG_ TBOX_V2XReverseOvertakeWarn_St : 112|2@1+ (1,0) [0|3] ""  IDCM,ARC,WHUD
 SG_ TBOX_V2XReverseOvertakeWarn_AlarmLevel : 114|2@1+ (1,0) [0|3] ""  IDCM,ARC,WHUD
 SG_ TBOX_FD_7_Checksum3 : 128|8@1+ (1,0) [0|255] ""  IDCM,ARC,WHUD
 SG_ TBOX_FD_7_RollingCounter3 : 136|4@1+ (1,0) [0|15] ""  IDCM,ARC,WHUD
 SG_ TBOX_V2XEmergencyBrakeWarn_St : 144|2@1+ (1,0) [0|3] ""  IDCM,ARC,WHUD
 SG_ TBOX_V2XEmergencyBrakeWarn_Direction : 146|4@1+ (1,0) [0|15] ""  IDCM,ARC,WHUD
 SG_ TBOX_V2XEmergencyBrakeWarn_AlarmLevel : 150|2@1+ (1,0) [0|3] ""  IDCM,ARC,WHUD
 SG_ TBOX_V2XEmergencyBrakeWarn_Distance : 152|8@1+ (1,0) [0|254] "m"  IDCM,ARC,WHUD
 SG_ TBOX_V2XAbnormalVehicleWarn_Distance : 168|8@1+ (1,0) [0|254] "m"  IDCM,ARC,WHUD
 SG_ TBOX_V2XAbnormalVehicleWarn_St : 176|2@1+ (1,0) [0|3] ""  IDCM,ARC,WHUD
 SG_ TBOX_V2XAbnormalVehicleWarn_AlarmLevel : 178|2@1+ (1,0) [0|3] ""  IDCM,ARC,WHUD
 SG_ TBOX_V2XAbnormalVehicleWarn_Angle : 180|10@1+ (1,0) [0|359] "°"  IDCM,ARC,WHUD

CM_ BO_ 744 "DLP_AVAS_路由信息";
CM_ BO_ 555 "座椅相关信号";
CM_ BO_ 745 "座椅相关信号";
CM_ BO_ 746 "座椅相关信号";
CM_ BO_ 747 "座椅相关信号";
CM_ BO_ 748 "座椅相关信号";
CM_ BO_ 310 "CSM_路由信息";
CM_ BO_ 700 "OLM_SCAM_路由信息";
CM_ BO_ 697 "门模块信号路由信息";
CM_ BO_ 208 "VDCM行驶类基础信息";
CM_ BO_ 220 "VDCM全局状态信息";
CM_ BO_ 663 "VDCM直发_100ms";
CM_ BO_ 540 "IDCM显示需求";
CM_ BO_ 222 "与ADCM交互需求";
CM_ BO_ 244 "VDCM直发_10ms";
CM_ BO_ 232 "PT基础信息_10ms_路由";
CM_ BO_ 648 "PT基础信息_100ms";
CM_ BO_ 653 "智能空调反馈显示";
CM_ BO_ 938 "电池容量信息";
CM_ BO_ 527 "IFV摄像头状态";
CM_ BO_ 224 "MCU_Sts";
CM_ BO_ 658 "MCUF温度、故障信息";
CM_ BO_ 225 "MCUR状态";
CM_ BO_ 659 "MCUR温度、故障信息";
CM_ BO_ 880 "绝对时间";
CM_ BO_ 378 "PT设置、控制信号";
CM_ BO_ 761 "蓝牙钥匙状态、安全管家、XCall";
CM_ BO_ 762 "V2X信号";
CM_ SG_ 744 DLP_LowerBeamLampSt_Rsp "Lower Beam Lamp State Response
近光灯点亮状态";
CM_ SG_ 744 DLP_LeftLampErr_Rsp "Left Lamp Error Response
左大灯故障反馈";
CM_ SG_ 744 DLP_RightLampErr_Rsp "Right Lamp Error Response
右大灯故障反馈";
CM_ SG_ 744 DLP_HighBeamLampSt_Rsp "High Beam Lamp State Response
远光点亮状态";
CM_ SG_ 744 DLP_PositionLampSt_Rsp "Position Lamp State Response
位置光灯点亮状态反馈";
CM_ SG_ 744 DLP_FogLampSt_Rsp_OnlyForIV2 "Fog Lamp State Response
后雾灯点亮状态反馈";
CM_ SG_ 744 DLP_LogLampSt_Rsp "Log Lamp State Response
Log灯的点亮状态反馈";
CM_ SG_ 744 DLP_ISDChargeConDisplayEn_Rsp "ISD Charging Connector Display Enable Response
ISD充电枪连接状态显示使能开关反馈";
CM_ SG_ 744 DLP_DaytimeRunningLightSt_Rsp "Day time Running Light State Response
日间行车灯点亮状态反馈";
CM_ SG_ 744 DLP_FLTurnLightSt_Rsp "Front Left Turn Light State Response
左前转向灯点亮状态反馈";
CM_ SG_ 744 DLP_FLTurnLightErr_Rsp_OnlyForIV2 "Front Left Turn Light Error State Response
左前转向灯故障状态反馈";
CM_ SG_ 744 DLP_RLTurnLightSt_Rsp "Rear Left Turn Light State Response
左后转向灯点亮状态反馈";
CM_ SG_ 744 DLP_RLTurnLightErr_Rsp_OnlyForIV2 "Rear Left Turn Light Error State Response
左后转向灯故障状态反馈";
CM_ SG_ 744 DLP_FRTurnLightSt_Rsp "Front Right Turn Light State Response
右前转向灯点亮状态反馈";
CM_ SG_ 744 DLP_FRTurnLightErr_Rsp_OnlyForIV2 "Front Right Turn Light Error State Response
右前转向灯故障状态反馈";
CM_ SG_ 744 DLP_RRTurnLightSt_Rsp "Rear Right Turn Light State Response
右后转向灯点亮状态反馈";
CM_ SG_ 744 DLP_RRTurnLightErr_Rsp_OnlyForIV2 "Rear Right Turn Light Error State Response
右后转向灯故障状态反馈";
CM_ SG_ 744 DLP_TailLampSt_Rsp "Tail Lamp State Response
尾灯点亮状态反馈";
CM_ SG_ 744 DLP_BrakeLampSt_Rsp "Brake Lamp State Response
刹车灯点亮状态反馈";
CM_ SG_ 744 DLP_TailLampErr_Rsp "Tail Lamp Error Response
尾灯（后位置灯）故障状态反馈";
CM_ SG_ 744 DLP_BrakeLampErr_Rsp "Brake Lamp Error Response
刹车灯故障状态反馈";
CM_ SG_ 744 DLP_ReversingLampSt_Rsp "Reversing Lamp State Response
倒车灯点亮状态反馈";
CM_ SG_ 744 DLP_LightingMasterErr_Rsp "Lighting Master Error Response
Lighting Master故障状态";
CM_ SG_ 744 DLP_CameraErr_Rsp "Camera Error Response
Camera故障状态";
CM_ SG_ 744 DLP_DHLErr_Rsp "DHL Error Response
DHL故障状态";
CM_ SG_ 744 DLP_PreviewErr_Rsp "Preview Error Response
预览功能故障状态反馈";
CM_ SG_ 744 DLP_VideoProjectErr_Rsp "Video Project Error Response
视频投影故障状态";
CM_ SG_ 744 DLP_ADASHoldProjectSt_Rsp "ADAS Hold Project State Response
ADAS抑制DLP投影状态反馈";
CM_ SG_ 744 DLP_PedestrianFirstPromptButton_Req "Pedestrian First Prompt Button Request
行人优先通行触发请求信号";
CM_ SG_ 744 DLP_DrivingLinePromptTrigger_Req "DrivingLinePromptTriggerRequest
行驶轨迹提示触发请求信号";
CM_ SG_ 744 DLP_ActualLightShowMode_Rsp "Actual Light Show Mode
当前进行的灯光秀模式";
CM_ SG_ 744 DLP_LightShowWorkingSt_Rsp "Light Show Working State Response
灯光秀进行状态";
CM_ SG_ 744 DLP_ADBEN_Rsp "ADBFunctionEnableResponse
ADB功能使能状态反馈";
CM_ SG_ 744 DLP_LightPedestriansWarnEn_Rsp "LightPedestriansWarnFunctionEnableResponse
大灯行人警示功能使能状态反馈";
CM_ SG_ 744 DLP_PedestrianFirstEn_Rsp "ISD Pedestrian First Enable Response
ISD的行人优先功能使能状态反馈";
CM_ SG_ 744 DLP_LightFrontVehicleCollisionWarnEn_Rsp "LightFrontVehicleCollisionWarnEnableResponse
大灯前车碰撞预警功能使能状态反馈";
CM_ SG_ 744 DLP_LightLaneChangeWarnEn_Res "LightLaneChangeWarnEnableResponse
大灯变道辅助提示功能使能状态反馈";
CM_ SG_ 744 DLP_LightTurnWarnEn_Rsp "LightTurnWarnEnableResponse
大灯转向提示功能使能状态反馈";
CM_ SG_ 744 DLP_LightLaneDepartureWarnEn_Rsp "LightLaneDepartureWarnEnableResponse
大灯车道偏离预警功能使能状态反馈";
CM_ SG_ 744 DLP_LightSpeedLimitWarnEn_Rsp "LightSpeedLimitWarnEnableResponse
大灯限速提示功能使能状态反馈";
CM_ SG_ 744 DLP_LightSmartNavigationPromptEn_Rsp "LightSmartNavigationPromptEnableResponse
大灯智能导航提示功能使能状态反馈";
CM_ SG_ 744 DLP_LightDrivingLinePromptEn_Rsp "LightDrivingLinePromptEnableResponse
大灯行驶轨迹提示功能使能状态反馈";
CM_ SG_ 744 DLP_LightVideoProjectPlayEn_Rsp "LightVideoProjectPlayEnableResponse
大灯投影播放激活状态反馈";
CM_ SG_ 744 DLP_ISDSmartNavigationEN_Rsp "ISD Smart Navigation Prompt Enable Response
ISD智能导航功能使能状态反馈";
CM_ SG_ 744 DLP_ISDSpeedLimitPromptEN_Rsp "ISD Speed Limit Prompt Enable Response
ISD限速提醒功能使能状态反馈";
CM_ SG_ 744 DLP_PreviewState_Rsp "Preview State Response
预览状态反馈";
CM_ SG_ 744 DLP_ISDEnduranceMileagePromptEn_Rsp "ISDEnduranceMileagePromptEnableResponse
ISD续航里程提示使能状态反馈";
CM_ SG_ 744 DLP_LightSignatureProjectEn_Rsp "LightSignatureProjectEnableResponse
大灯签名投影激活状态反馈";
CM_ SG_ 744 DLP_LightAutomaticPiolotPromptEn_Rsp "LightAutomaticPiolotPromptEnableResponse
大灯自动驾驶提示使能状态反馈";
CM_ SG_ 744 DLP_DrivingLinePromptButton_Rsp "DrivingLinePromptButtonRespone
行驶轨迹提示按钮反馈信号";
CM_ SG_ 744 DLP_ThanksButton_Rsp "Thanks Button Response
点赞按钮反馈";
CM_ SG_ 744 DLP_PedestrianFirsttButton_Rsp "PedestrianFirsttButtonRespones
行人优先通行按钮反馈";
CM_ SG_ 744 DLP_PrjctProjectLampSelact_Rsp "ProjectLampSelactResponse
投影灯选择（左灯/右灯投影选择）";
CM_ SG_ 744 DLP_ProjectAreaSelect_Rsp "ProjectAreaSelectResponse
投影位置选择，包括:投影到墙（规定距离范围）；投影到地";
CM_ SG_ 744 DLP_SaveButtone_Rsp "SaveButtoneRsponse
保存按钮状态反馈";
CM_ SG_ 744 DLP_ISDRearVehicleCollisionWarnEn_Rsp "ISDRearVehicleCollisionWarnEnableResponse
ISD后车碰撞预警能使能状态反馈";
CM_ SG_ 744 DLP_ISDCustomerEditeErr_Rsp "ISD Customer Edite Error
ISD客户自编辑模式故障状态";
CM_ SG_ 744 DLP_ISDHighBeamLampOffRemainderEn_Rsp "ISDHighBeamLampOffRemainderEnableResponse
ISD关闭远光提示能使能状态反馈";
CM_ SG_ 744 DLP_ISDPedestrianFirstEn_Rsp "ISDPedestrianFirstEnableResponse
ISD行人优先提示使能状态反馈";
CM_ SG_ 744 DLP_ISDLockStateRemainderEn_Rsp "ISDLockStateRemainderEnableResponse
ISD车辆上锁状态提示功能使能状态反馈";
CM_ SG_ 744 DLP_ISDChangeDrivingModeEn_Rsp "ISDChangeDrivingModeEnableResponse
ISD驾驶模式切换使能状态反馈";
CM_ SG_ 744 DLP_ISDCustomersModeEN_Rsp "ISDCustomersModeEnable Response
ISD自定义模式（信号灯样式手动个性化选择）使能状态反馈";
CM_ SG_ 744 DLP_ISDCustomerEditEN_Rsp "ISDCustomerEditEnable
ISD客户自编辑模式使能状态反馈";
CM_ SG_ 744 DLP_Festival1_LightShowEn_Rsp "Festival 1 Light Show Enable Response
节日1灯光秀使能设置反馈信号";
CM_ SG_ 744 DLP_Festival2_LightShowEn_Rsp "Festival 2 Light Show Enable Response
节日2灯光秀使能设置反馈信号";
CM_ SG_ 744 DLP_Festival3_LightShowEn_Rsp "Festival 3 Light Show Enable Response
节日3灯光秀使能设置反馈信号";
CM_ SG_ 744 DLP_Festival4_LightShowEn_Rsp "Festival 4 Light Show Enable Response
节日4灯光秀使能设置反馈信号";
CM_ SG_ 744 DLP_Festival5_LightShowEn_Rsp "Festival 5 Light Show Enable Response
节日5灯光秀使能设置反馈信号";
CM_ SG_ 744 DLP_WelcomeLightShowEn_Rsp "Welcome Light Show Enable Response
欢迎灯光秀使能设置反馈信号";
CM_ SG_ 744 DLP_FarewellLightShowEn_Rsp "Farewell Light Show Enable Response
欢送灯光秀使能设置反馈信号";
CM_ SG_ 744 DLP_LightShow1En_Rsp_Reserved "Light Show 1 Enable Response(reserved)
预留灯光秀1使能设置反馈信号";
CM_ SG_ 744 DLP_LightShow2En_Rsp_Reserved "Light Show 2 Enable Response(reserved)
预留灯光秀2使能设置反馈信号";
CM_ SG_ 744 DLP_LightShow3En_Rsp_Reserved "Light Show 3 Enable Response(reserved)
预留灯光秀3使能设置反馈信号";
CM_ SG_ 744 DLP_LightShow4En_Rsp_Reserved "Light Show 4 Enable Response(reserved)
预留灯光秀4使能设置反馈信号";
CM_ SG_ 744 DLP_LightShow5En_Rsp_Reserved "Light Show 5 Enable Response(reserved)
预留灯光秀5使能设置反馈信号";
CM_ SG_ 744 DLP_LightShow6En_Rsp_Reserved "Light Show 6 Enable Response(reserved)
预留灯光秀6使能设置反馈信号";
CM_ SG_ 744 DLP_LightShow7En_Rsp_Reserved "Light Show 7 Enable Response(reserved)
预留灯光秀7使能设置反馈信号";
CM_ SG_ 744 DLP_LightShow8En_Rsp_Reserved "Light Show 8 Enable Response(reserved)
预留灯光秀8使能设置反馈信号";
CM_ SG_ 744 AVAS_SoundType "AVAS Sound Type
AVAS音源状态";
CM_ SG_ 744 AVAS_ErrInfo "AVAS Error Information
故障信息";
CM_ SG_ 744 AVAS_ENSt_Rsp "AVAS Enable State Response
行人提示开关使能状态反馈";
CM_ SG_ 744 DLP_ProtocolVersion "DLP Protocol Version
DLP 协议版本";
CM_ SG_ 744 BDCM_FD_RT_2_AVAS_Available_St "If signals which route from AVAS in message BBDCM_FD_RT_2 are available
报文BDCM_FD_RT_2中路由的AVAS节点的信号是否可信";
CM_ SG_ 744 BDCM_FD_RT_2_DLP_Available_St "If signals which route from DLP in messageBDCM_FD_RT_2 are available
报文BDCM_FD_RT_2中路由的DLP节点的信号是否可信";
CM_ SG_ 744 BDCM_FDRT2_Checksum_1 "E2E Signal Group Checksum
Checksum is the actual value after calculation. See the 'ChecksumAlgorithm' sheet for the specific algorithm.
E2E信号组校验和
Checksum为计算后实际值，具体算法参见“ChecksumAlgorithm”页";
CM_ SG_ 744 BDCM_FDRT2_RollingCounter_1 "E2E Signal Group Counter
Counter value is automatically accumulated, added from 0 to 14 and then looped to the initial value of 0. Every time a message is sent, counter adds 1.
E2E信号组计数器
Counter值为自动累加，从0加到14，然后循环至初始值0，每次报文发送，Counter加1";
CM_ SG_ 744 DLP_FLTurnLightErr_Rsp "Front Left Turn Light Error State Response
左前转向灯故障状态反馈";
CM_ SG_ 744 DLP_RLTurnLightErr_Rsp "Rear Left Turn Light Error State Response
左后转向灯故障状态反馈";
CM_ SG_ 744 DLP_FRTurnLightErr_Rsp "Front Right Turn Light Error State Response
右前转向灯故障状态反馈";
CM_ SG_ 744 DLP_RRTurnLightErr_Rsp "Rear Right Turn Light Error State Response
右后转向灯故障状态反馈";
CM_ SG_ 555 SCMFL_FrontBackAdjMotorPosition_St "Front Left Seat Front Back Adjust Motor Position State
SCM_FL_主驾座椅前后调节电机位置信号";
CM_ SG_ 555 SCMFL_HeightAdjMotorPosition_St "Front Left Seat Height Adjust Motor Position State
SCM_FL_主驾座椅高度调节电机位置信号";
CM_ SG_ 555 SCMFL_CushionAngleAdjMotorPosition_St "Front Left Seat Cushion Angle Adjust Motor Position State
SCM_FL_主驾座椅坐垫角度调节电机位置信号";
CM_ SG_ 555 SCMFL_BackCushionAdjMotorPosition_St "Front Left Seat Back Cushion Adjust Motor Position State
SCM_FL_主驾座椅靠背调节电机位置信号";
CM_ SG_ 555 SCMFL_FrontBackAdjMotorCalibration_St_OnlyForIV2 "Front Left Seat Front Back Adjust Motor Calibration State
SCM_FL_主驾座椅前后调节电机标定状态";
CM_ SG_ 555 SCMFL_HeightAdjMotorCalibration_St_OnlyForIV2 "Front Left Seat Height Adjust Motor Calibration State
SCM_FL_主驾座椅高度调节电机标定状态";
CM_ SG_ 555 SCMFL_CushionAngleAdjMotorCalibration_St_OnlyForIV2 "Front Left Seat Cushion Angle Adjust Motor Calibration State
SCM_FL_主驾座椅坐垫角度调节电机标定状态";
CM_ SG_ 555 SCMFL_BackCushionAdjMotorCalibration_St_OnlyForIV2 "Front Left Seat Back Cushion Adjust Motor Calibration State
SCM_FL_主驾座椅靠背调节电机标定状态";
CM_ SG_ 555 SCMFR_FrontBackAdjMotorPosition_St "Front Right Seat Front Back Adjust Motor Position State
SCM_FR_副驾座椅前后调节电机位置信号";
CM_ SG_ 555 SCMFR_HeightAdjMotorPosition_St "Front Right Seat Height Adjust Motor Position State
SCM_FR_副驾座椅高度调节电机位置信号";
CM_ SG_ 555 SCMFR_SeatLegSupportAdjMotorPosition_St "Front Right Seat Leg Support Adjust Motor Position State
SCM_FR_副驾座椅腿托调节电机位置信号";
CM_ SG_ 555 SCMFR_BackCushionAdjMotorPosition_St "Front Right Seat Back Cushion Adjust Motor Position State
SCM_FR_副驾座椅靠背调节电机位置信号";
CM_ SG_ 555 SCMFR_FrontBackAdjMotorCalibration_St_OnlyForIV2 "Front Right Seat Front Back Adjust Motor Calibration State
SCM_FR_副驾座椅前后调节电机标定状态";
CM_ SG_ 555 SCMFR_HeightAdjMotorCalibration_St_OnlyForIV2 "Front Right Seat Height Adjust Motor Calibration State
SCM_FR_副驾座椅高度调节电机标定状态";
CM_ SG_ 555 SCMFR_LegSupportAdjMotorCalibration_St_OnlyForIV2 "Front Right Seat Leg Support Adjust Motor Calibration State
SCM_FR_副驾腿托调节电机标定状态";
CM_ SG_ 555 SCMFR_BackCushionAdjMotorCalibration_St_OnlyForIV2 "Front Right Seat Back Cushion Adjust Motor Calibration State
SCM_FR_副驾座椅靠背调节电机标定状态";
CM_ SG_ 555 SCMSRL_FrontBackAdjMotorPosition_St "Second Row Left Seat Front Back Adjust Motor Position State
SCM_SRL_第二排左侧座椅前后调节电机位置信号";
CM_ SG_ 555 SCMSRL_BackCushionAdjMotorPosition_St "Second Row Left Seat Lateral Adjust Motor Position State
SCM_SRL_第二排左侧座椅靠背调节电机位置信号";
CM_ SG_ 555 SCMSRL_LateralAdjustMotorPosition_St "Second Row Left Seat Back Cushion Adjust Motor Position State
SCM_SRL_第二排左侧座椅侧向调节电机位置信号";
CM_ SG_ 555 SCMSRL_LegSupportAdjMotorPosition_St "Second Row Left Seat Leg Support Adjust Motor Position State
SCM_SRL_第二排左侧座椅腿托调节电机位置信号";
CM_ SG_ 555 SCMSRL_FrontBackAdjustSt_Rsp "Second Row Left Seat Front Back Adjust State Response
SCM_SRL_第二排左侧座椅前后调节状态反馈信号";
CM_ SG_ 555 SCMSRL_LegSupportAdjustSt_Rsp "Second Row Left Seat Leg Support Adjust State Response
SCM_SRL_第二排左侧座椅腿托调节状态反馈信号";
CM_ SG_ 555 SCMSRL_LateralAdjustSt_Rsp "Second Row Left Seat Lateral Adjust State Response
SCM_SRL_第二排左侧座椅侧向调节状态反馈信号";
CM_ SG_ 555 SCMSRL_BackCushionAdjustSt_Rsp "Second Row Left Seat Back Cushion Adjust State Response
SCM_SRL_第二排左侧座椅靠背调节状态反馈信号";
CM_ SG_ 555 SCMSRL_FrontBackAdjMotorCalibration_St_OnlyForIV2 "Second Row Left Seat Front Back Adjust Motor Calibration State
SCM_SRL_第二排左侧座椅前后调节电机标定状态";
CM_ SG_ 555 SCMSRL_BackCushionAdjMotorCalibration_St_OnlyForIV2 "Second Row Left Seat Back Cushion Adjust Motor Calibration State
SCM_SRL_第二排左侧座椅靠背调节电机标定状态";
CM_ SG_ 555 SCMSRL_LateralAdjMotorCalibration_St_OnlyForIV2 "Second Row Left Seat Lateral Adjust Motor Calibration State
SCM_SRL_第二排左侧座椅侧向调节电机标定状态";
CM_ SG_ 555 SCMSRL_LegSupportAdjMotorCalibration_St_OnlyForIV2 "Second Row Left Seat Leg Support Adjust Motor Calibration State
SCM_SRL_第二排左侧座椅腿托调节电机标定状态";
CM_ SG_ 555 SCMSRR_FrontBackAdjMotorPosition_St "Second Row Right Seat Front Back Adjust Motor Position State
SCM_SRR_第二排右侧座椅前后调节电机位置信号";
CM_ SG_ 555 SCMSRR_BackCushionAdjMotorPosition_St "Second Row Right Seat Lateral Adjust Motor Position State
SCM_SRR_第二排右侧座椅靠背调节电机位置信号";
CM_ SG_ 555 SCMSRR_LateralAdjustMotorPosition_St "Second Row Right Seat Back Cushion Adjust Motor Position State
SCM_SRR_第二排右侧座椅侧向调节电机位置信号";
CM_ SG_ 555 SCMSRR_LegSupportAdjMotorPosition_St "Second Row Right Seat Leg Support Adjust Motor Position State
SCM_SRR_第二排右侧座椅腿托调节电机位置信号";
CM_ SG_ 555 SCMSRR_FrontBackAdjustSt_Rsp "Second Row Right Seat Front Back Adjust State Response
SCM_SRR_第二排右侧座椅前后调节状态反馈信号";
CM_ SG_ 555 SCMSRR_LegSupportAdjustSt_Rsp "Second Row Right Seat Leg Support Adjust State Response
SCM_SRR_第二排右侧座椅腿托调节状态反馈信号";
CM_ SG_ 555 SCMSRR_LateralAdjustSt_Rsp "Second Row Right Seat Lateral Adjust State Response
SCM_SRR_第二排右侧座椅侧向调节状态反馈信号";
CM_ SG_ 555 SCMSRR_BackCushionAdjustSt_Rsp "Second Row Right Seat Back Cushion Adjust State Response
SCM_SRR_第二排右侧座椅靠背调节状态反馈信号";
CM_ SG_ 555 SCMSRR_FrontBackAdjMotorCalibration_St_OnlyForIV2 "Second Row Right Seat Front Back Adjust Motor Calibration State
SCM_SRR_第二排右侧座椅前后调节电机标定状态";
CM_ SG_ 555 SCMSRR_BackCushionAdjMotorCalibration_St_OnlyForIV2 "Second Row Right Seat Back Cushion Adjust Motor Calibration State
SCM_SRR_第二排右侧座椅靠背调节电机标定状态";
CM_ SG_ 555 SCMSRR_LateralAdjMotorCalibration_St_OnlyForIV2 "Second Row Right Seat Lateral Adjust Motor Calibration State
SCM_SRR_第二排右侧座椅侧向调节电机标定状态";
CM_ SG_ 555 SCMSRR_LegSupportAdjMotorCalibration_St_OnlyForIV2 "Second Row Right Seat Leg Support Adjust Motor Calibration StateSCM_SRR_第二排右侧座椅腿托调节电机标定状态";
CM_ SG_ 745 SCMFL_HeatTemp_Rsp "Front Left Seat  Heat Temperature Response
SCM_FL_主驾驶座椅加热温度信号";
CM_ SG_ 745 SCMFL_HeatGearSt_Rsp "Front Left Seat Heat Gear State Response
SCM_FL_主驾驶座椅加热档位状态反馈信号";
CM_ SG_ 745 SCMFL_VentilationSt_Rsp "Front Left Seat Ventilation State Response
SCM_FL_主驾驶座椅通风状态反馈信号";
CM_ SG_ 745 SCMFL_LumbarSupportFrontBackAdjSt_Rsp "Front Left Lumbar Support Front Back Adjust State Response
SCM_FL_主驾驶座椅腰托气袋前后调节状态反馈信号";
CM_ SG_ 745 SCMFL_LumbarSupportUpDwnAdjSt_Rsp "Front Left Lumbar Support Up Down Adjust State Response
SCM_FL_主驾驶座椅腰托气袋上下调节状态反馈信号";
CM_ SG_ 745 SCMFL_LeftShakeMotorSt_Rsp "Left  Shake Motor State Response
SCM_FL_主驾驶座椅左侧震动电机状态反馈信号";
CM_ SG_ 745 SCMFL_RightShakeMotorSt_Rsp "Right Shake Motor State Response
SCM_FL_主驾驶座椅右侧震动电机状态反馈信号";
CM_ SG_ 745 SCMFL_MassageStrength_Rsp "Front Left Seat Massage Strength  Response
SCM_FL_主驾座椅按摩力度反馈信号";
CM_ SG_ 745 SCMFL_MassageMode_Rsp "Front Left Seat Massage Mode Response
SCM_FL_主驾座椅按摩模式反馈信号";
CM_ SG_ 745 SCMFL_FrontBackMoveSt_Rsp "Front Left Seat Front Back Move State Response
主驾座椅前后调节状态反馈";
CM_ SG_ 745 SCMFL_HeightAdjustSt_Rsp "Front Left Seat Height Adjust State Response
主驾座椅高度调节状态反馈";
CM_ SG_ 745 SCMFL_CushionAngleAdjustSt_Rsp "Front Left Seat Cushion Angle Adjust State Response
主驾座椅坐垫角度调节反馈";
CM_ SG_ 745 SCMFL_BackCushionAdjustSt_Rsp "Front Left Seat Back Cushion Adjust State Response
主驾座椅靠背角度调节反馈";
CM_ SG_ 745 SCMFL_FrontBackAdjustStopRsn "Front Left Seat Front Back Adjust Stop Reason
SCM_FL_主驾座椅前后调节停止原因信号";
CM_ SG_ 745 SCMFL_HeightAdjustStopRsn "Front Left Seat Height Adjust Stop Reason
SCM_FL_主驾座椅高度调节停止原因信号";
CM_ SG_ 745 SCMFL_CushionAngleAdjustStopRsn "Front Left Seat Cushion Angle Adjust Stop Reason
SCM_FL_主驾座椅坐垫角度调节停止原因信号";
CM_ SG_ 745 SCMFL_BackCushionAdjustStopRsn "Front Left Seat Back Cushion Adjust Stop Reason
SCM_FL_主驾座椅靠背调节停止原因信号";
CM_ SG_ 745 SCMFL_HeatStopRsn "Front Left Seat Heat Stop Reason
SCM_FL_主驾座椅加热停止原因";
CM_ SG_ 745 SCMFL_VentilationStopRsn "Front Left Seat Ventilation Stop Reason
SCM_FL_主驾座椅通风停止原因";
CM_ SG_ 745 SCMFL_LeftShakeStopRsn "Front Left Seat Left Shake Stop Reason
SCM_FL_主驾座椅左侧震动停止原因信号";
CM_ SG_ 745 SCMFL_RightShakeStopRsn "Front Left Seat Right Shake Stop Reason
SCM_FL_主驾座椅右侧震动停止原因信号";
CM_ SG_ 745 SCMFL_LumbarSupportFrontBackAdjStopRsn "Front Left Lumbar Support Front Back Adjust Stop Reason
SCM_FL_主驾座椅腰托气袋前后调节停止原因";
CM_ SG_ 745 SCMFL_LumbarSupportUpDwnAdjStopRsn "Front Left Lumbar Support Up Down Adjust Stop Reason
SCM_FL_主驾座椅腰托气袋上下调节停止原因";
CM_ SG_ 745 SCMFL_MassageStopReason "Front Left Seat Massage Stop Reason
SCM_FL_主驾座椅按摩停止原因";
CM_ SG_ 746 BDCM_FD_12_Checksum "E2E Signal Group Checksum
Checksum is the actual value after calculation. See the 'ChecksumAlgorithm' sheet for the specific algorithm.
E2E信号组校验和
Checksum为计算后实际值，具体算法参见“ChecksumAlgorithm”页";
CM_ SG_ 746 BDCM_FD_12_RollingCounter "E2E Signal Group Counter
Counter value is automatically accumulated, added from 0 to 14 and then looped to the initial value of 0. Every time a message is sent, counter adds 1.
E2E信号组计数器
Counter值为自动累加，从0加到14，然后循环至初始值0，每次报文发送，Counter加1";
CM_ SG_ 746 SCMFR_Occupied_St "Front Right Seat Occupied State
SCM_FR_副驾座椅占位信号";
CM_ SG_ 746 SCMFR_SeatBelt_St "Front Right Seat Belt State
SCM_FR_副驾安全带状态信号";
CM_ SG_ 746 SCMFR_HeatTemp_Rsp "Front Right Seat  Heat Temperature Response
SCM_FR_副驾驶座椅加热温度信号";
CM_ SG_ 746 SCMFR_FrontBackMoveSt_Rsp "Front Right Seat Front Back Move State Response
副驾座椅前后调节状态反馈";
CM_ SG_ 746 SCMFR_HeightAdjustSt_Rsp "Front Right Seat Height Adjust State Response
副驾座椅高度调节状态反馈";
CM_ SG_ 746 SCMFR_LegSupportAdjustSt_Rsp "Front Right Seat Leg Support Adjust State Response
副驾座椅腿托调节状态反馈";
CM_ SG_ 746 SCMFR_BackCushionAdjustSt_Rsp "Front Right Seat Back Cushion Adjust State Response
副驾座椅靠背角度调节反馈";
CM_ SG_ 746 SCMFR_HeatGearSt_Rsp "Front Right Seat Heat Gear State Response
SCM_FR_副驾驶座椅加热档位状态反馈信号";
CM_ SG_ 746 SCMFR_VentilationSt_Rsp "Front Right Seat Ventilation State Response
SCM_FR_副驾驶座椅通风状态反馈信号";
CM_ SG_ 746 SCMFR_LumbarSupportFrontBackAdjSt_Rsp "Front Right Lumbar Support Front Back Adjust State Response
SCM_FR_副驾驶座椅腰托气袋前后调节状态反馈信号";
CM_ SG_ 746 SCMFR_LumbarSupportUpDwnAdjSt_Rsp "Front Right Lumbar Support Up Down Adjust State Response
SCM_FR_副驾驶座椅腰托气袋上下调节状态反馈信号";
CM_ SG_ 746 SCMFR_MassageStrength_Rsp "Front Right Seat Massage Strength  Response
SCM_FR_副驾座椅按摩力度反馈信号";
CM_ SG_ 746 SCMFR_MassageMode_Rsp "Front Right Seat Massage Mode Response
SCM_FR_副驾座椅按摩模式反馈信号";
CM_ SG_ 746 SCMFR_FrontBackAdjustStopRsn "Front Right Seat Front Back Adjust Stop Reason
SCM_FR_副驾座椅前后调节停止原因信号";
CM_ SG_ 746 SCMFR_HeightAdjustStopRsn "Front Right Seat Height Adjust Stop Reason
SCM_FR_副驾座椅高度调节停止原因信号";
CM_ SG_ 746 SCMFR_LegSupportAdjustStopRsn "Front Right Seat Leg Support Adjust Stop Reason
SCM_FR_副驾座椅腿托调节停止原因信号";
CM_ SG_ 746 SCMFR_BackCushionAdjustStopRsn "Front Right Seat Back Cushion Adjust Stop Reason
SCM_FR_副驾座椅靠背调节停止原因信号";
CM_ SG_ 746 SCMFR_HeatStopRsn "Front Right Seat Heat Stop Reason
SCM_FR_副驾座椅加热停止原因";
CM_ SG_ 746 SCMFR_VentilationStopRsn "Front Right Seat Ventilation Stop Reason
SCM_FR_副驾座椅通风停止原因";
CM_ SG_ 746 SCMFR_LumbarSupportFrontBackAdjStopRsn "Front Right Lumbar Support Front Back Adjust Stop Reason
SCM_FR_副驾座椅腰托气袋前后调节停止原因";
CM_ SG_ 746 SCMFR_LumbarSupportUpDwnAdjStopRsn "Front Right Lumbar Support Up Down Adjust Stop Reason
SCM_FR_副驾座椅腰托气袋上下调节停止原因";
CM_ SG_ 746 SCMFR_MassageStopReason "Front Right Seat Massage Stop Reason
SCM_FR_副驾座椅按摩停止原因";
CM_ SG_ 747 BDCM_FD_13_Checksum "E2E Signal Group Checksum
Checksum is the actual value after calculation. See the 'ChecksumAlgorithm' sheet for the specific algorithm.
E2E信号组校验和
Checksum为计算后实际值，具体算法参见“ChecksumAlgorithm”页";
CM_ SG_ 747 BDCM_FD_13_RollingCounter "E2E Signal Group Counter
Counter value is automatically accumulated, added from 0 to 14 and then looped to the initial value of 0. Every time a message is sent, counter adds 1.
E2E信号组计数器
Counter值为自动累加，从0加到14，然后循环至初始值0，每次报文发送，Counter加1";
CM_ SG_ 747 SCMSRL_HeatTemp_Rsp "Second Row Left Seat  Heat Temperature Response
SCM_SRL_第二排左侧座椅加热温度信号";
CM_ SG_ 747 SCMSRL_HeatGearSt_Rsp "Second Row Left Seat Heat Gear State Response
SCM_SRL_第二排左侧座椅加热档位状态反馈信号";
CM_ SG_ 747 SCMSRL_VentilationSt_Rsp "Second Row Left Seat Ventilation State Response
SCM_SRL_第二排左侧座椅通风状态反馈信号";
CM_ SG_ 747 SCMSRL_Occupied_St "Second Row Left Seat  Occupied State
SCM_SRL_第二排左侧座椅占位信号";
CM_ SG_ 747 SCMSRL_SeatBelt_St "Second Row Left Seat Belt State
SCM_SRL_第二排左侧安全带状态信号";
CM_ SG_ 747 SCMSRL_LumbarSupportFrontBackAdjSt_Rsp "Second Row Left Lumbar Support Front Back Adjust State Response
SCM_SRL_第二排左侧座椅腰托气袋前后调节状态反馈信号";
CM_ SG_ 747 SCMSRL_LumbarSupportUpDwnAdjSt_Rsp "Second Row Left Lumbar Support Up Down Adjust State Response
SCM_SRL_第二排左侧座椅腰托气袋上下调节状态反馈信号";
CM_ SG_ 747 SCMSRL_MassageStrength_Rsp "Second Row Left Seat Massage Strength  Response
SCM_SRL_第二排左侧座椅按摩力度反馈信号";
CM_ SG_ 747 SCMSRL_MassageMode_Rsp "Second Row Left Seat Massage Mode Response
SCM_SRL_第二排左侧座椅按摩模式反馈信号";
CM_ SG_ 747 SCMSRL_FrontBackAdjustStopRsn "Second Row Left Seat Front Back Adjust Stop Reason
SCM_SRL_第二排左侧座椅前后调节停止原因信号";
CM_ SG_ 747 SCMSRL_BackCushionAdjustStopRsn "Second Row Left Seat Back Cushion Adjust Stop Reason
SCM_SRL_第二排左侧座椅靠背调节停止原因信号";
CM_ SG_ 747 SCMSRL_LateralAdjustStopRsn "Second Row Left Seat Lateral Adjust Stop Reason
SCM_SRL_第二排左侧座椅侧向调节停止原因信号";
CM_ SG_ 747 SCMSRL_LegSupportAdjustStopRsn "Second Row Left Seat Leg Support Adjust Stop Reason
SCM_SRL_第二排左侧座椅腿托调节停止原因信号";
CM_ SG_ 747 SCMSRL_HeatStopRsn "Second Row Left Seat Heat Stop Reason
SCM_SRL_第二排左侧座椅加热停止原因";
CM_ SG_ 747 SCMSRL_VentilationStopRsn "Second Row Left Seat Ventilation Stop Reason
SCM_SRL_第二排左侧座椅通风停止原因";
CM_ SG_ 747 SCMSRL_LumbarSupportFrontBackAdjStopRsn "Second Row Left Lumbar Support Front Back Adjust Stop Reason
SCM_SRL_第二排左侧座椅腰托气袋前后调节停止原因";
CM_ SG_ 747 SCMSRL_LumbarSupportUpDwnAdjStopRsn "Second Row Left Lumbar Support Up Down Adjust Stop Reason
SCM_SRL_第二排左侧座椅腰托气袋上下调节停止原因";
CM_ SG_ 747 SCMSRL_MassageStopReason "Second Row Left Seat Massage Stop Reason
SCM_SRL_第二排左侧座椅按摩停止原因";
CM_ SG_ 748 BDCM_FD_14_Checksum "E2E Signal Group Checksum
Checksum is the actual value after calculation. See the 'ChecksumAlgorithm' sheet for the specific algorithm.
E2E信号组校验和
Checksum为计算后实际值，具体算法参见“ChecksumAlgorithm”页";
CM_ SG_ 748 BDCM_FD_14_RollingCounter "E2E Signal Group Counter
Counter value is automatically accumulated, added from 0 to 14 and then looped to the initial value of 0. Every time a message is sent, counter adds 1.
E2E信号组计数器
Counter值为自动累加，从0加到14，然后循环至初始值0，每次报文发送，Counter加1";
CM_ SG_ 748 SCMSRR_HeatTemp_Rsp "Second Row Right Seat  Heat Temperature Response
SCM_SRR_第二排右侧座椅加热温度信号";
CM_ SG_ 748 SCMSRR_HeatGearSt_Rsp "Second Row Right Seat Heat Gear State Response
SCM_SRR_第二排右侧座椅加热档位状态反馈信号";
CM_ SG_ 748 SCMSRR_VentilationSt_Rsp "Second Row Right Seat Ventilation State Response
SCM_SRR_第二排右侧座椅通风状态反馈信号";
CM_ SG_ 748 SCMSRR_Occupied_St "Second Row Right Seat  Occupied State
SCM_SRR_第二排右侧座椅占位信号";
CM_ SG_ 748 SCMSRR_SeatBelt_St "Second Row Right Seat Belt State
SCM_SRR_第二排右侧安全带开关状态信号";
CM_ SG_ 748 SCMSRR_LumbarSupportFrontBackAdjSt_Rsp "Second Row Right Lumbar Support Front Back Adjust State Response
SCM_SRR_第二排右侧座椅腰托气袋前后调节状态反馈信号";
CM_ SG_ 748 SCMSRR_LumbarSupportUpDwnAdjSt_Rsp "Second Row Right Lumbar Support Up Down Adjust State Response
SCM_SRR_第二排右侧座椅腰托气袋上下调节状态反馈信号";
CM_ SG_ 748 SCMSRR_MassageStrength_Rsp "Second Row Right Seat Massage Strength  Response
SCM_SRR_第二排右侧座椅按摩力度反馈信号";
CM_ SG_ 748 SCMSRR_MassageMode_Rsp "Second Row Right Seat Massage Mode Response
SCM_SRR_第二排右侧座椅按摩模式反馈信号";
CM_ SG_ 748 SCMSRR_FrontBackAdjustStopRsn "Second Row Right Seat Front Back Adjust Stop Reason
SCM_SRR_第二排右侧座椅前后调节停止原因信号";
CM_ SG_ 748 SCMSRR_BackCushionAdjustStopRsn "Second Row Right Seat Back Cushion Adjust Stop Reason
SCM_SRR_第二排右侧座椅靠背调节停止原因信号";
CM_ SG_ 748 SCMSRR_LateralAdjustStopRsn "Second Row Right Seat Lateral Adjust Stop Reason
SCM_SRR_第二排右侧座椅侧向调节停止原因信号";
CM_ SG_ 748 SCMSRR_LegSupportAdjustStopRsn "Second Row Right Seat Leg Support Adjust Stop Reason
SCM_SRR_第二排右侧座椅腿托调节停止原因信号";
CM_ SG_ 748 SCMSRR_HeatStopRsn "Second Row Right Seat Heat Stop Reason
SCM_SRR_第二排右侧座椅加热停止原因";
CM_ SG_ 748 SCMSRR_VentilationStopRsn "Second Row Right Seat Ventilation Stop Reason
SCM_SRR_第二排右侧座椅通风停止原因";
CM_ SG_ 748 SCMSRR_LumbarSupportFrontBackAdjStopRsn "Second Row Left Lumbar Support Front Back Adjust Stop Reason
SCM_SRR_第二排右侧座椅腰托气袋前后调节停止原因";
CM_ SG_ 748 SCMSRR_LumbarSupportUpDwnAdjStopRsn "Second Row Left Lumbar Support Up Down Adjust Stop Reason
SCM_SRR_第二排右侧座椅腰托气袋上下调节停止原因";
CM_ SG_ 748 SCMSRR_MassageStopReason "Second Row Left Seat Massage Stop Reason
SCM_SRR_第二排右侧座椅按摩停止原因";
CM_ SG_ 310 BDCM_FD_RT_8_CheckSum "E2E Signal Group Checksum
Checksum is the actual value after calculation. See the 'ChecksumAlgorithm' sheet for the specific algorithm.
E2E信号组校验和
Checksum为计算后实际值，具体算法参见“ChecksumAlgorithm”页";
CM_ SG_ 310 BDCM_FD_RT_8_RollingCounter "E2E Signal Group Counter
Counter value is automatically accumulated, added from 0 to 14 and then looped to the initial value of 0. Every time a message is sent, counter adds 1.
E2E信号组计数器
Counter值为自动累加，从0加到14，然后循环至初始值0，每次报文发送，Counter加1";
CM_ SG_ 310 CSM_SAS_SteeringWheelAngle "Informationregardingthesteeringwheelangle.Theangleshouldbepositivewhenturnleftandnegativewhenturnright.
方向盘转角";
CM_ SG_ 310 CSM_SAS_SteeringWheelSpeed "Informationregardingthesteeringwheelrotationspeed
方向盘转速";
CM_ SG_ 310 CSM_SAS_SteeringWheelAngle_Valid "IfSAS_AnglevalueisO.K.,SAS_OKflagissetandotherwiseSAS_OKflag
iscleared.
方向盘转角信号标志位";
CM_ SG_ 310 CSM_SAS_Calibrating_St "Ifsteeringanglesensorhasbeencalibrated,SAS_CALflagissetand
otherwisecleared.
传感器标定状态";
CM_ SG_ 310 CSM_SAS_Trimmed_St "IfSASistrimmed,SAS_Trimflag=1.IfSASisnottrimmed(inthiscaseSAS_OK=0andSAS_CAL=0),
SAS_Trimflag=0.
传感器初始化状态";
CM_ SG_ 310 BDCM_FD_RT_8_CSM_Available_St "If signals which route from CSM in messageBDCM_FD_RT_8 are available
报文BDCM_FD_RT_8中路由的CSM节点的信号是否可信";
CM_ SG_ 700 OLM_FLAirOutletFanLeftRightAngle_Rsp "Front Left Air Outlet Fan Left Right Angle Response
左前出风口左右角度位置反馈";
CM_ SG_ 700 OLM_FLAirOutletFanUpDownAngle_Rsp "Front Left Air Outlet Fan Up Down Angle Response
左前出风口上下角度位置反馈";
CM_ SG_ 700 OLM_FLAirOutletOpenCtl_Rsp "Front Left Air Outlet Open Control Response
左前出风口风门开关状态反馈";
CM_ SG_ 700 OLM_LCAirOutletOpenCtl_Rsp "Left Centre Air Outlet Open Control Response
左中出风口风门开关状态反馈";
CM_ SG_ 700 OLM_LCAirOutletFanUpDownAngle_Rsp "Left Centre Air Outlet Fan Up Down Angle Response
左中出风口上下角度位置反馈";
CM_ SG_ 700 OLM_LCAirOutletFanLeftRightAngle_Rsp "Left Centre Air Outlet Fan Left Right Angle Response
左中出风口左右角度位置反馈";
CM_ SG_ 700 OLM_PanelAirOutletFanLeftRightAngle_Rsp "Panel Air Outlet Fan Left Right Angle Response
仪表盘出风口左右角度位置反馈";
CM_ SG_ 700 OLM_PanelAirOutletFanUpDownAngle_Rsp "Panel Air Outlet Fan Left Right Angle Response
仪表盘出风口上下角度位置反馈";
CM_ SG_ 700 OLM_PanelAirOutletOpenCtl_Rsp "Panel Air Outlet Open Control Response
仪表盘出风口风门开关状态反馈";
CM_ SG_ 700 OLM_RCAirOutletFanLeftRightAngle_Rsp "Right Centre Air Outlet Fan Left Right Angle Response
右中出风口左右角度位置反馈";
CM_ SG_ 700 OLM_RCAirOutletFanUpDownAngle_Rsp "Right Centre Air Outlet Fan Up Down Angle Response
右中出风口上下角度位置反馈";
CM_ SG_ 700 OLM_RCAirOutletOpenCtl_Rsp "Right Centre Air Outlet Open Control Response
右中出风口风门开关状态反馈";
CM_ SG_ 700 OLM_FRAirOutletOpenCtl_Rsp "Front Right Air Outlet Open Control Response
右前出风口风门开关状态反馈";
CM_ SG_ 700 OLM_FRAirOutletFanUpDownAngle_Rsp "Front Right Air Outlet Fan Up Down Angle Response
右前出风口上下角度位置反馈";
CM_ SG_ 700 OLM_FRAirOutletFanLeftRightAngle_Rsp "Front Right Air Outlet Fan Left Right Angle Response
右前出风口左右角度位置反馈";
CM_ SG_ 700 OLM_FanOpenSt_Rsp "Fan Open State Response
吹风开启状态";
CM_ SG_ 700 OLM_FanMode_Rsp "Fan Mode State Response
当前吹风模式";
CM_ SG_ 700 OLM_FLMotorErrSt_Rsp "Front Left Motor Error State Response
左前出风口故障状态";
CM_ SG_ 700 OLM_LCMotorErrSt_Rsp "Left Centre Motor Error State Response
左中出风口故障状态";
CM_ SG_ 700 OLM_PanelMotorErrSt_Rsp "Panel Motor Error State Response
仪表盘出风口故障状态";
CM_ SG_ 700 OLM_RCMotorErrSt_Rsp "Right Centre Motor Error State Response
右中出风口故障状态";
CM_ SG_ 700 OLM_FRMotorErrSt_Rsp "Front Right Motor Error State Response
右前出风口故障状态";
CM_ SG_ 700 BDCM_FD_RT_9_OLM_Available_St "If signals which route from OLM in messageBDCM_FD_RT_9 are available
报文BDCM_FD_RT_9中路由的OLM节点的信号是否可信";
CM_ SG_ 700 SCAM_TiltPosition "Actual Tilt Position
当前Tilt位置";
CM_ SG_ 700 SCAM_TelescopePosition "Actual Telescope Position
当前Telescope位置";
CM_ SG_ 700 BDCM_FD_RT_9_SCAM_Available_St "If signals which route from SCAM in messageBDCM_FD_RT_9 are available
报文BDCM_FD_RT_9中路由的SCAM节点的信号是否可信";
CM_ SG_ 697 NTDM_RL_DoorOpenDegree_Rsp "Rear Left Door Open Degree Response
左后车门开启角度反馈";
CM_ SG_ 697 NTDM_RL_NTDoorOpenDegree_Rsp "Rear Left NT Door Open Degree Response
左NT开启角度反馈";
CM_ SG_ 697 NTDM_RL_DoorWorkSt_Rsp "Rear Left Door Work State Response
左后车门运行状态反馈";
CM_ SG_ 697 NTDM_RL_NTDoorLight_St "Rear Left NT Door Light State
左NT门探照灯状态";
CM_ SG_ 697 NTDM_RL_DoorStopReason "左后车门停止原因
Lefttraditionaldoorstopreazon";
CM_ SG_ 697 NTDM_RL_NTDoorStopReason "左后NT停止原因
roofdoorstopreazon";
CM_ SG_ 697 NTDM_RL_DoorObstacleAvoid_St "左后车门避障状态反馈
obstacleavoidstatus";
CM_ SG_ 697 NTDM_RL_NTDoorObstacleAvoid_St "左NT避障状态反馈
obstacleavoidstatus";
CM_ SG_ 697 NTDM_RL_DoorobstacleDistance_Rsp "Rear Left Door obstacle Distance Response
左后车门障碍物距离";
CM_ SG_ 697 NTDM_RL_NTDoorobstacleDistance_Rsp "Rear Left NT Door obstacle Distance Response
左NT门障碍物距离";
CM_ SG_ 697 NTDM_RL_NTDoorWorkSt_Rsp "Rear Left NT Door Work State Response
左NT运行状态反馈";
CM_ SG_ 697 NTDM_RL_NTDoorAntiClamp_St "Rear Left NT Door Anti Clamp State
左NT门防夹状态";
CM_ SG_ 697 NTDM_RL_DoorAntiClamp_St "Rear Left Door Anti Clamp State
左后车门防夹状态反馈";
CM_ SG_ 697 BDCM_FD_RT_10_NTDM_RL_Available_St "If signals which route from NTDM_RL in message BDCM_FD_RT_10 are available
报文BDCM_FD_RT_10中路由的NTDM_RL节点的信号是否可信";
CM_ SG_ 697 BDCM_FD_RT_10_NTDM_RR_Available_St "If signals which route from NTDM_RR in message BDCM_FD_RT_10 are available
报文BDCM_FD_RT_10中路由的NTDM_RR节点的信号是否可信";
CM_ SG_ 697 NTDM_RR_DoorOpenDegree_Rsp "Rear Right Door Open Degree Response
右后车门开启角度反馈";
CM_ SG_ 697 NTDM_RR_NTDoorOpenDegree_Rsp "Rear Right NT Door Open Degree Response
右NT开启角度反馈";
CM_ SG_ 697 NTDM_RR_DoorWorkSt_Rsp "Rear Right Door Work State Response
右后车门运行状态反馈";
CM_ SG_ 697 NTDM_RR_NTDooRRight_St "Rear Right NT Door Light State
右NT门探照灯状态";
CM_ SG_ 697 NTDM_RR_DoorStopReason "右后车门停止原因
Lefttraditionaldoorstopreazon";
CM_ SG_ 697 NTDM_RR_NTDoorStopReason "右后NT停止原因
roofdoorstopreazon";
CM_ SG_ 697 NTDM_RR_DoorObstacleAvoid_St "右后车门避障状态反馈
obstacleavoidstatus";
CM_ SG_ 697 NTDM_RR_NTDoorObstacleAvoid_St "右NT避障状态反馈
obstacleavoidstatus";
CM_ SG_ 697 NTDM_RR_DoorobstacleDistance_Rsp "Rear Right Door obstacle Distance Response
右后车门障碍物距离";
CM_ SG_ 697 NTDM_RR_NTDoorobstacleDistance_Rsp "Rear Right NT Door obstacle Distance Response
右NT门障碍物距离";
CM_ SG_ 697 NTDM_RR_NTDoorWorkSt_Rsp "Rear Right NT Door Work State Response
右NT运行状态反馈";
CM_ SG_ 697 NTDM_RR_NTDoorAntiClamp_St "Rear Right NT Door Anti Clamp State
右NT门防夹状态";
CM_ SG_ 697 NTDM_RR_DoorAntiClamp_St "Rear Right Door Anti Clamp State
右后车门防夹状态反馈";
CM_ SG_ 697 BDCM_FD_RT_10_PLGM_Available_St "If signals which route from PLGM in message BDCM_FD_RT_10 are available
报文BDCM_FD_RT_10中路由的PLGM节点的信号是否可信";
CM_ SG_ 697 PLGM_TravelPosition_Rsp "TravelPosition
描述尾门的当前开度";
CM_ SG_ 697 PLGM_RearDoorMove_St "RearDoorStatus
描述尾门运动状态";
CM_ SG_ 697 PLGM_RearDoorPosition_St "RearDoorPositionStatus
描述尾门位置状态";
CM_ SG_ 697 PLGM_PinchEvent_St "Pinch Event Status
描述是否发生防夹条防夹事件";
CM_ SG_ 697 PLGM_RearLatchSwitch_St "RealLatchPosition
描述锁以及锁扣吸合的状态";
CM_ SG_ 208 VDCM_FD1_Checksum1 "E2E Signal Group Checksum
Checksum is the actual value after calculation. See the 'ChecksumAlgorithm' sheet for the specific algorithm.
E2E信号组校验和
Checksum为计算后实际值，具体算法参见“ChecksumAlgorithm”页";
CM_ SG_ 208 VDCM_FD1_RollingCounter1 "E2E Signal Group Counter
Counter value is automatically accumulated, added from 0 to 14 and then looped to the initial value of 0. Every time a message is sent, counter adds 1.
E2E信号组计数器
Counter值为自动累加，从0加到14，然后循环至初始值0，每次报文发送，Counter加1";
CM_ SG_ 208 VDCM_VirtualPedPstn "Virtual Accelerator Pedal Position
虚拟加速踏板位置";
CM_ SG_ 208 VDCM_AccrPedPstn "Accelerator Pedal Position
加速踏板位置";
CM_ SG_ 208 VDCM_VirtualAccrPedPstn_Valid "Virtual Accelerator Pedal Position Valid
虚拟踏板位置有效标志位";
CM_ SG_ 208 VDCM_AccrPedPstn_Valid "Accelerator Pedal Position Valid
加速踏板位置有效标志位";
CM_ SG_ 208 VDCM_ActlGear "Actual gear
实际档位";
CM_ SG_ 208 VDCM_ActlGear_Valid "Actual gear valid
实际档位有效性";
CM_ SG_ 208 VDCM_DriveSwitchPosition "DriveSwitchPosition
两驱/四驱开关信号";
CM_ SG_ 208 VDCM_BrakeSw_St "Brake Switch status
制动开关状态";
CM_ SG_ 208 VDCM_BrakeFluidWarning_St "Brake fluid warning
制动液报警";
CM_ SG_ 208 VDCM_FrontBrakePadWarning_St "Front brake pad warning
前摩擦片报警";
CM_ SG_ 208 VDCM_RearBrakePadWarning_St "Rear brake pad warning
后摩擦片报警";
CM_ SG_ 208 VDCM_BrakeSwStValid "Brake switch status valid
制动开关状态有效性";
CM_ SG_ 220 VDCM_FD4_Checksum "E2E Signal Group Checksum
Checksum is the actual value after calculation. See the 'ChecksumAlgorithm' sheet for the specific algorithm.
E2E信号组校验和
Checksum为计算后实际值，具体算法参见“ChecksumAlgorithm”页";
CM_ SG_ 220 VDCM_FD4_RollingCounter "E2E Signal Group Counter
Counter value is automatically accumulated, added from 0 to 14 and then looped to the initial value of 0. Every time a message is sent, counter adds 1.
E2E信号组计数器
Counter值为自动累加，从0加到14，然后循环至初始值0，每次报文发送，Counter加1";
CM_ SG_ 220 VDCM_Ready "Ready sign (for general)
Ready信号(通用Ready信号)";
CM_ SG_ 220 VDCM_HighVoltage_St "High voltage power-on
高压上电完成状态";
CM_ SG_ 663 VDCM_BookingCharge_St "Reservation charging state
预约充电状态";
CM_ SG_ 663 VDCM_BookingChargeStopReason "Reservation charging stop reason
预约充电中止原因";
CM_ SG_ 663 VDCM_BookingChargeAvailable_St_OnlyForIV2 "Reservation charging available state
预约充电可用状态";
CM_ SG_ 663 VDCM_ExclusiveChargePileContact_St "Exclusive pile connection state
专属桩连接状态";
CM_ SG_ 663 VDCM_MaxRemainRange "Maximum driving range
最大续驶里程";
CM_ SG_ 663 VDCM_MinRemainRange "Minimum driving range
最小续驶里程";
CM_ SG_ 663 VDCM_EstimateRange "Predicted driving range
预计续驶里程";
CM_ SG_ 663 VDCM_TravelChargePileContact_St "Travel charger connection state
旅充枪连接状态";
CM_ SG_ 663 VDCM_RegenAvaible_Status "Energy recovery available status
能量回收可用状态";
CM_ SG_ 663 VDCM_CreepModeSet_Rsp_OnlyForIV2 "Creep Mode Set Response
creep设置反馈信号";
CM_ SG_ 663 VDCM_PullOver_St "Pull over alert status
靠边停车提示状态";
CM_ SG_ 663 VDCM_HighVoltageWarning_St "High voltage security alert status
高压安全风险提示状态";
CM_ SG_ 663 VDCM_HVOffConfirmRequest "Emergency switch off request
紧急开关下电请求确认";
CM_ SG_ 663 VDCM_ServiceReminder_St "Service Reminder Status
维修提示状态";
CM_ SG_ 663 VDCM_LowVoltagePowerNetFault_OnlyForIV2 "Vehicle low voltage Powernet Fault
整车低压电网故障";
CM_ SG_ 663 VDCM_LowVoltageSystemError "Low voltage system error 
低压系统故障";
CM_ SG_ 663 VDCM_CreepSetAvailable_St "Creep set available status
Creep设置可用状态";
CM_ SG_ 663 VDCM_CreepSet_Rsp "Creep set response
蠕行开关设置反馈信号";
CM_ SG_ 663 VDCM_PTSystemFault_OnlyForIV2 "Powertrain system fault
PT系统故障";
CM_ SG_ 663 VDCM_AbnormalShiftInfo "Abnormal Shift Information
异常换挡信号";
CM_ SG_ 663 VDCM_AntiTheft "Anti-theft Status
防盗状态";
CM_ SG_ 663 VDCM_LimpHomeRemind_OnlyForIV2 "Limp Home Remainder
跛行提示";
CM_ SG_ 663 VDCM_HighVItgInterlockFault "High Voltage Interlock Fault
高压互锁故障";
CM_ SG_ 663 VDCM_ChargeCon_St_OnlyForIV2 "Charging Connector Status
充电枪连接状态信号";
CM_ SG_ 663 VDCM_ThermalRunawayWarn_St "Thermal Runaway Warn Status
热失控报警状态";
CM_ SG_ 663 VDCM_PLCUFault_St "PLCU Fault Status
PLCU故障状态";
CM_ SG_ 663 VDCM_FD_6_Checksum1 "E2E Signal Group Checksum
Checksum is the actual value after calculation. See the 'ChecksumAlgorithm' sheet for the specific algorithm.
E2E信号组校验和
Checksum为计算后实际值，具体算法参见“ChecksumAlgorithm”页";
CM_ SG_ 663 VDCM_FD_6_RollingCounter1 "E2E Signal Group Counter
Counter value is automatically accumulated, added from 0 to 14 and then looped to the initial value of 0. Every time a message is sent, counter adds 1.
E2E信号组计数器
Counter值为自动累加，从0加到14，然后循环至初始值0，每次报文发送，Counter加1";
CM_ SG_ 663 VDCM_PTSystemFault "Powertrain system fault
PT系统故障";
CM_ SG_ 663 VDCM_DisplaySOC "Display SOC
仪表显示SOC";
CM_ SG_ 663 VDCM_AverageEnergyConsume "Vehicle Average energy consumption
整车平均能耗";
CM_ SG_ 663 VDCM_ChargeCon_St "Charging Connector Status
充电枪连接状态信号";
CM_ SG_ 663 VDCM_LimpHomeRemind "Limp Home Remainder
跛行提示";
CM_ SG_ 663 VDCM_InstantEnergyConsume "Vehicle Instantaneous energy consumption
整车瞬时能耗";
CM_ SG_ 663 VDCM_EGSMFault "EGSM fault
换挡器故障";
CM_ SG_ 663 VDCM_CampingModeSOC_Rsp "Camping Mode SOC Set Response
露营模式SOC设置反馈";
CM_ SG_ 663 VDCM_RegenSettingPercent_Rsp "Regen setting percent response
再生制动设置反馈";
CM_ SG_ 663 VDCM_ValetModeMaxSpeedLimit_St "Valet mode - max speed limit status
代驾模式最大车速限制状态信号";
CM_ SG_ 663 VDCM_CampingMode_Rsp "Camping Mode Response
露营模式反馈";
CM_ SG_ 663 VDCM_DischargeRemainTime "Remain charging time
预计剩余放电时间";
CM_ SG_ 663 VDCM_ACHeatLiquidCircuitLackWarn "AC thermal management circuit coolant level low warn
空调加热回路冷却液液位低报警";
CM_ SG_ 663 VDCM_PTThermalLiquidCircuitLackWarn "PT thermal management circuit coolant level low warn
PT热管理回路冷却液液位低报警";
CM_ SG_ 663 VDCM_TractionModeAvailable_St "Traction Mode Available Status
Traction Mode可用状态";
CM_ SG_ 663 VDCM_TractionModeSetting_Rsp "Traction Mode Setting Response
VDCM Traction Mode设置反馈信号";
CM_ SG_ 540 VDCM_DrivePowerPercent "Driving power percent
驱动功率百分比";
CM_ SG_ 540 VDCM_RegenPowerPercent "Electric brake power percent
电制动功率百分比";
CM_ SG_ 540 VDCM_CurrentActDrivePower "Current actual Driving electric power
当前实际驱动电功率";
CM_ SG_ 540 VDCM_CurrentLimitDrivePower "Vehicle current permitted driving power
车辆当前许用驱动功率";
CM_ SG_ 540 VDCM_CurrentActBrakePower "Current actual brake power
当前实际制动电功率";
CM_ SG_ 540 VDCM_CurrentLimitBrakePower_OnlyForIV2 "Vehicle current permitted brake power
车辆当前许用制动功率";
CM_ SG_ 540 VDCM_DriveLimpSpdLmt_Status "Speed Limit Status in Drive Limp Mode
Limp模式下速度限定状态";
CM_ SG_ 540 VDCM_DriveLimpPwrLmt_Status_OnlyForIV2 "Power Limit Status in Drive Limp Mode
Limp模式下功率限定状态";
CM_ SG_ 540 VDCM_DriveLimpCnstSpd_Status "Constant Speed Status in Drive Limp Mode
Limp末实现恒定速度状态";
CM_ SG_ 540 VDCM_DriveConflictRemindInfo "Driving conflict tips
驾驶冲突提示";
CM_ SG_ 222 VDCM_FD_12_Checksum "E2E Signal Group Checksum
Checksum is the actual value after calculation. See the 'ChecksumAlgorithm' sheet for the specific algorithm.
E2E信号组校验和
Checksum为计算后实际值，具体算法参见“ChecksumAlgorithm”页";
CM_ SG_ 222 VDCM_FD_12_RollingCounter "E2E Signal Group Counter
Counter value is automatically accumulated, added from 0 to 14 and then looped to the initial value of 0. Every time a message is sent, counter adds 1.
E2E信号组计数器
Counter值为自动累加，从0加到14，然后循环至初始值0，每次报文发送，Counter加1";
CM_ SG_ 222 VDCM_PTAvailableforADAS_St "PT Available for ADAS Function Status
动力系统是否可用状态（ADAS功能控制交互）";
CM_ SG_ 244 VDCM_VehicleMaxSpeedLimit "The Maximum Speed Limit of Vehcile
最大车速限制";
CM_ SG_ 244 VDCM_OffroadMode_St "Offroad mode status
OffRoad模式状态";
CM_ SG_ 244 VDCM_SWSDisable_St "SWS Disable Status
驾驶模式调节不可用";
CM_ SG_ 244 VDCM_DMSVehicleModeInfo "Vehicle current drive mode
整车当前驾驶模式";
CM_ SG_ 244 VDCM_DMSModeChangeEnable "Drive mode available
驾驶模式接口可用";
CM_ SG_ 244 VDCM_DMSPTModeInfo "PT current mode (for display)
仪表显示-PT当前模式";
CM_ SG_ 244 VDCM_FaultLevel "System fault level
系统故障等级";
CM_ SG_ 244 VDCM_AirSOffRoadExitCommand "Indicate that AirS quites Off Road due to speed reason and command VDCM quite Off road .
空气悬架由于速度原因退出off Road并且要求VDCM改变驾驶模式.";
CM_ SG_ 244 VDCM_AirSOffRoadAvaliability "indicate to VDCM that off road available or not due to speed reason 
由于速度原因不可切换至off road标志位";
CM_ SG_ 244 VDCM_ProtocolVersion "VDCM Protocol Version
VDCM协议版本";
CM_ SG_ 244 VDCM_PowernetLowVoltageFault "Vehicle low voltage Powernet Fault
整车低压电网故障";
CM_ SG_ 244 VDCM_PowernetWarning_St "State of Charge Pownet Warning for HMI
当前电网状态报警";
CM_ SG_ 232 BMS_Current "Battery current
电池电流";
CM_ SG_ 232 BMS_BatteryVoltage "Battery voltage
电池内侧电压";
CM_ SG_ 232 BMS_HVBusVoltage "High voltage bus voltage
电池外侧电压";
CM_ SG_ 232 BMS_FastChargeConnector_St "Fast charging connector state
快充接头插接状态";
CM_ SG_ 232 BMS_DCCharge_St "DC charging state
直流充电状态";
CM_ SG_ 232 BMS_ACCharge_St "AC charging state
交流充电状态";
CM_ SG_ 232 BMS_V2L_Req "V2L request
V2L请求";
CM_ SG_ 232 BMS_CC2_St_OnlyForIV2 "Fast charging connector state
快充接头插接状态";
CM_ SG_ 232 BMS_UnderTemp_Err "Battery under temperature fault
电池低温故障(放电低于-30，充电低于-20)";
CM_ SG_ 232 BMS_ChargerPowerSupplyMode_St "Charging pile supplying power mode state
桩供电模式状态";
CM_ SG_ 232 OBC_ACVltg "OBC AC voltage
OBC交流侧电压";
CM_ SG_ 232 OBC_ACCurrent "OBC AC current
OBC交流侧电流";
CM_ SG_ 232 BMS_ProtocolVersion "BMS Protocol Version
BMS协议版本";
CM_ SG_ 232 VDCM_FD_RT_4_BMS_Available_St "If signals which route from BMS in message VDCM_FD_RT_4 are available
报文VDCM_FD_RT_4中路由的BMS节点的信号是否可信";
CM_ SG_ 232 VDCM_FD_RT_4_IPEU_Available_St "If signals which route from IPEU in message VDCM_FD_RT_4 are available
报文VDCM_FD_RT_4中路由的IPEU节点的信号是否可信";
CM_ SG_ 232 VDCM_FD_RT_4_Checksum1 "E2E Signal Group Checksum
Checksum is the actual value after calculation. See the 'ChecksumAlgorithm' sheet for the specific algorithm.
E2E信号组校验和
Checksum为计算后实际值，具体算法参见“ChecksumAlgorithm”页";
CM_ SG_ 232 VDCM_FD_RT_4_RollingCounter1 "E2E Signal Group Counter
Counter value is automatically accumulated, added from 0 to 14 and then looped to the initial value of 0. Every time a message is sent, counter adds 1.
E2E信号组计数器
Counter值为自动累加，从0加到14，然后循环至初始值0，每次报文发送，Counter加1";
CM_ SG_ 232 VDCM_FD_RT_4_ADCM_Available_St "If signals which route from ADCM in message VDCM_FD_RT_4 are available
报文VDCM_FD_RT_4中路由的ADCM节点的信号是否可信";
CM_ SG_ 232 ADCM_BU_Pilot_Warn_St "Pilot warning status
Pilot功能报警状态";
CM_ SG_ 648 VDCM_FD_RT_5_Checksum "E2E Signal Group Checksum
Checksum is the actual value after calculation. See the 'ChecksumAlgorithm' sheet for the specific algorithm.
E2E信号组校验和
Checksum为计算后实际值，具体算法参见“ChecksumAlgorithm”页";
CM_ SG_ 648 VDCM_FD_RT_5_RollingCounter "E2E Signal Group Counter
Counter value is automatically accumulated, added from 0 to 14 and then looped to the initial value of 0. Every time a message is sent, counter adds 1.
E2E信号组计数器
Counter值为自动累加，从0加到14，然后循环至初始值0，每次报文发送，Counter加1";
CM_ SG_ 648 BMS_RemainChargeTime "Remain charging time
剩余充电时间";
CM_ SG_ 648 ACM_InvehicleTemp "Invehicle temperature
车内温度";
CM_ SG_ 648 ACM_EnvironmentTemp "Environment temperature
环境温度";
CM_ SG_ 648 BMS_SOCReal "Real SOC
电池实际SOC";
CM_ SG_ 648 BMS_SOCDisplay "Displayed SOC
电池显示SOC";
CM_ SG_ 648 OBC_DischargeRatedPower "Discharger rated power
放电枪额定功率";
CM_ SG_ 648 OBC_CurrentACDischargedPower "Current AC Discharged Power
当前交流已放电量";
CM_ SG_ 648 VDCM_FD_RT_5_BMS_Available_St "If signals which route from BMS in message VDCM_FD_RT_5 are available
报文VDCM_FD_RT_5中路由的BMS节点的信号是否可信";
CM_ SG_ 648 VDCM_FD_RT_5_ACM_Available_St "If signals which route from ACM in message VDCM_FD_RT_5 are available
报文VDCM_FD_RT_5中路由的ACM节点的信号是否可信";
CM_ SG_ 648 VDCM_FD_RT_5_IPEU_Available_St "If signals which route from IPEU in message VDCM_FD_RT_5 are available
报文VDCM_FD_RT_5中路由的IPEU节点的信号是否可信";
CM_ SG_ 648 OBC_ACDischarge_St "OBC AC discharge state
OBC交流放电状态";
CM_ SG_ 648 OBC_ACChargerConnect_St "AC charger connection state
交流充电枪连接状态";
CM_ SG_ 648 OBC_ACChargerConnectSt_Valid "Status of AC charger connection state
交流充电枪连接状态有效标志位";
CM_ SG_ 648 BMS_ACDischarge_St "Vehicle AC discharging state
车辆交流放电状态";
CM_ SG_ 648 OBC_ACChargerMode "AC charger type
交流充电枪的类别";
CM_ SG_ 648 BMS_VehicleDischargeAbortReason "Vehicle AC discharging stop reason
车辆交流放电停止原因";
CM_ SG_ 648 OBC_DischargeAbortReason "OBC discharge stop reason
OBC放电停止原因";
CM_ SG_ 648 OBC_ACSocketLock_St "AC charging stand electronic lock state
交流充电座电子锁状态";
CM_ SG_ 648 BMS_FaultLevel "System fault Level
电池系统故障等级";
CM_ SG_ 648 BMS_Isolation_Err "Insulation fault
绝缘故障";
CM_ SG_ 648 BMS_CellOverVoltage "Cell over voltage
单体过压";
CM_ SG_ 648 BMS_CellUnderVoltage "Cell under voltage
单体欠压";
CM_ SG_ 648 IPEU_DischargerConnectSt "Discharger connection state
放电枪连接状态";
CM_ SG_ 648 IPEU_DischargerConnectSt_Valid "Status of Discharger connection state
放电枪连接状态有效标志位";
CM_ SG_ 648 BMS_CellOverTemp "Cell over temperature
温度过高";
CM_ SG_ 648 DCDC_ErrorLevel "DCDC fault level
DCDC故障等级";
CM_ SG_ 648 BMS_SOCLow "SOC low warn
SOC过低报警";
CM_ SG_ 648 BMS_SOCHigh "SOC high warn
SOC过高报警";
CM_ SG_ 648 IPEU_OverTemp "IPEU over temperature warn
IPEU过温报警";
CM_ SG_ 648 EBS_F_U_BATT "Front Battery voltage
主电池电压";
CM_ SG_ 648 EBS_F_St_Vltg "Front Battery Voltage Status
主电池电压状态";
CM_ SG_ 648 VDCM_VehicleTotalMileageBackup "车辆行驶总里程备份";
CM_ SG_ 653 ACM_FragSwitchEN_Rsp "Fragrance switch enable responce
香氛开关使能请求反馈";
CM_ SG_ 653 ACM_FragChannel1Switch_St "Channel 1 Switch state
1通道切换状态";
CM_ SG_ 653 ACM_FragChannel2Switch_St "Channel 2 Switch state
2通道切换状态";
CM_ SG_ 653 ACM_FragChannel3Switch_St "Channel 3 Switch state
3通道切换状态";
CM_ SG_ 653 ACM_FragConcLevel_Rsp "Density response level
浓度响应等级";
CM_ SG_ 653 ACM_FrontACMode_St "Front AC mode state
前空调模式状态";
CM_ SG_ 653 ACM_InOutLoopMode_St "Internal and external circulation state
内外循环状态";
CM_ SG_ 653 ACM_DriveTempSet_St "Drive temperature state
主驾温度状态";
CM_ SG_ 653 ACM_TempAreaSync_St "Temperature area synchronization state response
温区同步状态反馈";
CM_ SG_ 653 ACM_PassengerTempSet_St "Passenger temperature state
副驾温度状态";
CM_ SG_ 653 ACM_ACOperateMode_St "AC operation mode state
空调运行模式状态";
CM_ SG_ 653 ACM_FrontACAirFlowLevel_St "Front AC air flow state
前空调风量状态";
CM_ SG_ 653 ACM_RearACAirFlowLevel_St "Rear AC air flow state
后空调风量状态";
CM_ SG_ 653 ACM_RearRowTempSet_St "Rear AC temperature display state
后空调温度显示状态";
CM_ SG_ 653 ACM_AutoDefrostSet_St "Auto defrost state
自动除雾状态";
CM_ SG_ 653 ACM_RearACMode_St "Rear AC mode state
后空调模式状态";
CM_ SG_ 653 ACM_IONSet_St "ION state
ION状态";
CM_ SG_ 653 ACM_ConsumeMileagePredict "AC Consume Mileage Predict
空调消耗的公里数预测";
CM_ SG_ 653 ACM_ConsumeDriveTimePredict "AC Consume Drive Time Predict
空调消耗的行车时间预测";
CM_ SG_ 653 ACM_AQSAirQuality_St "Environment air quality state
车外空气质量状态";
CM_ SG_ 653 ACM_PM25Set_St "PM2.5 switch state
PM2.5开关状态";
CM_ SG_ 653 ACM_PM25CarConc "Invehicle PM2.5 density
车内PM2.5浓度";
CM_ SG_ 653 ACM_AQSSet_St "AQS state response
AQS状态反馈";
CM_ SG_ 653 ACM_HepaActive "Hepa active signal
Hepa激活信号";
CM_ SG_ 653 ACM_ACSt_St "AC state
A/C状态";
CM_ SG_ 653 ACM_FragChannel1Life "Fragrance remaining life of channel 1
1通道香氛剩余寿命";
CM_ SG_ 653 ACM_FragChannel2Life "Fragrance remaining life of channel 2
2通道香氛剩余寿命";
CM_ SG_ 653 ACM_FragChannel3Life "Fragrance remaining life of channel 3
3通道香氛剩余寿命";
CM_ SG_ 653 ACM_FragChannel1Type "Fragrance type of channel 1
1通道香氛种类信息";
CM_ SG_ 653 ACM_FragChannel2Type "Fragrance type of channel 2
2通道香氛种类信息";
CM_ SG_ 653 ACM_FragChannel3Type "Fragrance type of channel 3
3通道香氛种类信息";
CM_ SG_ 653 ACM_InFilterLifeRemind "Filter remaining life remind in the vehicle
车内滤芯寿命提醒";
CM_ SG_ 653 ACM_OutsideFilterLifeRemind "Filter remaining life remind out the vehicle
车外滤芯寿命提醒";
CM_ SG_ 653 ACM_FrontACSwitch_Rsp "Front AC switch response
前空调开关反馈";
CM_ SG_ 653 ACM_RearACSwitch_Rsp "Rear AC switch response
后空调开关反馈";
CM_ SG_ 653 ACM_FrontACAuto_Rsp "Front AC auto response
前空调Auto反馈";
CM_ SG_ 653 ACM_RearACAuto_Rsp "Rear AC auto response
后空调Auto反馈";
CM_ SG_ 653 ACM_FrontDeiceDefrost_Rsp "Front deice and defrost response
前除霜除雾反馈";
CM_ SG_ 653 VDCM_FD_RT_6_ACM_Available_St "If signals which route from ACM in message VDCM_FD_RT_6 are available
报文VDCM_FD_RT_6中路由的ACM节点的信号是否可信";
CM_ SG_ 938 VDCM_FD_RT_9_BMS_Available_St "If signals which route from BMS in message VDCM_FD_RT_9 are available
报文VDCM_FD_RT_9中路由的BMS节点的信号是否可信";
CM_ SG_ 938 BMS_SOE "SOC available energy
电池可用能量（SOE）";
CM_ SG_ 527 VDCM_FD_RT_11_Checksum "E2E Signal Group Checksum
Checksum is the actual value after calculation. See the 'ChecksumAlgorithm' sheet for the specific algorithm.
E2E信号组校验和
Checksum为计算后实际值，具体算法参见“ChecksumAlgorithm”页";
CM_ SG_ 527 VDCM_FD_RT_11_RollingCounter "E2E Signal Group Counter
Counter value is automatically accumulated, added from 0 to 14 and then looped to the initial value of 0. Every time a message is sent, counter adds 1.
E2E信号组计数器
Counter值为自动累加，从0加到14，然后循环至初始值0，每次报文发送，Counter加1";
CM_ SG_ 527 IFV300_Pilot_Warning_St "Pilot warning status
Pilot功能报警状态";
CM_ SG_ 527 IFV300_CameraBlocked "IFV300 Camera Blocked Status
IFV300摄像头遮挡状态";
CM_ SG_ 527 IFV300_CameraCalibratinSts "IFV300 Camera Calibration Status
IFV300摄像头标定状态";
CM_ SG_ 527 IFV300_CamreaFailureSts "IFV300 Camera Failure Status
IFV300摄像头故障状态";
CM_ SG_ 527 VDCM_FD_RT_11_IFV300_Available_St "If signals which route from IFV300 in message VDCM_FD_RT_11 are available
报文VDCM_FD_RT_11中路由的IFV300节点的信号是否可信";
CM_ SG_ 224 MCUF_FD1_Checksum1 "E2E Signal Group Checksum
Checksum is the actual value after calculation. See the 'ChecksumAlgorithm' sheet for the specific algorithm.
E2E信号组校验和
Checksum为计算后实际值，具体算法参见“ChecksumAlgorithm”页";
CM_ SG_ 224 MCUF_FD1_RollingCounter1 "E2E Signal Group Counter
Counter value is automatically accumulated, added from 0 to 14 and then looped to the initial value of 0. Every time a message is sent, counter adds 1.
E2E信号组计数器
Counter值为自动累加，从0加到14，然后循环至初始值0，每次报文发送，Counter加1";
CM_ SG_ 224 MCUF_ActOutputTq "EDS current output torque(include positive and negtive signs)
电机当前输出扭矩(包括正负号)";
CM_ SG_ 224 MCUF_FD1_Checksum2 "E2E Signal Group Checksum
Checksum is the actual value after calculation. See the 'ChecksumAlgorithm' sheet for the specific algorithm.
E2E信号组校验和
Checksum为计算后实际值，具体算法参见“ChecksumAlgorithm”页";
CM_ SG_ 224 MCUF_FD1_RollingCounter2 "E2E Signal Group Counter
Counter value is automatically accumulated, added from 0 to 14 and then looped to the initial value of 0. Every time a message is sent, counter adds 1.
E2E信号组计数器
Counter值为自动累加，从0加到14，然后循环至初始值0，每次报文发送，Counter加1";
CM_ SG_ 224 MCUF_Speed "Motor speed
电机转速";
CM_ SG_ 224 MCUF_ErrSt "MCUF fault level
MCUF故障等级";
CM_ SG_ 224 MCUF_InverterOverTemp "Inverter over temperature warining 
逆变器过温报警";
CM_ SG_ 224 MCUF_MotorOverTemp "Motor over temperature warning
电机过温报警";
CM_ SG_ 224 MCUF_FD1_Checksum3 "E2E Signal Group Checksum
Checksum is the actual value after calculation. See the 'ChecksumAlgorithm' sheet for the specific algorithm.
E2E信号组校验和
Checksum为计算后实际值，具体算法参见“ChecksumAlgorithm”页";
CM_ SG_ 224 MCUF_FD1_RollingCounter3 "E2E Signal Group Counter
Counter value is automatically accumulated, added from 0 to 14 and then looped to the initial value of 0. Every time a message is sent, counter adds 1.
E2E信号组计数器
Counter值为自动累加，从0加到14，然后循环至初始值0，每次报文发送，Counter加1";
CM_ SG_ 224 MCUF_CurrentHV "DC bus end current calculation value
直流母线端电流计算值";
CM_ SG_ 224 MCUF_VltgHV "DC bus end voltage value
直流母线端的电压值";
CM_ SG_ 658 MCUF_ElectricMachineTemp "Stator temperature
定子温度";
CM_ SG_ 658 MCUF_InverterTemp "Inverter temperature
逆变器温度";
CM_ SG_ 658 MCUF_TractionModeSetting_Rsp "Traction Mode Setting Response
MCUF Traction Mode设置反馈信号";
CM_ SG_ 225 MCUR_FD1_Checksum1 "E2E Signal Group Checksum
Checksum is the actual value after calculation. See the 'ChecksumAlgorithm' sheet for the specific algorithm.
E2E信号组校验和
Checksum为计算后实际值，具体算法参见“ChecksumAlgorithm”页";
CM_ SG_ 225 MCUR_FD1_RollingCounter1 "E2E Signal Group Counter
Counter value is automatically accumulated, added from 0 to 14 and then looped to the initial value of 0. Every time a message is sent, counter adds 1.
E2E信号组计数器
Counter值为自动累加，从0加到14，然后循环至初始值0，每次报文发送，Counter加1";
CM_ SG_ 225 MCUR_ActOutputTq "EDS current output torque(include positive and negtive signs)
电机当前输出扭矩(包括正负号)";
CM_ SG_ 225 MCUR_FD1_Checksum2 "E2E Signal Group Checksum
Checksum is the actual value after calculation. See the 'ChecksumAlgorithm' sheet for the specific algorithm.
E2E信号组校验和
Checksum为计算后实际值，具体算法参见“ChecksumAlgorithm”页";
CM_ SG_ 225 MCUR_FD1_RollingCounter2 "E2E Signal Group Counter
Counter value is automatically accumulated, added from 0 to 14 and then looped to the initial value of 0. Every time a message is sent, counter adds 1.
E2E信号组计数器
Counter值为自动累加，从0加到14，然后循环至初始值0，每次报文发送，Counter加1";
CM_ SG_ 225 MCUR_Speed "Motor speed
电机转速";
CM_ SG_ 225 MCUR_ErrSt "MCUR fault level
MCUR故障等级";
CM_ SG_ 225 MCUR_InverterOverTemp "Inverter over temperature warining 
逆变器过温报警";
CM_ SG_ 225 MCUR_MotorOverTemp "Motor over temperature warning
电机过温报警";
CM_ SG_ 225 MCUR_FD1_Checksum3 "E2E Signal Group Checksum
Checksum is the actual value after calculation. See the 'ChecksumAlgorithm' sheet for the specific algorithm.
E2E信号组校验和
Checksum为计算后实际值，具体算法参见“ChecksumAlgorithm”页";
CM_ SG_ 225 MCUR_FD1_RollingCounter3 "E2E Signal Group Counter
Counter value is automatically accumulated, added from 0 to 14 and then looped to the initial value of 0. Every time a message is sent, counter adds 1.
E2E信号组计数器
Counter值为自动累加，从0加到14，然后循环至初始值0，每次报文发送，Counter加1";
CM_ SG_ 225 MCUR_CurrentHV "DC bus end current calculation value
直流母线端电流计算值";
CM_ SG_ 225 MCUR_VltgHV "DC bus end voltage value
直流母线端的电压值";
CM_ SG_ 659 MCUR_ElectricMachineTemp "Stator temperature
定子温度";
CM_ SG_ 659 MCUR_InverterTemp "Inverter temperature
逆变器温度";
CM_ SG_ 659 MCUR_TractionModeSetting_Rsp "Traction Mode Setting Response
MCUR Traction Mode设置反馈信号";
CM_ SG_ 880 TBOX_AbsoluteTime_Year "AbsoluteTime - Year
绝对时间 - 年";
CM_ SG_ 880 TBOX_AbsoluteTime_Month "AbsoluteTime - Month
绝对时间 - 月";
CM_ SG_ 880 TBOX_AbsoluteTime_Day "AbsoluteTime - Day
绝对时间 - 日";
CM_ SG_ 880 TBOX_AbsoluteTime_Hour "AbsoluteTime - Hour
绝对时间 - 时";
CM_ SG_ 880 TBOX_AbsoluteTime_Minute "AbsoluteTime - Minute
绝对时间 - 分";
CM_ SG_ 880 TBOX_AbsoluteTime_Second "AbsoluteTime_Second
绝对时间 - 秒";
CM_ SG_ 378 TBOX_FD_2_Checksum1 "E2E Signal Group Checksum
Checksum is the actual value after calculation. See the 'ChecksumAlgorithm' sheet for the specific algorithm.
E2E信号组校验和
Checksum为计算后实际值，具体算法参见“ChecksumAlgorithm”页";
CM_ SG_ 378 TBOX_FD_2_RollingCounter1 "E2E Signal Group Counter
Counter value is automatically accumulated, added from 0 to 14 and then looped to the initial value of 0. Every time a message is sent, counter adds 1.
E2E信号组计数器
Counter值为自动累加，从0加到14，然后循环至初始值0，每次报文发送，Counter加1";
CM_ SG_ 378 TBOX_ChargeReservationSource "Charging Reservation source
充电预约场景源";
CM_ SG_ 378 TBOX_ReservationChargeActive "Reservation Charging Active
预约充电激活状态";
CM_ SG_ 378 TBOX_ReservationChargeEnable "Reservation Charging Enable
预约充电到时状态";
CM_ SG_ 378 TBOX_ReservationChargeTimeHour "Reservation Charge Start Time-Hour
车辆预约充电起始时间小时";
CM_ SG_ 378 TBOX_ReservationChargeTimeMinute "Reservation Charge Start Time-Minute
车辆预约充电起始时间分钟";
CM_ SG_ 378 TBOX_ReservationChargeDurationSet "Reservation Charge Duration Set
车辆预约充电时长";
CM_ SG_ 378 TBOX_ReservationChargCutoffSOCSet "Reservation Charge Cut-off SOC Set
车辆预约充电截止SOC";
CM_ SG_ 378 TBOX_ReservationChargeStopHour "Reservation Charge Stop Time-Hour
车辆预约充电停止时间 - 小时";
CM_ SG_ 378 TBOX_ReservationChargeStopMinute "Reservation Charge Stop Time-Minute
车辆预约充电停止时间分钟";
CM_ SG_ 761 TBOX_FD_5_Checksum1 "E2E Signal Group Checksum
Checksum is the actual value after calculation. See the 'ChecksumAlgorithm' sheet for the specific algorithm.
E2E信号组校验和
Checksum为计算后实际值，具体算法参见“ChecksumAlgorithm”页";
CM_ SG_ 761 TBOX_FD_5_RollingCounter1 "E2E Signal Group Counter
Counter value is automatically accumulated, added from 0 to 14 and then looped to the initial value of 0. Every time a message is sent, counter adds 1.
E2E信号组计数器
Counter值为自动累加，从0加到14，然后循环至初始值0，每次报文发送，Counter加1";
CM_ SG_ 761 TBOX_BluetoothKey1Availability "Bluetooth Virtual Key1 Availability
蓝牙虚拟钥匙-key1_有效性";
CM_ SG_ 761 TBOX_BluetoothKey1ZoneID "Bluetooth Virtual Key1 Zone ID
蓝牙虚拟钥匙-key1_ZoneID";
CM_ SG_ 761 TBOX_BluetoothKey2ZoneID "Bluetooth Virtual Key2 Zone ID
蓝牙虚拟钥匙-key2_ZoneID";
CM_ SG_ 761 TBOX_VehicleTotalMileageBackup "TBOX Back Up Vehicle Total Mileage
TBOX行驶总里程备份（信号初始值为上次值）";
CM_ SG_ 761 TBOX_ECall_St "Ecall Status
Ecall状态";
CM_ SG_ 761 TBOX_BLEConnected_St "BLE Connected Status
BLE连接状态：Tbox的BLE和车主手机连接后，Tbox发送相应消息给VSP,VSP可以进行提前启动";
CM_ SG_ 761 TBOX_BCall_St "Bcall Status
Bcall状态";
CM_ SG_ 761 TBOX_GuardWakeup "Guard Wakeup
安全管家唤醒信号";
CM_ SG_ 761 TBOX_AbnormalMoveWakeup "Abnormal Move Wakeup
车辆异常移动唤醒信号";
CM_ SG_ 761 TBOX_ScratchWakeup "Scratch Wakeup
车辆剐蹭唤醒信号";
CM_ SG_ 761 TBOX_SVTWakeup "SVT Wakeup
车辆被盗追踪信号";
CM_ SG_ 761 TBOX_CrashWakeup "Crash Wakeup
车辆碰撞唤醒信号";
CM_ SG_ 762 TBOX_FD_7_Checksum1 "E2E Signal Group Checksum
Checksum is the actual value after calculation. See the 'ChecksumAlgorithm' sheet for the specific algorithm.
E2E信号组校验和
Checksum为计算后实际值，具体算法参见“ChecksumAlgorithm”页";
CM_ SG_ 762 TBOX_FD_7_RollingCounter1 "E2E Signal Group Counter
Counter value is automatically accumulated, added from 0 to 14 and then looped to the initial value of 0. Every time a message is sent, counter adds 1.
E2E信号组计数器
Counter值为自动累加，从0加到14，然后循环至初始值0，每次报文发送，Counter加1";
CM_ SG_ 762 TBOX_V2XFrontCollisionWarn_St "V2X Front Collision Warn Status
V2X-前向碰撞预警－状态";
CM_ SG_ 762 TBOX_V2XFrontCollisionWarn_Direction "V2X Front Collision Warn Direction
V2X-前向碰撞预警－方位";
CM_ SG_ 762 TBOX_V2XFrontCollisionWarn_AlarmLevel "V2X Front Collision Warn Alarm Level
V2X-前向碰撞预警－告警等级";
CM_ SG_ 762 TBOX_V2XFrontCollisionWarn_Distance "V2X Front Collision Warn Distance
V2X-前向碰撞预警－距离";
CM_ SG_ 762 TBOX_V2XIntersectionCollisionWarn_St "V2X Intersection Collision Warn Status
V2X-交叉路口碰撞预警－状态";
CM_ SG_ 762 TBOX_V2XIntersectionCollisionWarn_Direction "V2X Intersection Collision Warn Direction
V2X-交叉路口碰撞预警－方位";
CM_ SG_ 762 TBOX_V2XIntersectionCollisionWarn_AlarmLevel "V2X Intersection Collision Warn Alarm Level
V2X-交叉路口碰撞预警－告警等级";
CM_ SG_ 762 TBOX_V2XIntersectionCollisionWarn_Distance "V2X Intersection Collision Warn Distance
V2X-交叉路口碰撞预警－距离";
CM_ SG_ 762 TBOX_FD_7_Checksum2 "E2E Signal Group Checksum
Checksum is the actual value after calculation. See the 'ChecksumAlgorithm' sheet for the specific algorithm.
E2E信号组校验和
Checksum为计算后实际值，具体算法参见“ChecksumAlgorithm”页";
CM_ SG_ 762 TBOX_FD_7_RollingCounter2 "E2E Signal Group Counter
Counter value is automatically accumulated, added from 0 to 14 and then looped to the initial value of 0. Every time a message is sent, counter adds 1.
E2E信号组计数器
Counter值为自动累加，从0加到14，然后循环至初始值0，每次报文发送，Counter加1";
CM_ SG_ 762 TBOX_V2XTurnLeftAssist_Distance "V2X Turn Left Assist Distance
V2X-左转辅助－距离";
CM_ SG_ 762 TBOX_V2XTurnLeftAssist_St "V2X Turn Left Assist Status
V2X-左转辅助－状态";
CM_ SG_ 762 TBOX_V2XTurnLeftAssist_AlarmLevel "V2X Turn Left Assist Alarm Level
V2X-左转辅助－告警等级";
CM_ SG_ 762 TBOX_V2XReverseOvertakeWarn_Distance "V2X Reverse Overtake Warn Distance
V2X-逆向超车预警－距离";
CM_ SG_ 762 TBOX_V2XReverseOvertakeWarn_St "V2X Reverse Overtake Warn Status
V2X-逆向超车预警－状态";
CM_ SG_ 762 TBOX_V2XReverseOvertakeWarn_AlarmLevel "V2X Reverse Overtake Warn Alarm Level
V2X-逆向超车预警－告警等级";
CM_ SG_ 762 TBOX_FD_7_Checksum3 "E2E Signal Group Checksum
Checksum is the actual value after calculation. See the 'ChecksumAlgorithm' sheet for the specific algorithm.
E2E信号组校验和
Checksum为计算后实际值，具体算法参见“ChecksumAlgorithm”页";
CM_ SG_ 762 TBOX_FD_7_RollingCounter3 "E2E Signal Group Counter
Counter value is automatically accumulated, added from 0 to 14 and then looped to the initial value of 0. Every time a message is sent, counter adds 1.
E2E信号组计数器
Counter值为自动累加，从0加到14，然后循环至初始值0，每次报文发送，Counter加1";
CM_ SG_ 762 TBOX_V2XEmergencyBrakeWarn_St "V2X Emergency Brake Warn Status
V2X-紧急制动预警－状态";
CM_ SG_ 762 TBOX_V2XEmergencyBrakeWarn_Direction "V2X Emergency Brake Warn Direction
V2X-紧急制动预警－方位";
CM_ SG_ 762 TBOX_V2XEmergencyBrakeWarn_AlarmLevel "V2X Emergency Brake Warn Alarm Level
V2X-紧急制动预警－告警等级";
CM_ SG_ 762 TBOX_V2XEmergencyBrakeWarn_Distance "V2X Emergency Brake Warn Distance
V2X-紧急制动预警－距离";
CM_ SG_ 762 TBOX_V2XAbnormalVehicleWarn_Distance "V2X Abnormal Vehicle Warn Distance
V2X-异常车辆提醒－距离";
CM_ SG_ 762 TBOX_V2XAbnormalVehicleWarn_St "V2X Abnormal Vehicle Warn Status
V2X-异常车辆提醒－状态";
CM_ SG_ 762 TBOX_V2XAbnormalVehicleWarn_AlarmLevel "V2X Abnormal Vehicle Warn Alarm Level
V2X-异常车辆提醒－告警等级";
CM_ SG_ 762 TBOX_V2XAbnormalVehicleWarn_Angle "V2X Abnormal Vehicle Warn Angle
V2X-异常车辆提醒－角度";

BA_DEF_ BO_  "NmMessage" ENUM "No","Yes";
BA_DEF_ BO_  "GenMsgSendType" ENUM  "cyclic","Event","IfActive","CE","CA","NoMsgSendType";
BA_DEF_ BO_  "GenMsgCycleTime" INT 0 0;
BA_DEF_ SG_  "GenSigSendType" ENUM  "cyclic","OnChange","OnWrite","IfActive","OnChangeWithRepetition","OnWriteWithRepetition","IfActiveWithRepetition","NoSigSendType","OnChangeAndIfActive","OnChangeAndIfActiveWithRepetition","CA","CE","Event";
BA_DEF_ SG_  "GenSigStartValue" INT 0 0;
BA_DEF_ BO_  "GenMsgCycleTimeFast" INT 0 0;
BA_DEF_ BO_  "GenMsgNrOfRepetition" INT 0 0;
BA_DEF_ BO_  "CANFD_BRS" ENUM  "0","1";
BA_DEF_ BO_  "VFrameFormat" ENUM  "StandardCAN","ExtendedCAN","reserved","reserved","reserved","reserved","reserved","reserved","reserved","reserved","reserved","reserved","reserved","reserved","StandardCAN_FD","ExtendedCAN_FD";
BA_DEF_ BO_  "GenMsgILSupport" ENUM  "No","Yes";
BA_DEF_DEF_  "NmMessage" "No";
BA_DEF_DEF_  "GenMsgSendType" "cyclic";
BA_DEF_DEF_  "GenMsgCycleTime" 0;
BA_DEF_DEF_  "GenSigSendType" "cyclic";
BA_DEF_DEF_  "GenSigStartValue" 0;
BA_DEF_DEF_  "GenMsgCycleTimeFast" 0;
BA_DEF_DEF_  "GenMsgNrOfRepetition" 0;
BA_DEF_DEF_  "CANFD_BRS" "1";
BA_DEF_DEF_  "VFrameFormat" "StandardCAN_FD";
BA_DEF_DEF_  "GenMsgILSupport" "Yes";
BA_ "GenMsgCycleTime" BO_ 744 100;
BA_ "GenSigStartValue" SG_ 744 AVAS_ENSt_Rsp 1;
BA_ "GenSigStartValue" SG_ 744 DLP_ProtocolVersion 1;
BA_ "GenSigStartValue" SG_ 744 BDCM_FD_RT_2_AVAS_Available_St 1;
BA_ "GenSigStartValue" SG_ 744 BDCM_FD_RT_2_DLP_Available_St 1;
BA_ "GenMsgCycleTime" BO_ 555 50;
BA_ "GenSigStartValue" SG_ 555 SCMFL_FrontBackAdjMotorPosition_St 255;
BA_ "GenSigStartValue" SG_ 555 SCMFL_HeightAdjMotorPosition_St 255;
BA_ "GenSigStartValue" SG_ 555 SCMFL_CushionAngleAdjMotorPosition_St 255;
BA_ "GenSigStartValue" SG_ 555 SCMFL_BackCushionAdjMotorPosition_St 255;
BA_ "GenSigStartValue" SG_ 555 SCMFR_FrontBackAdjMotorPosition_St 255;
BA_ "GenSigStartValue" SG_ 555 SCMFR_HeightAdjMotorPosition_St 255;
BA_ "GenSigStartValue" SG_ 555 SCMFR_SeatLegSupportAdjMotorPosition_St 255;
BA_ "GenSigStartValue" SG_ 555 SCMFR_BackCushionAdjMotorPosition_St 255;
BA_ "GenSigStartValue" SG_ 555 SCMSRL_FrontBackAdjMotorPosition_St 255;
BA_ "GenSigStartValue" SG_ 555 SCMSRL_BackCushionAdjMotorPosition_St 255;
BA_ "GenSigStartValue" SG_ 555 SCMSRL_LateralAdjustMotorPosition_St 255;
BA_ "GenSigStartValue" SG_ 555 SCMSRL_LegSupportAdjMotorPosition_St 255;
BA_ "GenSigStartValue" SG_ 555 SCMSRR_FrontBackAdjMotorPosition_St 255;
BA_ "GenSigStartValue" SG_ 555 SCMSRR_BackCushionAdjMotorPosition_St 255;
BA_ "GenSigStartValue" SG_ 555 SCMSRR_LateralAdjustMotorPosition_St 255;
BA_ "GenSigStartValue" SG_ 555 SCMSRR_LegSupportAdjMotorPosition_St 255;
BA_ "GenMsgSendType" BO_ 745 3;
BA_ "GenMsgCycleTime" BO_ 745 100;
BA_ "GenMsgCycleTimeFast" BO_ 745 20;
BA_ "GenMsgNrOfRepetition" BO_ 745 3;
BA_ "GenSigStartValue" SG_ 745 SCMFL_HeatTemp_Rsp 255;
BA_ "GenMsgCycleTime" BO_ 746 100;
BA_ "GenSigStartValue" SG_ 746 BDCM_FD_12_RollingCounter 15;
BA_ "GenSigStartValue" SG_ 746 SCMFR_HeatTemp_Rsp 255;
BA_ "GenMsgCycleTime" BO_ 747 100;
BA_ "GenSigStartValue" SG_ 747 BDCM_FD_13_RollingCounter 15;
BA_ "GenSigStartValue" SG_ 747 SCMSRL_HeatTemp_Rsp 255;
BA_ "GenMsgCycleTime" BO_ 748 100;
BA_ "GenSigStartValue" SG_ 748 BDCM_FD_14_RollingCounter 15;
BA_ "GenSigStartValue" SG_ 748 SCMSRR_HeatTemp_Rsp 255;
BA_ "GenMsgCycleTime" BO_ 310 10;
BA_ "GenSigStartValue" SG_ 310 CSM_SAS_SteeringWheelAngle 65535;
BA_ "GenSigStartValue" SG_ 310 CSM_SAS_SteeringWheelSpeed 255;
BA_ "GenSigStartValue" SG_ 310 BDCM_FD_RT_8_CSM_Available_St 1;
BA_ "GenMsgCycleTime" BO_ 700 100;
BA_ "GenSigStartValue" SG_ 700 OLM_FLAirOutletFanLeftRightAngle_Rsp 255;
BA_ "GenSigStartValue" SG_ 700 OLM_FLAirOutletFanUpDownAngle_Rsp 63;
BA_ "GenSigStartValue" SG_ 700 OLM_LCAirOutletFanUpDownAngle_Rsp 63;
BA_ "GenSigStartValue" SG_ 700 OLM_LCAirOutletFanLeftRightAngle_Rsp 255;
BA_ "GenSigStartValue" SG_ 700 OLM_PanelAirOutletFanLeftRightAngle_Rsp 255;
BA_ "GenSigStartValue" SG_ 700 OLM_PanelAirOutletFanUpDownAngle_Rsp 63;
BA_ "GenSigStartValue" SG_ 700 OLM_RCAirOutletFanLeftRightAngle_Rsp 255;
BA_ "GenSigStartValue" SG_ 700 OLM_RCAirOutletFanUpDownAngle_Rsp 63;
BA_ "GenSigStartValue" SG_ 700 OLM_FRAirOutletFanUpDownAngle_Rsp 63;
BA_ "GenSigStartValue" SG_ 700 OLM_FRAirOutletFanLeftRightAngle_Rsp 255;
BA_ "GenSigStartValue" SG_ 700 BDCM_FD_RT_9_OLM_Available_St 1;
BA_ "GenSigStartValue" SG_ 700 SCAM_TiltPosition 32768;
BA_ "GenSigStartValue" SG_ 700 SCAM_TelescopePosition 32768;
BA_ "GenSigStartValue" SG_ 700 BDCM_FD_RT_9_SCAM_Available_St 1;
BA_ "GenMsgCycleTime" BO_ 697 100;
BA_ "GenSigStartValue" SG_ 697 NTDM_RL_DoorOpenDegree_Rsp 255;
BA_ "GenSigStartValue" SG_ 697 NTDM_RL_NTDoorOpenDegree_Rsp 255;
BA_ "GenSigStartValue" SG_ 697 NTDM_RL_DoorObstacleAvoid_St 3;
BA_ "GenSigStartValue" SG_ 697 NTDM_RL_NTDoorObstacleAvoid_St 3;
BA_ "GenSigStartValue" SG_ 697 NTDM_RL_DoorobstacleDistance_Rsp 255;
BA_ "GenSigStartValue" SG_ 697 NTDM_RL_NTDoorobstacleDistance_Rsp 255;
BA_ "GenSigStartValue" SG_ 697 BDCM_FD_RT_10_NTDM_RL_Available_St 1;
BA_ "GenSigStartValue" SG_ 697 BDCM_FD_RT_10_NTDM_RR_Available_St 1;
BA_ "GenSigStartValue" SG_ 697 NTDM_RR_DoorOpenDegree_Rsp 255;
BA_ "GenSigStartValue" SG_ 697 NTDM_RR_NTDoorOpenDegree_Rsp 255;
BA_ "GenSigStartValue" SG_ 697 NTDM_RR_DoorObstacleAvoid_St 3;
BA_ "GenSigStartValue" SG_ 697 NTDM_RR_NTDoorObstacleAvoid_St 3;
BA_ "GenSigStartValue" SG_ 697 NTDM_RR_DoorobstacleDistance_Rsp 255;
BA_ "GenSigStartValue" SG_ 697 NTDM_RR_NTDoorobstacleDistance_Rsp 255;
BA_ "GenSigStartValue" SG_ 697 BDCM_FD_RT_10_PLGM_Available_St 1;
BA_ "GenSigStartValue" SG_ 697 PLGM_TravelPosition_Rsp 255;
BA_ "GenMsgCycleTime" BO_ 208 10;
BA_ "GenSigStartValue" SG_ 208 VDCM_ActlGear_Valid 1;
BA_ "GenMsgCycleTime" BO_ 220 10;
BA_ "GenMsgCycleTime" BO_ 663 100;
BA_ "GenSigStartValue" SG_ 663 VDCM_DisplaySOC 255;
BA_ "GenMsgCycleTime" BO_ 540 50;
BA_ "GenMsgCycleTime" BO_ 222 10;
BA_ "GenMsgCycleTime" BO_ 244 10;
BA_ "GenSigStartValue" SG_ 244 VDCM_ProtocolVersion 1;
BA_ "GenMsgCycleTime" BO_ 232 10;
BA_ "GenSigStartValue" SG_ 232 BMS_Current 65534;
BA_ "GenSigStartValue" SG_ 232 BMS_BatteryVoltage 4094;
BA_ "GenSigStartValue" SG_ 232 BMS_HVBusVoltage 4094;
BA_ "GenSigStartValue" SG_ 232 BMS_ProtocolVersion 1;
BA_ "GenSigStartValue" SG_ 232 VDCM_FD_RT_4_BMS_Available_St 1;
BA_ "GenSigStartValue" SG_ 232 VDCM_FD_RT_4_IPEU_Available_St 1;
BA_ "GenSigStartValue" SG_ 232 VDCM_FD_RT_4_ADCM_Available_St 1;
BA_ "GenMsgCycleTime" BO_ 648 100;
BA_ "GenSigStartValue" SG_ 648 ACM_InvehicleTemp 126;
BA_ "GenSigStartValue" SG_ 648 ACM_EnvironmentTemp 126;
BA_ "GenSigStartValue" SG_ 648 VDCM_FD_RT_5_BMS_Available_St 1;
BA_ "GenSigStartValue" SG_ 648 VDCM_FD_RT_5_ACM_Available_St 1;
BA_ "GenSigStartValue" SG_ 648 VDCM_FD_RT_5_IPEU_Available_St 1;
BA_ "GenMsgCycleTime" BO_ 653 100;
BA_ "GenSigStartValue" SG_ 653 ACM_DriveTempSet_St 14;
BA_ "GenSigStartValue" SG_ 653 ACM_PassengerTempSet_St 14;
BA_ "GenSigStartValue" SG_ 653 ACM_RearRowTempSet_St 14;
BA_ "GenSigStartValue" SG_ 653 ACM_FragChannel1Life 360;
BA_ "GenSigStartValue" SG_ 653 ACM_FragChannel2Life 360;
BA_ "GenSigStartValue" SG_ 653 ACM_FragChannel3Life 360;
BA_ "GenSigStartValue" SG_ 653 VDCM_FD_RT_6_ACM_Available_St 1;
BA_ "GenMsgCycleTime" BO_ 938 1000;
BA_ "GenSigStartValue" SG_ 938 VDCM_FD_RT_9_BMS_Available_St 1;
BA_ "GenMsgCycleTime" BO_ 527 50;
BA_ "GenSigStartValue" SG_ 527 VDCM_FD_RT_11_IFV300_Available_St 1;
BA_ "GenMsgCycleTime" BO_ 224 10;
BA_ "GenMsgCycleTime" BO_ 658 100;
BA_ "GenMsgCycleTime" BO_ 225 10;
BA_ "GenMsgCycleTime" BO_ 659 100;
BA_ "GenMsgCycleTime" BO_ 880 500;
BA_ "GenSigStartValue" SG_ 880 TBOX_AbsoluteTime_Year 255;
BA_ "GenSigStartValue" SG_ 880 TBOX_AbsoluteTime_Month 15;
BA_ "GenSigStartValue" SG_ 880 TBOX_AbsoluteTime_Day 63;
BA_ "GenSigStartValue" SG_ 880 TBOX_AbsoluteTime_Hour 31;
BA_ "GenSigStartValue" SG_ 880 TBOX_AbsoluteTime_Minute 63;
BA_ "GenSigStartValue" SG_ 880 TBOX_AbsoluteTime_Second 63;
BA_ "GenMsgSendType" BO_ 378 3;
BA_ "GenMsgCycleTime" BO_ 378 500;
BA_ "GenMsgCycleTimeFast" BO_ 378 100;
BA_ "GenMsgNrOfRepetition" BO_ 378 3;
BA_ "GenSigSendType" SG_ 378 TBOX_ChargeReservationSource 5;
BA_ "GenSigStartValue" SG_ 378 TBOX_ReservationChargeTimeHour 63;
BA_ "GenSigStartValue" SG_ 378 TBOX_ReservationChargeTimeMinute 63;
BA_ "GenSigStartValue" SG_ 378 TBOX_ReservationChargeDurationSet 65535;
BA_ "GenSigStartValue" SG_ 378 TBOX_ReservationChargCutoffSOCSet 255;
BA_ "GenSigSendType" SG_ 378 TBOX_ReservationChargeStopHour 5;
BA_ "GenSigStartValue" SG_ 378 TBOX_ReservationChargeStopHour 63;
BA_ "GenSigSendType" SG_ 378 TBOX_ReservationChargeStopMinute 5;
BA_ "GenSigStartValue" SG_ 378 TBOX_ReservationChargeStopMinute 63;
BA_ "GenMsgSendType" BO_ 761 3;
BA_ "GenMsgCycleTime" BO_ 761 100;
BA_ "GenMsgCycleTimeFast" BO_ 761 20;
BA_ "GenMsgNrOfRepetition" BO_ 761 3;
BA_ "GenSigStartValue" SG_ 761 TBOX_VehicleTotalMileageBackup 16777215;
BA_ "GenSigSendType" SG_ 761 TBOX_BLEConnected_St 4;
BA_ "GenSigSendType" SG_ 761 TBOX_GuardWakeup 4;
BA_ "GenSigSendType" SG_ 761 TBOX_AbnormalMoveWakeup 4;
BA_ "GenSigSendType" SG_ 761 TBOX_ScratchWakeup 4;
BA_ "GenSigSendType" SG_ 761 TBOX_SVTWakeup 4;
BA_ "GenSigSendType" SG_ 761 TBOX_CrashWakeup 4;
BA_ "GenMsgSendType" BO_ 762 3;
BA_ "GenMsgCycleTime" BO_ 762 100;
BA_ "GenSigSendType" SG_ 762 TBOX_FD_7_Checksum1 2;
BA_ "GenSigSendType" SG_ 762 TBOX_FD_7_RollingCounter1 2;
BA_ "GenSigSendType" SG_ 762 TBOX_V2XFrontCollisionWarn_St 2;
BA_ "GenSigSendType" SG_ 762 TBOX_V2XFrontCollisionWarn_Direction 2;
BA_ "GenSigSendType" SG_ 762 TBOX_V2XFrontCollisionWarn_AlarmLevel 2;
BA_ "GenSigSendType" SG_ 762 TBOX_V2XFrontCollisionWarn_Distance 2;
BA_ "GenSigSendType" SG_ 762 TBOX_V2XIntersectionCollisionWarn_St 2;
BA_ "GenSigSendType" SG_ 762 TBOX_V2XIntersectionCollisionWarn_Direction 2;
BA_ "GenSigSendType" SG_ 762 TBOX_V2XIntersectionCollisionWarn_AlarmLevel 2;
BA_ "GenSigSendType" SG_ 762 TBOX_V2XIntersectionCollisionWarn_Distance 2;
BA_ "GenSigSendType" SG_ 762 TBOX_FD_7_Checksum2 2;
BA_ "GenSigSendType" SG_ 762 TBOX_FD_7_RollingCounter2 2;
BA_ "GenSigSendType" SG_ 762 TBOX_V2XTurnLeftAssist_Distance 2;
BA_ "GenSigSendType" SG_ 762 TBOX_V2XTurnLeftAssist_St 2;
BA_ "GenSigSendType" SG_ 762 TBOX_V2XTurnLeftAssist_AlarmLevel 2;
BA_ "GenSigSendType" SG_ 762 TBOX_V2XReverseOvertakeWarn_Distance 2;
BA_ "GenSigSendType" SG_ 762 TBOX_V2XReverseOvertakeWarn_St 2;
BA_ "GenSigSendType" SG_ 762 TBOX_V2XReverseOvertakeWarn_AlarmLevel 2;
BA_ "GenSigSendType" SG_ 762 TBOX_FD_7_Checksum3 2;
BA_ "GenSigSendType" SG_ 762 TBOX_FD_7_RollingCounter3 2;
BA_ "GenSigSendType" SG_ 762 TBOX_V2XEmergencyBrakeWarn_St 2;
BA_ "GenSigSendType" SG_ 762 TBOX_V2XEmergencyBrakeWarn_Direction 2;
BA_ "GenSigSendType" SG_ 762 TBOX_V2XEmergencyBrakeWarn_AlarmLevel 2;
BA_ "GenSigSendType" SG_ 762 TBOX_V2XEmergencyBrakeWarn_Distance 2;
BA_ "GenSigSendType" SG_ 762 TBOX_V2XAbnormalVehicleWarn_Distance 2;
BA_ "GenSigSendType" SG_ 762 TBOX_V2XAbnormalVehicleWarn_St 2;
BA_ "GenSigSendType" SG_ 762 TBOX_V2XAbnormalVehicleWarn_AlarmLevel 2;
BA_ "GenSigSendType" SG_ 762 TBOX_V2XAbnormalVehicleWarn_Angle 2;
VAL_ 744 DLP_LowerBeamLampSt_Rsp 3 "invalid" 2 "reserved" 1 "active" 0 "Inacitve" ;
VAL_ 744 DLP_LeftLampErr_Rsp 1 "Error" 0 "Normal" ;
VAL_ 744 DLP_RightLampErr_Rsp 1 "Error" 0 "Normal" ;
VAL_ 744 DLP_HighBeamLampSt_Rsp 3 "invalid" 2 "reserved" 1 "active" 0 "Inacitve" ;
VAL_ 744 DLP_PositionLampSt_Rsp 3 "invalid" 2 "reserved" 1 "active" 0 "Inactive" ;
VAL_ 744 DLP_FogLampSt_Rsp_OnlyForIV2 3 "invalid" 2 "reserved" 1 "active" 0 "Inactive" ;
VAL_ 744 DLP_LogLampSt_Rsp 3 "invalid" 2 "reserved" 1 "active" 0 "Inactive" ;
VAL_ 744 DLP_ISDChargeConDisplayEn_Rsp 3 "Invalid" 2 "ON" 1 "OFF" 0 "Default" ;
VAL_ 744 DLP_DaytimeRunningLightSt_Rsp 3 "invalid" 2 "reserved" 1 "active" 0 "Inactive" ;
VAL_ 744 DLP_FLTurnLightSt_Rsp 3 "invalid" 2 "reserved" 1 "active" 0 "Inactive" ;
VAL_ 744 DLP_FLTurnLightErr_Rsp_OnlyForIV2 1 "Error" 0 "Normal" ;
VAL_ 744 DLP_RLTurnLightSt_Rsp 3 "invalid" 2 "reserved" 1 "active" 0 "Inactive" ;
VAL_ 744 DLP_RLTurnLightErr_Rsp_OnlyForIV2 1 "Error" 0 "Normal" ;
VAL_ 744 DLP_FRTurnLightSt_Rsp 3 "invalid" 2 "reserved" 1 "active" 0 "Inactive" ;
VAL_ 744 DLP_FRTurnLightErr_Rsp_OnlyForIV2 1 "Error" 0 "Normal" ;
VAL_ 744 DLP_RRTurnLightSt_Rsp 3 "invalid" 2 "reserved" 1 "active" 0 "Inactive" ;
VAL_ 744 DLP_RRTurnLightErr_Rsp_OnlyForIV2 1 "Error" 0 "Normal" ;
VAL_ 744 DLP_TailLampSt_Rsp 3 "invalid" 2 "reserved" 1 "active" 0 "Inactive" ;
VAL_ 744 DLP_BrakeLampSt_Rsp 3 "invalid" 2 "reserved" 1 "active" 0 "Inactive" ;
VAL_ 744 DLP_TailLampErr_Rsp 1 "Error" 0 "Normal" ;
VAL_ 744 DLP_BrakeLampErr_Rsp 1 "Error" 0 "Normal" ;
VAL_ 744 DLP_ReversingLampSt_Rsp 3 "invalid" 2 "reserved" 1 "active" 0 "Inactive" ;
VAL_ 744 DLP_LightingMasterErr_Rsp 1 "Error" 0 "Normal" ;
VAL_ 744 DLP_CameraErr_Rsp 1 "Error" 0 "Normal" ;
VAL_ 744 DLP_DHLErr_Rsp 1 "Error" 0 "Normal" ;
VAL_ 744 DLP_PreviewErr_Rsp 3 "internal fail" 2 "decode fail" 1 "connect/transmit fail" 0 "normal" ;
VAL_ 744 DLP_VideoProjectErr_Rsp 3 "internal fail" 2 "decode fail" 1 "connect/transmit fail" 0 "normal" ;
VAL_ 744 DLP_ADASHoldProjectSt_Rsp 1 "Active" 0 "Inactive" ;
VAL_ 744 DLP_PedestrianFirstPromptButton_Req 3 "invalid" 2 "reserved" 1 "active" 0 "Inactive" ;
VAL_ 744 DLP_DrivingLinePromptTrigger_Req 3 "invalid" 2 "reserved" 1 "active" 0 "Inactive" ;
VAL_ 744 DLP_ActualLightShowMode_Rsp 15 "Reserved" 14 "Reserved" 13 "Reserved" 12 "Reserved" 11 "Reserved" 10 "Reserved" 9 "Reserved" 8 "Reserved" 7 "FarewellMode" 6 "WelcomeMode" 5 "FestivalMode5" 4 "FestivalMode4" 3 "FestivalMode3" 2 "FestivalMode2" 1 "FestivalMode1" 0 "No Light show" ;
VAL_ 744 DLP_LightShowWorkingSt_Rsp 3 "Exit" 2 "Finish" 1 "Showing" 0 "Not show" ;
VAL_ 744 DLP_ADBEN_Rsp 1 "ON" 0 "OFF" ;
VAL_ 744 DLP_LightPedestriansWarnEn_Rsp 1 "ON" 0 "OFF" ;
VAL_ 744 DLP_PedestrianFirstEn_Rsp 1 "ON" 0 "OFF" ;
VAL_ 744 DLP_LightFrontVehicleCollisionWarnEn_Rsp 1 "ON" 0 "OFF" ;
VAL_ 744 DLP_LightLaneChangeWarnEn_Res 1 "ON" 0 "OFF" ;
VAL_ 744 DLP_LightTurnWarnEn_Rsp 1 "ON" 0 "OFF" ;
VAL_ 744 DLP_LightLaneDepartureWarnEn_Rsp 1 "ON" 0 "OFF" ;
VAL_ 744 DLP_LightSpeedLimitWarnEn_Rsp 1 "ON" 0 "OFF" ;
VAL_ 744 DLP_LightSmartNavigationPromptEn_Rsp 1 "ON" 0 "OFF" ;
VAL_ 744 DLP_LightDrivingLinePromptEn_Rsp 1 "ON" 0 "OFF" ;
VAL_ 744 DLP_LightVideoProjectPlayEn_Rsp 1 "ON" 0 "OFF" ;
VAL_ 744 DLP_ISDSmartNavigationEN_Rsp 1 "ON" 0 "OFF" ;
VAL_ 744 DLP_ISDSpeedLimitPromptEN_Rsp 1 "ON" 0 "OFF" ;
VAL_ 744 DLP_PreviewState_Rsp 1 "ON" 0 "OFF" ;
VAL_ 744 DLP_ISDEnduranceMileagePromptEn_Rsp 1 "ON" 0 "OFF" ;
VAL_ 744 DLP_LightSignatureProjectEn_Rsp 1 "ON" 0 "OFF" ;
VAL_ 744 DLP_LightAutomaticPiolotPromptEn_Rsp 1 "ON" 0 "OFF" ;
VAL_ 744 DLP_DrivingLinePromptButton_Rsp 1 "ON" 0 "OFF" ;
VAL_ 744 DLP_ThanksButton_Rsp 1 "ON" 0 "OFF" ;
VAL_ 744 DLP_PedestrianFirsttButton_Rsp 1 "ON" 0 "OFF" ;
VAL_ 744 DLP_PrjctProjectLampSelact_Rsp 3 "invalid" 2 "Both Project" 1 "Right Project" 0 "Left Project" ;
VAL_ 744 DLP_ProjectAreaSelect_Rsp 3 "Invalid" 2 "Projectiontotheground" 1 "ProjectiontotheWall" 0 "NoProjection" ;
VAL_ 744 DLP_SaveButtone_Rsp 3 "Reserved" 2 "Save Unfinish" 1 "Save Fail" 0 "Save Successful" ;
VAL_ 744 DLP_ISDRearVehicleCollisionWarnEn_Rsp 1 "ON" 0 "OFF" ;
VAL_ 744 DLP_ISDCustomerEditeErr_Rsp 3 "internal fail" 2 "decode fail" 1 "connect/transmit fail" 0 "normal" ;
VAL_ 744 DLP_ISDHighBeamLampOffRemainderEn_Rsp 1 "ON" 0 "OFF" ;
VAL_ 744 DLP_ISDPedestrianFirstEn_Rsp 1 "ON" 0 "OFF" ;
VAL_ 744 DLP_ISDLockStateRemainderEn_Rsp 1 "Enable" 0 "Disable" ;
VAL_ 744 DLP_ISDChangeDrivingModeEn_Rsp 1 "ON" 0 "OFF" ;
VAL_ 744 DLP_ISDCustomersModeEN_Rsp 1 "ON" 0 "OFF" ;
VAL_ 744 DLP_ISDCustomerEditEN_Rsp 1 "ON" 0 "OFF" ;
VAL_ 744 DLP_Festival1_LightShowEn_Rsp 1 "ON" 0 "OFF" ;
VAL_ 744 DLP_Festival2_LightShowEn_Rsp 1 "ON" 0 "OFF" ;
VAL_ 744 DLP_Festival3_LightShowEn_Rsp 1 "ON" 0 "OFF" ;
VAL_ 744 DLP_Festival4_LightShowEn_Rsp 1 "ON" 0 "OFF" ;
VAL_ 744 DLP_Festival5_LightShowEn_Rsp 1 "ON" 0 "OFF" ;
VAL_ 744 DLP_WelcomeLightShowEn_Rsp 1 "ON" 0 "OFF" ;
VAL_ 744 DLP_FarewellLightShowEn_Rsp 1 "ON" 0 "OFF" ;
VAL_ 744 DLP_LightShow1En_Rsp_Reserved 1 "ON" 0 "OFF" ;
VAL_ 744 DLP_LightShow2En_Rsp_Reserved 1 "ON" 0 "OFF" ;
VAL_ 744 DLP_LightShow3En_Rsp_Reserved 1 "ON" 0 "OFF" ;
VAL_ 744 DLP_LightShow4En_Rsp_Reserved 1 "ON" 0 "OFF" ;
VAL_ 744 DLP_LightShow5En_Rsp_Reserved 1 "ON" 0 "OFF" ;
VAL_ 744 DLP_LightShow6En_Rsp_Reserved 1 "ON" 0 "OFF" ;
VAL_ 744 DLP_LightShow7En_Rsp_Reserved 1 "ON" 0 "OFF" ;
VAL_ 744 DLP_LightShow8En_Rsp_Reserved 1 "ON" 0 "OFF" ;
VAL_ 744 AVAS_SoundType 7 "invalid" 6 "reserved" 5 "reserved" 4 "reserved" 3 "reserved" 2 "Type3" 1 "Type2" 0 "Type1" ;
VAL_ 744 AVAS_ErrInfo 15 "invalid" 14 "Reserved" 13 "Reserved" 12 "Reserved" 11 "Reserved" 10 "Reserved" 9 "Reserved" 8 "Reserved" 7 "Reserved" 6 "Reserved" 5 "Reserved" 4 "Reserved" 3 "LostCommunication" 2 "OverNormalVoltage" 1 "UnderNormalVoltage" 0 "NoFault" ;
VAL_ 744 AVAS_ENSt_Rsp 3 "invalid" 2 "reserved" 1 "Enable" 0 "Disable" ;
VAL_ 744 DLP_ProtocolVersion 3 "Reserved" 2 "PPV" 1 "NCT" 0 "IV2" ;
VAL_ 744 BDCM_FD_RT_2_AVAS_Available_St 3 "Reserved" 2 "Reserved" 1 "Not available" 0 "Available" ;
VAL_ 744 BDCM_FD_RT_2_DLP_Available_St 3 "Reserved" 2 "Reserved" 1 "Not available" 0 "Available" ;
VAL_ 744 DLP_FLTurnLightErr_Rsp 3 "invalid" 2 "reserved" 1 "Error" 0 "Normal" ;
VAL_ 744 DLP_RLTurnLightErr_Rsp 3 "invalid" 2 "reserved" 1 "Error" 0 "Normal" ;
VAL_ 744 DLP_FRTurnLightErr_Rsp 3 "invalid" 2 "reserved" 1 "Error" 0 "Normal" ;
VAL_ 744 DLP_RRTurnLightErr_Rsp 3 "invalid" 2 "reserved" 1 "Error" 0 "Normal" ;
VAL_ 555 SCMFL_FrontBackAdjMotorPosition_St 255 "Invalid" ;
VAL_ 555 SCMFL_HeightAdjMotorPosition_St 255 "Invalid" ;
VAL_ 555 SCMFL_CushionAngleAdjMotorPosition_St 255 "Invalid" ;
VAL_ 555 SCMFL_BackCushionAdjMotorPosition_St 255 "Invalid" ;
VAL_ 555 SCMFL_FrontBackAdjMotorCalibration_St_OnlyForIV2 3 "invalid" 2 "Reserved" 1 "Calibrationcomplete" 0 "Calibrationincomplete" ;
VAL_ 555 SCMFL_HeightAdjMotorCalibration_St_OnlyForIV2 3 "invalid" 2 "Reserved" 1 "Calibrationcomplete" 0 "Calibrationincomplete" ;
VAL_ 555 SCMFL_CushionAngleAdjMotorCalibration_St_OnlyForIV2 3 "invalid" 2 "Reserved" 1 "Calibrationcomplete" 0 "Calibrationincomplete" ;
VAL_ 555 SCMFL_BackCushionAdjMotorCalibration_St_OnlyForIV2 3 "invalid" 2 "Reserved" 1 "Calibrationcomplete" 0 "Calibrationincomplete" ;
VAL_ 555 SCMFR_FrontBackAdjMotorPosition_St 255 "Invalid" ;
VAL_ 555 SCMFR_HeightAdjMotorPosition_St 255 "Invalid" ;
VAL_ 555 SCMFR_SeatLegSupportAdjMotorPosition_St 255 "Invalid" ;
VAL_ 555 SCMFR_BackCushionAdjMotorPosition_St 255 "Invalid" ;
VAL_ 555 SCMFR_FrontBackAdjMotorCalibration_St_OnlyForIV2 3 "invalid" 2 "Reserved" 1 "Calibrationcomplete" 0 "Calibrationincomplete" ;
VAL_ 555 SCMFR_HeightAdjMotorCalibration_St_OnlyForIV2 3 "invalid" 2 "Reserved" 1 "Calibrationcomplete" 0 "Calibrationincomplete" ;
VAL_ 555 SCMFR_LegSupportAdjMotorCalibration_St_OnlyForIV2 3 "invalid" 2 "Reserved" 1 "Calibrationcomplete" 0 "Calibrationincomplete" ;
VAL_ 555 SCMFR_BackCushionAdjMotorCalibration_St_OnlyForIV2 3 "invalid" 2 "Reserved" 1 "Calibrationcomplete" 0 "Calibrationincomplete" ;
VAL_ 555 SCMSRL_FrontBackAdjMotorPosition_St 255 "Invalid" ;
VAL_ 555 SCMSRL_BackCushionAdjMotorPosition_St 255 "Invalid" ;
VAL_ 555 SCMSRL_LateralAdjustMotorPosition_St 255 "Invalid" ;
VAL_ 555 SCMSRL_LegSupportAdjMotorPosition_St 255 "Invalid" ;
VAL_ 555 SCMSRL_FrontBackAdjustSt_Rsp 3 "Invalid" 2 "Stop" 1 "Back" 0 "Forward" ;
VAL_ 555 SCMSRL_LegSupportAdjustSt_Rsp 3 "Invalid" 2 "Stop" 1 "Down" 0 "Up" ;
VAL_ 555 SCMSRL_LateralAdjustSt_Rsp 3 "Reserved" 2 "Right" 1 "Left" 0 "NoRequest" ;
VAL_ 555 SCMSRL_BackCushionAdjustSt_Rsp 3 "Invalid" 2 "Stop" 1 "Back" 0 "Forward" ;
VAL_ 555 SCMSRL_FrontBackAdjMotorCalibration_St_OnlyForIV2 3 "Reserved" 2 "Calibrationcomplete" 1 "Calibrationincomplete" 0 "Default" ;
VAL_ 555 SCMSRL_BackCushionAdjMotorCalibration_St_OnlyForIV2 3 "Reserved" 2 "Calibrationcomplete" 1 "Calibrationincomplete" 0 "Default" ;
VAL_ 555 SCMSRL_LateralAdjMotorCalibration_St_OnlyForIV2 3 "Reserved" 2 "Calibrationcomplete" 1 "Calibrationincomplete" 0 "Default" ;
VAL_ 555 SCMSRL_LegSupportAdjMotorCalibration_St_OnlyForIV2 3 "Reserved" 2 "Calibrationcomplete" 1 "Calibrationincomplete" 0 "Default" ;
VAL_ 555 SCMSRR_FrontBackAdjMotorPosition_St 255 "Invalid" ;
VAL_ 555 SCMSRR_BackCushionAdjMotorPosition_St 255 "Invalid" ;
VAL_ 555 SCMSRR_LateralAdjustMotorPosition_St 255 "Invalid" ;
VAL_ 555 SCMSRR_LegSupportAdjMotorPosition_St 255 "Invalid" ;
VAL_ 555 SCMSRR_FrontBackAdjustSt_Rsp 3 "Invalid" 2 "Stop" 1 "Back" 0 "Forward" ;
VAL_ 555 SCMSRR_LegSupportAdjustSt_Rsp 3 "Invalid" 2 "Stop" 1 "Down" 0 "Up" ;
VAL_ 555 SCMSRR_LateralAdjustSt_Rsp 3 "Reserved" 2 "Right" 1 "Left" 0 "NoRequest" ;
VAL_ 555 SCMSRR_BackCushionAdjustSt_Rsp 3 "Invalid" 2 "Stop" 1 "Back" 0 "Forward" ;
VAL_ 555 SCMSRR_FrontBackAdjMotorCalibration_St_OnlyForIV2 3 "Reserved" 2 "Calibrationcomplete" 1 "Calibrationincomplete" 0 "Default" ;
VAL_ 555 SCMSRR_BackCushionAdjMotorCalibration_St_OnlyForIV2 3 "Reserved" 2 "Calibrationcomplete" 1 "Calibrationincomplete" 0 "Default" ;
VAL_ 555 SCMSRR_LateralAdjMotorCalibration_St_OnlyForIV2 3 "Reserved" 2 "Calibrationcomplete" 1 "Calibrationincomplete" 0 "Default" ;
VAL_ 555 SCMSRR_LegSupportAdjMotorCalibration_St_OnlyForIV2 3 "Reserved" 2 "Calibrationcomplete" 1 "Calibrationincomplete" 0 "Default" ;
VAL_ 745 SCMFL_HeatTemp_Rsp 255 "Invalid" ;
VAL_ 745 SCMFL_HeatGearSt_Rsp 7 "invalid" 6 "Reserved" 5 "Reserved" 4 "Reserved" 3 "High" 2 "Medium" 1 "Low" 0 "OFF" ;
VAL_ 745 SCMFL_VentilationSt_Rsp 7 "invalid" 6 "Reserved" 5 "Reserved" 4 "Reserved" 3 "High" 2 "Medium" 1 "Low" 0 "OFF" ;
VAL_ 745 SCMFL_LumbarSupportFrontBackAdjSt_Rsp 7 "invalid" 6 "Reserved" 5 "Reserved" 4 "Reserved" 3 "Error" 2 "Backward" 1 "Forward" 0 "NoRequest" ;
VAL_ 745 SCMFL_LumbarSupportUpDwnAdjSt_Rsp 7 "invalid" 6 "Reserved" 5 "Reserved" 4 "Reserved" 3 "Error" 2 "Down" 1 "Up" 0 "No Request" ;
VAL_ 745 SCMFL_LeftShakeMotorSt_Rsp 3 "invalid" 2 "reserved" 1 "Active" 0 "NoRequest" ;
VAL_ 745 SCMFL_RightShakeMotorSt_Rsp 3 "invalid" 2 "reserved" 1 "Active" 0 "NoRequest" ;
VAL_ 745 SCMFL_MassageStrength_Rsp 7 "Invalid" 6 "Reserved" 5 "Reserved" 4 "Reserved" 3 "High" 2 "Medium" 1 "Low" 0 "Inacitve" ;
VAL_ 745 SCMFL_MassageMode_Rsp 7 "invalid" 6 "Reserved" 5 "Reserved" 4 "Mode3" 3 "Mode2" 2 "Mode1" 1 "OFF" 0 "Inacitve" ;
VAL_ 745 SCMFL_FrontBackMoveSt_Rsp 3 "Invalid" 2 "Stop" 1 "Back" 0 "Forward" ;
VAL_ 745 SCMFL_HeightAdjustSt_Rsp 3 "invalid" 2 "Down" 1 "Up" 0 "NoRequest" ;
VAL_ 745 SCMFL_CushionAngleAdjustSt_Rsp 3 "invalid" 2 "Down" 1 "Up" 0 "NoRequest" ;
VAL_ 745 SCMFL_BackCushionAdjustSt_Rsp 3 "invalid" 2 "Back" 1 "Front" 0 "NoRequest" ;
VAL_ 745 SCMFL_FrontBackAdjustStopRsn 8 "Instruction conflict" 7 "anti-pinch trigger" 6 "Hard stop" 5 "Soft stop" 4 "Over voltage" 3 "Under voltage" 2 "Load failure" 1 "End" 0 "invalid" ;
VAL_ 745 SCMFL_HeightAdjustStopRsn 8 "Instruction conflict" 7 "anti-pinch trigger" 6 "Hard stop" 5 "Soft stop" 4 "Over voltage" 3 "Under voltage" 2 "Load failure" 1 "End" 0 "invalid" ;
VAL_ 745 SCMFL_CushionAngleAdjustStopRsn 8 "Instruction conflict" 7 "anti-pinch trigger" 6 "Hard stop" 5 "Soft stop" 4 "Over voltage" 3 "Under voltage" 2 "Load failure" 1 "End" 0 "invalid" ;
VAL_ 745 SCMFL_BackCushionAdjustStopRsn 8 "Instruction conflict" 7 "anti-pinch trigger" 6 "Hard stop" 5 "Soft stop" 4 "Over voltage" 3 "Under voltage" 2 "Load failure" 1 "End" 0 "invalid" ;
VAL_ 745 SCMFL_HeatStopRsn 5 "Seat Ventilation" 4 "Over voltage" 3 "Under voltage" 2 "Load failure" 1 "End" 0 "invalid" ;
VAL_ 745 SCMFL_VentilationStopRsn 5 "Seat heating" 4 "Over voltage" 3 "Under voltage" 2 "Load failure" 1 "End" 0 "invalid" ;
VAL_ 745 SCMFL_LeftShakeStopRsn 4 "Over voltage" 3 "Under voltage" 2 "Load failure" 1 "End" 0 "invalid" ;
VAL_ 745 SCMFL_RightShakeStopRsn 4 "Over voltage" 3 "Under voltage" 2 "Load failure" 1 "End" 0 "invalid" ;
VAL_ 745 SCMFL_LumbarSupportFrontBackAdjStopRsn 7 "Instruction conflict" 6 "Seat controller communication failure" 5 "Massage module communication failure" 4 "SCMOver voltage" 3 "SCMUnder voltage" 2 "Load failure" 1 "End" 0 "invalid" ;
VAL_ 745 SCMFL_LumbarSupportUpDwnAdjStopRsn 7 "Instruction conflict" 6 "Seat controller communication failure" 5 "Massage module communication failure" 4 "SCMOver voltage" 3 "SCMUnder voltage" 2 "Load failure" 1 "End" 0 "invalid" ;
VAL_ 745 SCMFL_MassageStopReason 7 "Instruction conflict" 6 "Seat controller communication failure" 5 "Massage module communication failure" 4 "SCMOver voltage" 3 "SCMUnder voltage" 2 "Load failure" 1 "End" 0 "invalid" ;
VAL_ 746 SCMFR_Occupied_St 3 "invalid" 2 "reserved" 1 "Active" 0 "NoRequest" ;
VAL_ 746 SCMFR_SeatBelt_St 3 "invalid" 2 "reserved" 1 "Unbuckle" 0 "Buckled" ;
VAL_ 746 SCMFR_HeatTemp_Rsp 255 "Invalid" ;
VAL_ 746 SCMFR_FrontBackMoveSt_Rsp 3 "Invalid" 2 "Stop" 1 "Back" 0 "Forward" ;
VAL_ 746 SCMFR_HeightAdjustSt_Rsp 3 "invalid" 2 "Stop" 1 "Down" 0 "Up" ;
VAL_ 746 SCMFR_LegSupportAdjustSt_Rsp 3 "invalid" 2 "Down" 1 "Up" 0 "NoRequest" ;
VAL_ 746 SCMFR_BackCushionAdjustSt_Rsp 3 "invalid" 2 "Back" 1 "Front" 0 "NoRequest" ;
VAL_ 746 SCMFR_HeatGearSt_Rsp 7 "invalid" 6 "Reserved" 5 "Reserved" 4 "Reserved" 3 "High" 2 "Medium" 1 "Low" 0 "OFF" ;
VAL_ 746 SCMFR_VentilationSt_Rsp 7 "invalid" 6 "Reserved" 5 "Reserved" 4 "Reserved" 3 "High" 2 "Medium" 1 "Low" 0 "OFF" ;
VAL_ 746 SCMFR_LumbarSupportFrontBackAdjSt_Rsp 7 "invalid" 6 "Reserved" 5 "Reserved" 4 "Reserved" 3 "Error" 2 "Backward" 1 "Forward" 0 "NoRequest" ;
VAL_ 746 SCMFR_LumbarSupportUpDwnAdjSt_Rsp 7 "invalid" 6 "Reserved" 5 "Reserved" 4 "Reserved" 3 "Error" 2 "Down" 1 "Up" 0 "No Request" ;
VAL_ 746 SCMFR_MassageStrength_Rsp 7 "Invalid" 6 "Reserved" 5 "Reserved" 4 "Reserved" 3 "High" 2 "Medium" 1 "Low" 0 "Inacitve" ;
VAL_ 746 SCMFR_MassageMode_Rsp 7 "invalid" 6 "Reserved" 5 "Reserved" 4 "Mode3" 3 "Mode2" 2 "Mode1" 1 "OFF" 0 "Inacitve" ;
VAL_ 746 SCMFR_FrontBackAdjustStopRsn 8 "Instruction conflict" 7 "anti-pinch trigger" 6 "Hard stop" 5 "Soft stop" 4 "Over voltage" 3 "Under voltage" 2 "Load failure" 1 "End" 0 "invalid" ;
VAL_ 746 SCMFR_HeightAdjustStopRsn 8 "Instruction conflict" 7 "anti-pinch trigger" 6 "Hard stop" 5 "Soft stop" 4 "Over voltage" 3 "Under voltage" 2 "Load failure" 1 "End" 0 "invalid" ;
VAL_ 746 SCMFR_LegSupportAdjustStopRsn 8 "Instruction conflict" 7 "anti-pinch trigger" 6 "Hard stop" 5 "Soft stop" 4 "Over voltage" 3 "Under voltage" 2 "Load failure" 1 "End" 0 "invalid" ;
VAL_ 746 SCMFR_BackCushionAdjustStopRsn 8 "Instruction conflict" 7 "anti-pinch trigger" 6 "Hard stop" 5 "Soft stop" 4 "Over voltage" 3 "Under voltage" 2 "Load failure" 1 "End" 0 "invalid" ;
VAL_ 746 SCMFR_HeatStopRsn 5 "Seat Ventilation" 4 "Over voltage" 3 "Under voltage" 2 "Load failure" 1 "End" 0 "invalid" ;
VAL_ 746 SCMFR_VentilationStopRsn 5 "Seat heating" 4 "Over voltage" 3 "Under voltage" 2 "Load failure" 1 "End" 0 "invalid" ;
VAL_ 746 SCMFR_LumbarSupportFrontBackAdjStopRsn 7 "Instruction conflict" 6 "Seat controller communication failure" 5 "Massage module communication failure" 4 "SCMOver voltage" 3 "SCMUnder voltage" 2 "Load failure" 1 "End" 0 "invalid" ;
VAL_ 746 SCMFR_LumbarSupportUpDwnAdjStopRsn 7 "Instruction conflict" 6 "Seat controller communication failure" 5 "Massage module communication failure" 4 "SCMOver voltage" 3 "SCMUnder voltage" 2 "Load failure" 1 "End" 0 "invalid" ;
VAL_ 746 SCMFR_MassageStopReason 7 "Instruction conflict" 6 "Seat controller communication failure" 5 "Massage module communication failure" 4 "SCMOver voltage" 3 "SCMUnder voltage" 2 "Load failure" 1 "End" 0 "invalid" ;
VAL_ 747 SCMSRL_HeatTemp_Rsp 255 "Invalid" ;
VAL_ 747 SCMSRL_HeatGearSt_Rsp 7 "invalid" 6 "Reserved" 5 "Reserved" 4 "Reserved" 3 "High" 2 "Medium" 1 "Low" 0 "OFF" ;
VAL_ 747 SCMSRL_VentilationSt_Rsp 7 "invalid" 6 "Reserved" 5 "Reserved" 4 "Reserved" 3 "High" 2 "Medium" 1 "Low" 0 "OFF" ;
VAL_ 747 SCMSRL_Occupied_St 3 "invalid" 2 "reserved" 1 "Active" 0 "NoRequest" ;
VAL_ 747 SCMSRL_SeatBelt_St 3 "Invalid" 2 "reserved" 1 "Unbuckle" 0 "Buckled" ;
VAL_ 747 SCMSRL_LumbarSupportFrontBackAdjSt_Rsp 7 "invalid" 6 "Reserved" 5 "Reserved" 4 "Reserved" 3 "Error" 2 "Backward" 1 "Forward" 0 "NoRequest" ;
VAL_ 747 SCMSRL_LumbarSupportUpDwnAdjSt_Rsp 7 "invalid" 6 "Reserved" 5 "Reserved" 4 "Reserved" 3 "Error" 2 "Down" 1 "Up" 0 "No Request" ;
VAL_ 747 SCMSRL_MassageStrength_Rsp 7 "Invalid" 6 "Reserved" 5 "Reserved" 4 "Reserved" 3 "High" 2 "Medium" 1 "Low" 0 "Inacitve" ;
VAL_ 747 SCMSRL_MassageMode_Rsp 7 "invalid" 6 "Reserved" 5 "Reserved" 4 "Mode3" 3 "Mode2" 2 "Mode1" 1 "OFF" 0 "Inacitve" ;
VAL_ 747 SCMSRL_FrontBackAdjustStopRsn 8 "Instruction conflict" 7 "anti-pinch trigger" 6 "Hard stop" 5 "Soft stop" 4 "Over voltage" 3 "Under voltage" 2 "Load failure" 1 "End" 0 "invalid" ;
VAL_ 747 SCMSRL_BackCushionAdjustStopRsn 8 "Instruction conflict" 7 "anti-pinch trigger" 6 "Hard stop" 5 "Soft stop" 4 "Over voltage" 3 "Under voltage" 2 "Load failure" 1 "End" 0 "invalid" ;
VAL_ 747 SCMSRL_LateralAdjustStopRsn 8 "Instruction conflict" 7 "anti-pinch trigger" 6 "Hard stop" 5 "Soft stop" 4 "Over voltage" 3 "Under voltage" 2 "Load failure" 1 "End" 0 "invalid" ;
VAL_ 747 SCMSRL_LegSupportAdjustStopRsn 8 "Instruction conflict" 7 "anti-pinch trigger" 6 "Hard stop" 5 "Soft stop" 4 "Over voltage" 3 "Under voltage" 2 "Load failure" 1 "End" 0 "invalid" ;
VAL_ 747 SCMSRL_HeatStopRsn 5 "Seat Ventilation" 4 "Over voltage" 3 "Under voltage" 2 "Load failure" 1 "End" 0 "invalid" ;
VAL_ 747 SCMSRL_VentilationStopRsn 5 "Seat heating" 4 "Over voltage" 3 "Under voltage" 2 "Load failure" 1 "End" 0 "invalid" ;
VAL_ 747 SCMSRL_LumbarSupportFrontBackAdjStopRsn 7 "Instruction conflict" 6 "Seat controller communication failure" 5 "Massage module communication failure" 4 "SCMOver voltage" 3 "SCMUnder voltage" 2 "Load failure" 1 "End" 0 "invalid" ;
VAL_ 747 SCMSRL_LumbarSupportUpDwnAdjStopRsn 7 "Instruction conflict" 6 "Seat controller communication failure" 5 "Massage module communication failure" 4 "SCMOver voltage" 3 "SCMUnder voltage" 2 "Load failure" 1 "End" 0 "invalid" ;
VAL_ 747 SCMSRL_MassageStopReason 7 "Instruction conflict" 6 "Seat controller communication failure" 5 "Massage module communication failure" 4 "SCMOver voltage" 3 "SCMUnder voltage" 2 "Load failure" 1 "End" 0 "invalid" ;
VAL_ 748 SCMSRR_HeatTemp_Rsp 255 "Invalid" ;
VAL_ 748 SCMSRR_HeatGearSt_Rsp 7 "invalid" 6 "Reserved" 5 "Reserved" 4 "Reserved" 3 "High" 2 "Medium" 1 "Low" 0 "OFF" ;
VAL_ 748 SCMSRR_VentilationSt_Rsp 7 "invalid" 6 "Reserved" 5 "Reserved" 4 "Reserved" 3 "High" 2 "Medium" 1 "Low" 0 "OFF" ;
VAL_ 748 SCMSRR_Occupied_St 3 "invalid" 2 "reserved" 1 "Active" 0 "NoRequest" ;
VAL_ 748 SCMSRR_SeatBelt_St 3 "Invalid" 2 "reserved" 1 "Unbuckle" 0 "Buckled" ;
VAL_ 748 SCMSRR_LumbarSupportFrontBackAdjSt_Rsp 7 "invalid" 6 "Reserved" 5 "Reserved" 4 "Reserved" 3 "Error" 2 "Backward" 1 "Forward" 0 "NoRequest" ;
VAL_ 748 SCMSRR_LumbarSupportUpDwnAdjSt_Rsp 7 "invalid" 6 "Reserved" 5 "Reserved" 4 "Reserved" 3 "Error" 2 "Down" 1 "Up" 0 "No Request" ;
VAL_ 748 SCMSRR_MassageStrength_Rsp 7 "Invalid" 6 "Reserved" 5 "Reserved" 4 "Reserved" 3 "High" 2 "Medium" 1 "Low" 0 "Inacitve" ;
VAL_ 748 SCMSRR_MassageMode_Rsp 7 "invalid" 6 "Reserved" 5 "Reserved" 4 "Mode3" 3 "Mode2" 2 "Mode1" 1 "OFF" 0 "Inacitve" ;
VAL_ 748 SCMSRR_FrontBackAdjustStopRsn 8 "Instruction conflict" 7 "anti-pinch trigger" 6 "Hard stop" 5 "Soft stop" 4 "Over voltage" 3 "Under voltage" 2 "Load failure" 1 "End" 0 "invalid" ;
VAL_ 748 SCMSRR_BackCushionAdjustStopRsn 8 "Instruction conflict" 7 "anti-pinch trigger" 6 "Hard stop" 5 "Soft stop" 4 "Over voltage" 3 "Under voltage" 2 "Load failure" 1 "End" 0 "invalid" ;
VAL_ 748 SCMSRR_LateralAdjustStopRsn 8 "Instruction conflict" 7 "anti-pinch trigger" 6 "Hard stop" 5 "Soft stop" 4 "Over voltage" 3 "Under voltage" 2 "Load failure" 1 "End" 0 "invalid" ;
VAL_ 748 SCMSRR_LegSupportAdjustStopRsn 8 "Instruction conflict" 7 "anti-pinch trigger" 6 "Hard stop" 5 "Soft stop" 4 "Over voltage" 3 "Under voltage" 2 "Load failure" 1 "End" 0 "invalid" ;
VAL_ 748 SCMSRR_HeatStopRsn 5 "Seat Ventilation" 4 "Over voltage" 3 "Under voltage" 2 "Load failure" 1 "End" 0 "invalid" ;
VAL_ 748 SCMSRR_VentilationStopRsn 5 "Seat heating" 4 "Over voltage" 3 "Under voltage" 2 "Load failure" 1 "End" 0 "invalid" ;
VAL_ 748 SCMSRR_LumbarSupportFrontBackAdjStopRsn 7 "Instruction conflict" 6 "Seat controller communication failure" 5 "Massage module communication failure" 4 "SCMOver voltage" 3 "SCMUnder voltage" 2 "Load failure" 1 "End" 0 "invalid" ;
VAL_ 748 SCMSRR_LumbarSupportUpDwnAdjStopRsn 7 "Instruction conflict" 6 "Seat controller communication failure" 5 "Massage module communication failure" 4 "SCMOver voltage" 3 "SCMUnder voltage" 2 "Load failure" 1 "End" 0 "invalid" ;
VAL_ 748 SCMSRR_MassageStopReason 7 "Instruction conflict" 6 "Seat controller communication failure" 5 "Massage module communication failure" 4 "SCMOver voltage" 3 "SCMUnder voltage" 2 "Load failure" 1 "End" 0 "invalid" ;
VAL_ 310 CSM_SAS_SteeringWheelAngle 65535 "Invalid" ;
VAL_ 310 CSM_SAS_SteeringWheelSpeed 255 "Invalid" ;
VAL_ 310 CSM_SAS_SteeringWheelAngle_Valid 3 "invalid" 2 "reserved" 1 "OK" 0 "notOK" ;
VAL_ 310 CSM_SAS_Calibrating_St 3 "invalid" 2 "reserved" 1 "calibrated" 0 "notcalibrated" ;
VAL_ 310 CSM_SAS_Trimmed_St 3 "invalid" 2 "reserved" 1 "trimmed" 0 "nottrimmed" ;
VAL_ 310 BDCM_FD_RT_8_CSM_Available_St 3 "Reserved" 2 "Reserved" 1 "Not available" 0 "Available" ;
VAL_ 700 OLM_FLAirOutletFanLeftRightAngle_Rsp 255 "Invalid" ;
VAL_ 700 OLM_FLAirOutletFanUpDownAngle_Rsp 63 "Invalid" ;
VAL_ 700 OLM_FLAirOutletOpenCtl_Rsp 3 "Reserved" 2 "Close" 1 "Open" 0 "Default" ;
VAL_ 700 OLM_LCAirOutletOpenCtl_Rsp 3 "Reserved" 2 "Close" 1 "Open" 0 "Default" ;
VAL_ 700 OLM_LCAirOutletFanUpDownAngle_Rsp 63 "Invalid" ;
VAL_ 700 OLM_LCAirOutletFanLeftRightAngle_Rsp 255 "Invalid" ;
VAL_ 700 OLM_PanelAirOutletFanLeftRightAngle_Rsp 255 "Invalid" ;
VAL_ 700 OLM_PanelAirOutletFanUpDownAngle_Rsp 63 "Invalid" ;
VAL_ 700 OLM_PanelAirOutletOpenCtl_Rsp 3 "Reserved" 2 "Close" 1 "Open" 0 "Default" ;
VAL_ 700 OLM_RCAirOutletFanLeftRightAngle_Rsp 255 "Invalid" ;
VAL_ 700 OLM_RCAirOutletFanUpDownAngle_Rsp 63 "Invalid" ;
VAL_ 700 OLM_RCAirOutletOpenCtl_Rsp 3 "Reserved" 2 "Close" 1 "Open" 0 "Default" ;
VAL_ 700 OLM_FRAirOutletOpenCtl_Rsp 3 "Reserved" 2 "Close" 1 "Open" 0 "Default" ;
VAL_ 700 OLM_FRAirOutletFanUpDownAngle_Rsp 63 "Invalid" ;
VAL_ 700 OLM_FRAirOutletFanLeftRightAngle_Rsp 255 "Invalid" ;
VAL_ 700 OLM_FanOpenSt_Rsp 3 "Reserved" 2 "Close" 1 "Open" 0 "Default" ;
VAL_ 700 OLM_FanMode_Rsp 3 "Temp Control fast" 2 "Avoid people" 1 "Cycle" 0 "normal" ;
VAL_ 700 OLM_FLMotorErrSt_Rsp 7 "invalid" 6 "reserved" 5 "reserved" 4 "Over heat protect" 3 "Stall protect" 2 "Fault" 1 "normal" 0 "no display" ;
VAL_ 700 OLM_LCMotorErrSt_Rsp 7 "invalid" 6 "reserved" 5 "reserved" 4 "Over heat protect" 3 "Stall protect" 2 "Fault" 1 "normal" 0 "no display" ;
VAL_ 700 OLM_PanelMotorErrSt_Rsp 7 "invalid" 6 "reserved" 5 "reserved" 4 "Over heat protect" 3 "Stall protect" 2 "Fault" 1 "normal" 0 "no display" ;
VAL_ 700 OLM_RCMotorErrSt_Rsp 7 "invalid" 6 "reserved" 5 "reserved" 4 "Over heat protect" 3 "Stall protect" 2 "Fault" 1 "normal" 0 "no display" ;
VAL_ 700 OLM_FRMotorErrSt_Rsp 7 "invalid" 6 "reserved" 5 "reserved" 4 "Over heat protect" 3 "Stall protect" 2 "Fault" 1 "normal" 0 "no display" ;
VAL_ 700 BDCM_FD_RT_9_OLM_Available_St 3 "Reserved" 2 "Reserved" 1 "Not available" 0 "Available" ;
VAL_ 700 SCAM_TiltPosition 65535 "Invalid" ;
VAL_ 700 SCAM_TelescopePosition 65535 "Invalid" ;
VAL_ 700 BDCM_FD_RT_9_SCAM_Available_St 3 "Reserved" 2 "Reserved" 1 "Not available" 0 "Available" ;
VAL_ 697 NTDM_RL_DoorOpenDegree_Rsp 255 "Invalid" ;
VAL_ 697 NTDM_RL_NTDoorOpenDegree_Rsp 255 "Invalid" ;
VAL_ 697 NTDM_RL_DoorWorkSt_Rsp 3 "invalid" 2 "opening" 1 "closing" 0 "stop" ;
VAL_ 697 NTDM_RL_NTDoorLight_St 3 "invalid" 2 "reserved" 1 "ON" 0 "OFF" ;
VAL_ 697 NTDM_RL_DoorStopReason 15 "invalid" 14 "reserved" 13 "reserved" 12 "reserved" 11 "reserved" 10 "reserved" 9 "reserved" 8 "reserved" 7 "USS fault" 6 "Non-quiescent" 5 "Instruction conflict" 4 "Load failure" 3 "avoidObstaclehappened" 2 "anti~pinchhappend" 1 "movetoexpectedposition" 0 "Init value" ;
VAL_ 697 NTDM_RL_NTDoorStopReason 15 "invalid" 14 "reserved" 13 "reserved" 12 "reserved" 11 "reserved" 10 "reserved" 9 "reserved" 8 "reserved" 7 "USS fault" 6 "Non-quiescent" 5 "Instruction conflict" 4 "Load failure" 3 "avoidObstaclehappened" 2 "anti~pinchhappend" 1 "movetoexpectedposition" 0 "Init value" ;
VAL_ 697 NTDM_RL_DoorObstacleAvoid_St 3 "invalid" 2 "reserved" 1 "avoidObstaclehappened" 0 "avoidObstaclenothappend" ;
VAL_ 697 NTDM_RL_NTDoorObstacleAvoid_St 3 "invalid" 2 "reserved" 1 "avoidObstaclehappened" 0 "avoidObstaclenothappend" ;
VAL_ 697 NTDM_RL_DoorobstacleDistance_Rsp 255 "Invalid" ;
VAL_ 697 NTDM_RL_NTDoorobstacleDistance_Rsp 255 "Invalid" ;
VAL_ 697 NTDM_RL_NTDoorWorkSt_Rsp 3 "invalid" 2 "opening" 1 "closing" 0 "stop" ;
VAL_ 697 NTDM_RL_NTDoorAntiClamp_St 3 "invalid" 2 "reserved" 1 "anti~pinchhappend" 0 "anti~pinchnothappend" ;
VAL_ 697 NTDM_RL_DoorAntiClamp_St 7 "invalid" 6 "reserved" 5 "reserved" 4 "reserved" 3 "reserved" 2 "reserved" 1 "anti~pinch happend" 0 "anti~pinch not happend" ;
VAL_ 697 BDCM_FD_RT_10_NTDM_RL_Available_St 3 "Reserved" 2 "Reserved" 1 "Not available" 0 "Available" ;
VAL_ 697 BDCM_FD_RT_10_NTDM_RR_Available_St 3 "Reserved" 2 "Reserved" 1 "Not available" 0 "Available" ;
VAL_ 697 NTDM_RR_DoorOpenDegree_Rsp 255 "Invalid" ;
VAL_ 697 NTDM_RR_NTDoorOpenDegree_Rsp 255 "Invalid" ;
VAL_ 697 NTDM_RR_DoorWorkSt_Rsp 3 "invalid" 2 "opening" 1 "closing" 0 "stop" ;
VAL_ 697 NTDM_RR_NTDooRRight_St 3 "invalid" 2 "reserved" 1 "ON" 0 "OFF" ;
VAL_ 697 NTDM_RR_DoorStopReason 15 "invalid" 14 "reserved" 13 "reserved" 12 "reserved" 11 "reserved" 10 "reserved" 9 "reserved" 8 "reserved" 7 "USS fault" 6 "Non-quiescent" 5 "Instruction conflict" 4 "Load failure" 3 "avoidObstaclehappened" 2 "anti~pinchhappend" 1 "movetoexpectedposition" 0 "Init value" ;
VAL_ 697 NTDM_RR_NTDoorStopReason 15 "invalid" 14 "reserved" 13 "reserved" 12 "reserved" 11 "reserved" 10 "reserved" 9 "reserved" 8 "reserved" 7 "USS fault" 6 "Non-quiescent" 5 "Instruction conflict" 4 "Load failure" 3 "avoidObstaclehappened" 2 "anti~pinchhappend" 1 "movetoexpectedposition" 0 "Init value" ;
VAL_ 697 NTDM_RR_DoorObstacleAvoid_St 3 "invalid" 2 "reserved" 1 "avoidObstaclehappened" 0 "avoidObstaclenothappend" ;
VAL_ 697 NTDM_RR_NTDoorObstacleAvoid_St 3 "invalid" 2 "reserved" 1 "avoidObstaclehappened" 0 "avoidObstaclenothappend" ;
VAL_ 697 NTDM_RR_DoorobstacleDistance_Rsp 255 "Invalid" ;
VAL_ 697 NTDM_RR_NTDoorobstacleDistance_Rsp 255 "Invalid" ;
VAL_ 697 NTDM_RR_NTDoorWorkSt_Rsp 3 "invalid" 2 "opening" 1 "closing" 0 "stop" ;
VAL_ 697 NTDM_RR_NTDoorAntiClamp_St 3 "invalid" 2 "reserved" 1 "anti~pinchhappend" 0 "anti~pinchnothappend" ;
VAL_ 697 NTDM_RR_DoorAntiClamp_St 7 "invalid" 6 "reserved" 5 "reserved" 4 "reserved" 3 "reserved" 2 "reserved" 1 "anti~pinch happend" 0 "anti~pinch not happend" ;
VAL_ 697 BDCM_FD_RT_10_PLGM_Available_St 3 "Reserved" 2 "Reserved" 1 "Not available" 0 "Available" ;
VAL_ 697 PLGM_TravelPosition_Rsp 255 "Invalid" ;
VAL_ 697 PLGM_RearDoorMove_St 3 "closing" 2 "opening" 1 "stopped" 0 "Inactive" ;
VAL_ 697 PLGM_RearDoorPosition_St 7 "invalid" 6 "reserved" 5 "reserved" 4 "area4（all open）" 3 "area3(half open)" 2 "area2(half closed)" 1 "area1(all closed)" 0 "Initial value" ;
VAL_ 697 PLGM_PinchEvent_St 1 "occurred" 0 "Not occurred" ;
VAL_ 697 PLGM_RearLatchSwitch_St 15 "invalid" 14 "Reserved" 13 "Reserved" 12 "Reserved" 11 "Reserved" 10 "Reserved" 9 "Reserved" 8 "Reserved" 7 "Primary Not Returned" 6 "Half Latched Not Returned" 5 "Opened Not Returned" 4 "Full latched Not Returned" 3 "Primary Returned" 2 "Half Latched Returned" 1 "Opened Returned" 0 "Full latched Returned" ;
VAL_ 208 VDCM_VirtualAccrPedPstn_Valid 1 "Valid" 0 "Invalid" ;
VAL_ 208 VDCM_AccrPedPstn_Valid 1 "Valid" 0 "Invalid" ;
VAL_ 208 VDCM_ActlGear 7 "Reserved" 6 "Reserved" 5 "Reserved" 4 "Reserved" 3 "D" 2 "N" 1 "R" 0 "P" ;
VAL_ 208 VDCM_ActlGear_Valid 1 "Valid" 0 "Invalid" ;
VAL_ 208 VDCM_DriveSwitchPosition 3 "Reserved" 2 "Four wheel Driven" 1 "Rear Driven" 0 "Front  Driven" ;
VAL_ 208 VDCM_BrakeSw_St 1 "Press" 0 "No Press" ;
VAL_ 208 VDCM_BrakeFluidWarning_St 1 "Warning" 0 "Normal" ;
VAL_ 208 VDCM_FrontBrakePadWarning_St 1 "Warning" 0 "Normal" ;
VAL_ 208 VDCM_RearBrakePadWarning_St 1 "Warning" 0 "Normal" ;
VAL_ 208 VDCM_BrakeSwStValid 1 "Valid" 0 "Invalid" ;
VAL_ 220 VDCM_Ready 1 "Ready" 0 "Not Ready" ;
VAL_ 220 VDCM_HighVoltage_St 3 "Reserved" 2 "Reserved" 1 "Yes" 0 "No" ;
VAL_ 663 VDCM_BookingCharge_St 7 "Reserved" 6 "Reserved" 5 "Reserved" 4 "Charging Fault" 3 "Charging Complete" 2 "Charging" 1 "Charging Pending" 0 "None" ;
VAL_ 663 VDCM_BookingChargeStopReason 7 "Reserved" 6 "Reserved" 5 "Fault" 4 "ByCMD" 3 "SOC" 2 "Charging timeout" 1 "Charging complete" 0 "None" ;
VAL_ 663 VDCM_BookingChargeAvailable_St_OnlyForIV2 1 "Available" 0 "Not available" ;
VAL_ 663 VDCM_ExclusiveChargePileContact_St 1 "Connected" 0 "Not connected" ;
VAL_ 663 VDCM_TravelChargePileContact_St 1 "Connected" 0 "Not connected" ;
VAL_ 663 VDCM_RegenAvaible_Status 1 "Avaiable" 0 "No Avaiable" ;
VAL_ 663 VDCM_CreepModeSet_Rsp_OnlyForIV2 3 "Invalid" 2 "Reserved" 1 "Active" 0 "Inactive" ;
VAL_ 663 VDCM_PullOver_St 1 "Active" 0 "No Active" ;
VAL_ 663 VDCM_HighVoltageWarning_St 1 "Active" 0 "No Active" ;
VAL_ 663 VDCM_HVOffConfirmRequest 1 "Request confirm" 0 "None" ;
VAL_ 663 VDCM_ServiceReminder_St 1 "Active" 0 "No Active" ;
VAL_ 663 VDCM_LowVoltagePowerNetFault_OnlyForIV2 15 "Reserved" 14 "Reserved" 13 "Reserved" 12 "Reserved" 11 "Reserved" 10 "Reserved" 9 "Reserved" 8 "Reserved" 7 "Reserved" 6 "Shortcut Fault" 5 "Under Voltage Fault" 4 "Over Voltage Fault" 3 "E-Relay Fault" 2 "Rear battery fault" 1 "Main Battery Fault" 0 "No Fault" ;
VAL_ 663 VDCM_LowVoltageSystemError 1 "Error" 0 "Normal" ;
VAL_ 663 VDCM_CreepSetAvailable_St 1 "Available" 0 "Not Available" ;
VAL_ 663 VDCM_CreepSet_Rsp 1 "ON" 0 "OFF" ;
VAL_ 663 VDCM_PTSystemFault_OnlyForIV2 1 "Fault" 0 "No Fault" ;
VAL_ 663 VDCM_AbnormalShiftInfo 15 "reserved" 14 "reserved" 13 "reserved" 12 "reserved" 11 "reserved" 10 "reserved" 9 "reserved" 8 "reserved" 7 "reserved" 6 "Shifting not allowed in current vehicle mode" 5 "EPB not locked, current gear is N" 4 "Switching out of P when brake pedal is not applied" 3 "Switching to P when vehicle is running" 2 "D switch to R when vehicle is running" 1 "R switch to D when vehicle is running" 0 "Normal" ;
VAL_ 663 VDCM_AntiTheft 7 "Invalid" 6 "Reserved" 5 "Reserved" 4 "L2 Fail，L3 Pass" 3 "L2 Pass，L3 Fail" 2 "L2&L3 Fail" 1 "L2&L3 pass" 0 "Inactive" ;
VAL_ 663 VDCM_LimpHomeRemind_OnlyForIV2 1 "Limp Home" 0 "Normal" ;
VAL_ 663 VDCM_HighVItgInterlockFault 1 "Fault" 0 "No Fault" ;
VAL_ 663 VDCM_ChargeCon_St_OnlyForIV2 7 "Reserved" 6 "Reserved" 5 "Reserved" 4 "Reserved" 3 "Invalid" 2 "Connect Abnormal" 1 "Connected" 0 "No Connect" ;
VAL_ 663 VDCM_ThermalRunawayWarn_St 1 "Active" 0 "Inactive" ;
VAL_ 663 VDCM_PLCUFault_St 1 "Fault" 0 "Normal" ;
VAL_ 663 VDCM_PTSystemFault 1 "Fault" 0 "No Fault" ;
VAL_ 663 VDCM_DisplaySOC 255 "Invalid" ;
VAL_ 663 VDCM_AverageEnergyConsume 4095 "Invalid" ;
VAL_ 663 VDCM_ChargeCon_St 7 "Reserved" 6 "Reserved" 5 "Reserved" 4 "Reserved" 3 "Invalid" 2 "Connect Abnormal" 1 "Connected" 0 "No Connect" ;
VAL_ 663 VDCM_LimpHomeRemind 1 "Limp Home" 0 "Normal" ;
VAL_ 663 VDCM_InstantEnergyConsume 4095 "Invalid" ;
VAL_ 663 VDCM_EGSMFault 1 "Fault" 0 "Normal" ;
VAL_ 663 VDCM_CampingModeSOC_Rsp 1023 "Invalid" ;
VAL_ 663 VDCM_RegenSettingPercent_Rsp 255 "Invalid" ;
VAL_ 663 VDCM_ValetModeMaxSpeedLimit_St 1 "Active" 0 "Inactive" ;
VAL_ 663 VDCM_CampingMode_Rsp 1 "Active" 0 "Inactive" ;
VAL_ 663 VDCM_DischargeRemainTime 4095 "Invalid" ;
VAL_ 663 VDCM_ACHeatLiquidCircuitLackWarn 3 "Reserved" 2 "Reserved" 1 "Warning" 0 "No Warning" ;
VAL_ 663 VDCM_PTThermalLiquidCircuitLackWarn 3 "Reserved" 2 "Reserved" 1 "Warning" 0 "No Warning" ;
VAL_ 663 VDCM_TractionModeAvailable_St 3 "Reserved" 2 "Reserved" 1 "Available" 0 "Not Available" ;
VAL_ 663 VDCM_TractionModeSetting_Rsp 3 "Invalid" 2 "Reserved" 1 "Active" 0 "Inactive" ;
VAL_ 540 VDCM_DriveLimpSpdLmt_Status 1 "Active" 0 "No Active" ;
VAL_ 540 VDCM_DriveLimpPwrLmt_Status_OnlyForIV2 1 "Active" 0 "No Active" ;
VAL_ 540 VDCM_DriveLimpCnstSpd_Status 1 "Active" 0 "No Active" ;
VAL_ 540 VDCM_DriveConflictRemindInfo 15 "Reserved" 14 "Reserved" 13 "Reserved" 12 "Reserved" 11 "Reserved" 10 "Reserved" 9 "Reserved" 8 "Reserved" 7 "Reserved" 6 "Reserved" 5 "Reserved" 4 "Reserved" 3 "Reserved" 2 "行车请挂如D/R档" 1 "Try to drive the car when charging connecor is connected" 0 "Normal" ;
VAL_ 222 VDCM_PTAvailableforADAS_St 7 "Reserved" 6 "Reserved" 5 "Reserved" 4 "PT emergency shutdown" 3 "PT fault torque control" 2 "PT fault torque limit" 1 "PT energy shortage" 0 "Normal" ;
VAL_ 244 VDCM_OffroadMode_St 1 "Active" 0 "Inactive" ;
VAL_ 244 VDCM_SWSDisable_St 1 "Available" 0 "Not available" ;
VAL_ 244 VDCM_DMSVehicleModeInfo 15 "Invalid" 14 "Reserved" 13 "Reserved" 12 "Reserved" 11 "Reserved" 10 "Reserved" 9 "Reserved" 8 "Reserved" 7 "Auto" 6 "Offroad" 5 "Soft sand" 4 "winter" 3 "Individual" 2 "Sport" 1 "Comfort" 0 "ECO" ;
VAL_ 244 VDCM_DMSModeChangeEnable 1 "Enable" 0 "Disable" ;
VAL_ 244 VDCM_DMSPTModeInfo 7 "Invalid" 6 "Reserved" 5 "Reserved" 4 "Reserved" 3 "Reserved" 2 "Sport" 1 "Comfort" 0 "Standard" ;
VAL_ 244 VDCM_FaultLevel 7 "Reserved" 6 "Reserved" 5 "Reserved" 4 "Fault Level 4" 3 "Fault Level 3" 2 "Fault Level 2" 1 "Fault Level 1" 0 "No Fault" ;
VAL_ 244 VDCM_AirSOffRoadExitCommand 1 "Command" 0 "No command" ;
VAL_ 244 VDCM_AirSOffRoadAvaliability 1 "Available" 0 "Not available" ;
VAL_ 244 VDCM_ProtocolVersion 3 "Reserved" 2 "PPV" 1 "NCT" 0 "IV2" ;
VAL_ 244 VDCM_PowernetLowVoltageFault 255 "Reserved" 254 "Reserved" 253 "Reserved" 252 "Reserved" 251 "Reserved" 250 "Reserved" 249 "Reserved" 248 "Reserved" 247 "Reserved" 246 "Reserved" 245 "Reserved" 244 "Reserved" 243 "Reserved" 242 "Reserved" 241 "Reserved" 240 "Reserved" 239 "Reserved" 238 "Reserved" 237 "Reserved" 236 "Reserved" 235 "Reserved" 234 "Reserved" 233 "Reserved" 232 "Reserved" 231 "Reserved" 230 "Reserved" 229 "Reserved" 228 "Reserved" 227 "Reserved" 226 "Reserved" 225 "Reserved" 224 "Reserved" 223 "Reserved" 222 "Reserved" 221 "Reserved" 220 "Reserved" 219 "Reserved" 218 "Reserved" 217 "Reserved" 216 "Reserved" 215 "Reserved" 214 "Reserved" 213 "Reserved" 212 "Reserved" 211 "Reserved" 210 "Reserved" 209 "Reserved" 208 "Reserved" 207 "Reserved" 206 "Reserved" 205 "Reserved" 204 "Reserved" 203 "Reserved" 202 "Reserved" 201 "Reserved" 200 "Reserved" 199 "Reserved" 198 "Reserved" 197 "Reserved" 196 "Reserved" 195 "Reserved" 194 "Reserved" 193 "Reserved" 192 "Reserved" 191 "Reserved" 190 "Reserved" 189 "Reserved" 188 "Reserved" 187 "Reserved" 186 "Reserved" 185 "Reserved" 184 "Reserved" 183 "Reserved" 182 "Reserved" 181 "Reserved" 180 "Reserved" 179 "Reserved" 178 "Reserved" 177 "Reserved" 176 "Reserved" 175 "Reserved" 174 "Reserved" 173 "Reserved" 172 "Reserved" 171 "Reserved" 170 "Reserved" 169 "Reserved" 168 "Reserved" 167 "Reserved" 166 "Reserved" 165 "Reserved" 164 "Reserved" 163 "Reserved" 162 "Reserved" 161 "Reserved" 160 "Reserved" 159 "Reserved" 158 "Reserved" 157 "Reserved" 156 "Reserved" 155 "Reserved" 154 "Reserved" 153 "Reserved" 152 "Reserved" 151 "Reserved" 150 "Reserved" 149 "Reserved" 148 "Reserved" 147 "Reserved" 146 "Reserved" 145 "Reserved" 144 "Reserved" 143 "Reserved" 142 "Reserved" 141 "Reserved" 140 "Reserved" 139 "Reserved" 138 "Reserved" 137 "Reserved" 136 "Reserved" 135 "Reserved" 134 "Reserved" 133 "Reserved" 132 "Reserved" 131 "Reserved" 130 "Reserved" 129 "Reserved" 128 "Reserved" 127 "Reserved" 126 "Reserved" 125 "Reserved" 124 "Reserved" 123 "Reserved" 122 "Reserved" 121 "Reserved" 120 "Reserved" 119 "Reserved" 118 "Reserved" 117 "Reserved" 116 "Reserved" 115 "Reserved" 114 "Reserved" 113 "Reserved" 112 "Reserved" 111 "Reserved" 110 "Reserved" 109 "Reserved" 108 "Reserved" 107 "Reserved" 106 "Reserved" 105 "Reserved" 104 "Reserved" 103 "Reserved" 102 "Reserved" 101 "Reserved" 100 "Reserved" 99 "Reserved" 98 "Reserved" 97 "Reserved" 96 "Reserved" 95 "Reserved" 94 "Reserved" 93 "Reserved" 92 "Reserved" 91 "Reserved" 90 "Reserved" 89 "Reserved" 88 "Reserved" 87 "Reserved" 86 "Reserved" 85 "Reserved" 84 "Reserved" 83 "Reserved" 82 "Reserved" 81 "Reserved" 80 "Reserved" 79 "Reserved" 78 "Reserved" 77 "Reserved" 76 "Reserved" 75 "Reserved" 74 "Reserved" 73 "Reserved" 72 "Reserved" 71 "Reserved" 70 "Reserved" 69 "Reserved" 68 "Reserved" 67 "Reserved" 66 "Reserved" 65 "Reserved" 64 "Reserved" 63 "Reserved" 62 "Reserved" 61 "Reserved" 60 "Reserved" 59 "Reserved" 58 "Reserved" 57 "Reserved" 56 "Reserved" 55 "Reserved" 54 "Reserved" 53 "Reserved" 52 "Reserved" 51 "Reserved" 50 "Reserved" 49 "Reserved" 48 "Reserved" 47 "Reserved" 46 "Reserved" 45 "Reserved" 44 "Reserved" 43 "Reserved" 42 "Reserved" 41 "Reserved" 40 "Reserved" 39 "Reserved" 38 "Reserved" 37 "Reserved" 36 "Reserved" 35 "Reserved" 34 "Reserved" 33 "Reserved" 32 "Reserved" 31 "Reserved" 30 "Reserved" 29 "Reserved" 28 "Reserved" 27 "Reserved" 26 "Reserved" 25 "Reserved" 24 "Reserved" 23 "Reserved" 22 "Reserved" 21 "Reserved" 20 "Reserved" 19 "Reserved" 18 "Reserved" 17 "Rear Battery Failure" 16 "Front battery failure" 15 "Rear EBS failure" 14 "front EBS failure" 13 "E-relay internal failure" 12 "No communication to E-relay" 11 "No communication to rear EBS" 10 "No communication to front EBS" 9 "Short Circuit backup powernet" 8 "short circuit main powernet" 7 "Under voltage backup powernet" 6 "Under voltage main powernet" 5 "Over Voltage backup powernet" 4 "Over Voltage main powernet" 3 "E-relay Over Temperature" 2 "Over Current backup powernet" 1 "Over Current main powernet" 0 "No Error" ;
VAL_ 244 VDCM_PowernetWarning_St 3 "Reserved" 2 "Critical Failure (Red Warning)" 1 "Non-critical Failure (Yellow Warning)" 0 "No Failure" ;
VAL_ 232 BMS_Current 65535 "Invalid" ;
VAL_ 232 BMS_BatteryVoltage 4095 "Invalid" ;
VAL_ 232 BMS_HVBusVoltage 4095 "Invalid" ;
VAL_ 232 BMS_FastChargeConnector_St 3 "Reserved" 2 "Abnormal" 1 "Connected" 0 "No Connected" ;
VAL_ 232 BMS_DCCharge_St 3 "Charge Fault" 2 "Charge Completed" 1 "Charging" 0 "Not Charge" ;
VAL_ 232 BMS_ACCharge_St 3 "Charge Fault" 2 "Charge Completed" 1 "Charging" 0 "Not Charge" ;
VAL_ 232 BMS_V2L_Req 3 "Reserved" 2 "Invalid" 1 "Request" 0 "No Request" ;
VAL_ 232 BMS_CC2_St_OnlyForIV2 1 "Connected" 0 "No Connected" ;
VAL_ 232 BMS_UnderTemp_Err 1 "Error" 0 "No Error" ;
VAL_ 232 BMS_ChargerPowerSupplyMode_St 1 "Active" 0 "None" ;
VAL_ 232 OBC_ACVltg 511 "Invalid" ;
VAL_ 232 OBC_ACCurrent 1023 "Invalid" ;
VAL_ 232 BMS_ProtocolVersion 3 "Reserved" 2 "PPV" 1 "NCT" 0 "IV2" ;
VAL_ 232 VDCM_FD_RT_4_BMS_Available_St 3 "Reserved" 2 "Reserved" 1 "Not available" 0 "Available" ;
VAL_ 232 VDCM_FD_RT_4_IPEU_Available_St 3 "Reserved" 2 "Reserved" 1 "Not available" 0 "Available" ;
VAL_ 232 VDCM_FD_RT_4_ADCM_Available_St 3 "Reserved" 2 "Reserved" 1 "Not available" 0 "Available" ;
VAL_ 232 ADCM_BU_Pilot_Warn_St 15 "Reserved" 14 "Reserved" 13 "Reserved" 12 "Reserved" 11 "Reserved" 10 "Reserved" 9 "Reserved" 8 "Reserved" 7 "Reserved" 6 "Override warning" 5 "Safe stop warning" 4 "Take over warning" 3 "Attention Warning" 2 "Unable to active" 1 "Cancel Warning" 0 "No warning" ;
VAL_ 648 BMS_RemainChargeTime 4095 "Invalid" ;
VAL_ 648 ACM_InvehicleTemp 255 "Invalid" ;
VAL_ 648 ACM_EnvironmentTemp 255 "Invalid" ;
VAL_ 648 BMS_SOCReal 1023 "Invalid" ;
VAL_ 648 BMS_SOCDisplay 1023 "Invalid" ;
VAL_ 648 VDCM_FD_RT_5_BMS_Available_St 3 "Reserved" 2 "Reserved" 1 "Not available" 0 "Available" ;
VAL_ 648 VDCM_FD_RT_5_ACM_Available_St 3 "Reserved" 2 "Reserved" 1 "Not available" 0 "Available" ;
VAL_ 648 VDCM_FD_RT_5_IPEU_Available_St 3 "Reserved" 2 "Reserved" 1 "Not available" 0 "Available" ;
VAL_ 648 OBC_ACDischarge_St 3 "Invalid" 2 "Discharing failure" 1 "Discharing" 0 "Not Discharing" ;
VAL_ 648 OBC_ACChargerConnect_St 3 "Half Connected" 2 "Abnormal" 1 "Connected" 0 "No Connected" ;
VAL_ 648 OBC_ACChargerConnectSt_Valid 1 "Valid" 0 "Invalid" ;
VAL_ 648 BMS_ACDischarge_St 7 "Invalid" 6 "Reserved" 5 "Reserved" 4 "Reserved" 3 "Discharging completed" 2 "Discharing failure" 1 "Discharing" 0 "Not Discharing" ;
VAL_ 648 OBC_ACChargerMode 15 "Reserved" 14 "Reserved" 13 "Reserved" 12 "Reserved" 11 "Reserved" 10 "Reserved" 9 "Reserved" 8 "Reserved" 7 "Abnormal Charger" 6 "Discharge32A" 5 "Discharge16A" 4 "Charge63A" 3 "Charge32A" 2 "Charge16A" 1 "Charge10A" 0 "Unconnected" ;
VAL_ 648 BMS_VehicleDischargeAbortReason 7 "Reserved" 6 "Reserved" 5 "Reserved" 4 "Reserved" 3 "Fault" 2 "ByCommand" 1 "SOC" 0 "None" ;
VAL_ 648 OBC_DischargeAbortReason 7 "Reserved" 6 "Reserved" 5 "Internal Fault" 4 "Over Temperature" 3 "HV UnderVoltage" 2 "HV Power Insufficient" 1 "Over Load" 0 "None" ;
VAL_ 648 OBC_ACSocketLock_St 7 "Reserved" 6 "Reserved" 5 "Lock Fault" 4 "Unlock Fault" 3 "Locked" 2 "Reserved" 1 "Unlocked" 0 "Default" ;
VAL_ 648 BMS_FaultLevel 15 "Reserved" 14 "Reserved" 13 "Reserved" 12 "Reserved" 11 "Reserved" 10 "Reserved" 9 "Reserved" 8 "Reserved" 7 "Reserved" 6 "Reserved" 5 "Reserved" 4 "Fault Level 4" 3 "Fault Level 3" 2 "Fault Level 2" 1 "Fault Level 1" 0 "No Fault" ;
VAL_ 648 BMS_Isolation_Err 3 "Reserved" 2 "Isolation Low Level2" 1 "Isolation Low Level1" 0 "No Error" ;
VAL_ 648 BMS_CellOverVoltage 1 "Fault" 0 "Not fault" ;
VAL_ 648 BMS_CellUnderVoltage 1 "Fault" 0 "Not fault" ;
VAL_ 648 IPEU_DischargerConnectSt 3 "Half Connected" 2 "Connect Abnormal" 1 "Connected" 0 "No Connect" ;
VAL_ 648 IPEU_DischargerConnectSt_Valid 1 "Valid" 0 "Invalid" ;
VAL_ 648 BMS_CellOverTemp 1 "Fault" 0 "Not fault" ;
VAL_ 648 DCDC_ErrorLevel 7 "Reserved" 6 "Reserved" 5 "Reserved" 4 "Fault Level 4" 3 "Fault Level 3" 2 "Fault Level 2" 1 "Fault Level 1" 0 "No Fault" ;
VAL_ 648 BMS_SOCLow 1 "Fault" 0 "No Fault" ;
VAL_ 648 BMS_SOCHigh 1 "Fault" 0 "No Fault" ;
VAL_ 648 IPEU_OverTemp 1 "Warning" 0 "Normal" ;
VAL_ 648 EBS_F_U_BATT 16383 "Invalid" ;
VAL_ 648 EBS_F_St_Vltg 3 "LIN saturation (no HW defect)" 2 "HW defect (ADC defect)" 1 "Error Open circuit" 0 "No error" ;
VAL_ 648 VDCM_VehicleTotalMileageBackup 16777215 "Invalid" ;
VAL_ 653 ACM_FragSwitchEN_Rsp 3 "Reserved" 2 "Enable" 1 "Disable" 0 "Default" ;
VAL_ 653 ACM_FragChannel1Switch_St 3 "Invalid" 2 "Open" 1 "Close" 0 "Default" ;
VAL_ 653 ACM_FragChannel2Switch_St 3 "Invalid" 2 "Open" 1 "Close" 0 "Default" ;
VAL_ 653 ACM_FragChannel3Switch_St 3 "Invalid" 2 "Open" 1 "Close" 0 "Default" ;
VAL_ 653 ACM_FragConcLevel_Rsp 7 "Reserved" 6 "Reserved" 5 "Reserved" 4 "Reserved" 3 "Density3" 2 "Density2" 1 "Density1" 0 "Default" ;
VAL_ 653 ACM_FrontACMode_St 7 "Reserved" 6 "Reserved" 5 "Reserved" 4 "Defrost" 3 "FootDefrost" 2 "Foot" 1 "FaceFoot" 0 "Face" ;
VAL_ 653 ACM_InOutLoopMode_St 3 "Reserved" 2 "Auto Inside and outside Loop" 1 "Outside Loop" 0 "Inside Loop" ;
VAL_ 653 ACM_DriveTempSet_St 33 "High" 32 "31℃" 31 "30.5℃" 30 "30℃" 29 "29.5℃" 28 "29℃" 27 "28.5℃" 26 "28℃" 25 "27.5℃" 24 "27℃" 23 "26.5℃" 22 "26℃" 21 "25.5℃" 20 "25℃" 19 "24.5℃" 18 "24℃" 17 "23.5℃" 16 "23℃" 15 "22.5℃" 14 "22℃" 13 "21.5℃" 12 "21℃" 11 "20.5℃" 10 "20℃" 9 "19.5℃" 8 "19℃" 7 "18.5℃" 6 "18℃" 5 "17.5℃" 4 "17℃" 3 "16.5℃" 2 "16℃" 1 "Low" 0 "Deafult" ;
VAL_ 653 ACM_TempAreaSync_St 3 "Reserved" 2 "Active" 1 "Deactive" 0 "Default" ;
VAL_ 653 ACM_PassengerTempSet_St 33 "High" 32 "31℃" 31 "30.5℃" 30 "30℃" 29 "29.5℃" 28 "29℃" 27 "28.5℃" 26 "28℃" 25 "27.5℃" 24 "27℃" 23 "26.5℃" 22 "26℃" 21 "25.5℃" 20 "25℃" 19 "24.5℃" 18 "24℃" 17 "23.5℃" 16 "23℃" 15 "22.5℃" 14 "22℃" 13 "21.5℃" 12 "21℃" 11 "20.5℃" 10 "20℃" 9 "19.5℃" 8 "19℃" 7 "18.5℃" 6 "18℃" 5 "17.5℃" 4 "17℃" 3 "16.5℃" 2 "16℃" 1 "Low" 0 "Deafult" ;
VAL_ 653 ACM_ACOperateMode_St 3 "Reserved" 2 "Reserved" 1 "Economy" 0 "Comfort" ;
VAL_ 653 ACM_FrontACAirFlowLevel_St 15 "Reserved" 14 "Reserved" 13 "Reserved" 12 "Reserved" 11 "Reserved" 10 "Level_10" 9 "Level_9" 8 "Level_8" 7 "Level_7" 6 "Level_6" 5 "Level_5" 4 "Level_4" 3 "Level_3" 2 "Level_2" 1 "Level_1" 0 "Default" ;
VAL_ 653 ACM_RearACAirFlowLevel_St 15 "Reserved" 14 "Reserved" 13 "Reserved" 12 "Reserved" 11 "Reserved" 10 "Reserved" 9 "Reserved" 8 "Level_8" 7 "Level_7" 6 "Level_6" 5 "Level_5" 4 "Level_4" 3 "Level_3" 2 "Level_2" 1 "Level_1" 0 "Default" ;
VAL_ 653 ACM_RearRowTempSet_St 33 "High" 32 "31℃" 31 "30.5℃" 30 "30℃" 29 "29.5℃" 28 "29℃" 27 "28.5℃" 26 "28℃" 25 "27.5℃" 24 "27℃" 23 "26.5℃" 22 "26℃" 21 "25.5℃" 20 "25℃" 19 "24.5℃" 18 "24℃" 17 "23.5℃" 16 "23℃" 15 "22.5℃" 14 "22℃" 13 "21.5℃" 12 "21℃" 11 "20.5℃" 10 "20℃" 9 "19.5℃" 8 "19℃" 7 "18.5℃" 6 "18℃" 5 "17.5℃" 4 "17℃" 3 "16.5℃" 2 "16℃" 1 "Low" 0 "Deafult" ;
VAL_ 653 ACM_AutoDefrostSet_St 3 "Reserved" 2 "Active" 1 "Deactive" 0 "Default" ;
VAL_ 653 ACM_RearACMode_St 7 "Reserved" 6 "Reserved" 5 "Reserved" 4 "Reserved" 3 "Reserved" 2 "Foot" 1 "FaceFoot" 0 "Face" ;
VAL_ 653 ACM_IONSet_St 3 "Reserved" 2 "Active" 1 "Deactive" 0 "Default" ;
VAL_ 653 ACM_ConsumeMileagePredict 255 "Invalid" ;
VAL_ 653 ACM_ConsumeDriveTimePredict 255 "Invalid" ;
VAL_ 653 ACM_AQSAirQuality_St 15 "Reserved" 14 "Reserved" 13 "Reserved" 12 "Reserved" 11 "Reserved" 10 "Luft Stark" 9 "Luftguete 90%" 8 "Luftguete 80%" 7 "Luftguete 70%" 6 "Luftguete 60%" 5 "Luftguete 50%" 4 "Luftguete 40%" 3 "Luftguete 30%" 2 "Luftguete 20%" 1 "Luftguete 10%" 0 "Default" ;
VAL_ 653 ACM_PM25Set_St 3 "Reserved" 2 "Active" 1 "Deactive" 0 "Default" ;
VAL_ 653 ACM_AQSSet_St 3 "Reserved" 2 "Active" 1 "Deactive" 0 "Default" ;
VAL_ 653 ACM_HepaActive 3 "Reserved" 2 "Active" 1 "Deactive" 0 "Default" ;
VAL_ 653 ACM_ACSt_St 3 "Reserved" 2 "Active" 1 "Deactive" 0 "Default" ;
VAL_ 653 ACM_FragChannel1Type 15 "Invalid" 14 "Flavour15" 13 "Flavour14" 12 "Flavour13" 11 "Flavour12" 10 "Flavour11" 9 "Flavour10" 8 "Flavour9" 7 "Flavour8" 6 "Flavour7" 5 "Flavour6" 4 "Flavour5" 3 "Flavour4" 2 "Flavour3" 1 "Flavour2" 0 "Flavour1" ;
VAL_ 653 ACM_FragChannel2Type 15 "Invalid" 14 "Flavour15" 13 "Flavour14" 12 "Flavour13" 11 "Flavour12" 10 "Flavour11" 9 "Flavour10" 8 "Flavour9" 7 "Flavour8" 6 "Flavour7" 5 "Flavour6" 4 "Flavour5" 3 "Flavour4" 2 "Flavour3" 1 "Flavour2" 0 "Flavour1" ;
VAL_ 653 ACM_FragChannel3Type 15 "Invalid" 14 "Flavour15" 13 "Flavour14" 12 "Flavour13" 11 "Flavour12" 10 "Flavour11" 9 "Flavour10" 8 "Flavour9" 7 "Flavour8" 6 "Flavour7" 5 "Flavour6" 4 "Flavour5" 3 "Flavour4" 2 "Flavour3" 1 "Flavour2" 0 "Flavour1" ;
VAL_ 653 ACM_InFilterLifeRemind 15 "Reserved" 14 "Reserved" 13 "Reserved" 12 "Reserved" 11 "Reserved" 10 "Reserved" 9 "Reserved" 8 "30day" 7 "20day" 6 "10day" 5 "5day" 4 "3day" 3 "2day" 2 "1day" 1 "0day" 0 "Default" ;
VAL_ 653 ACM_OutsideFilterLifeRemind 15 "Reserved" 14 "Reserved" 13 "Reserved" 12 "Reserved" 11 "Reserved" 10 "Reserved" 9 "Reserved" 8 "30day" 7 "20day" 6 "10day" 5 "5day" 4 "3day" 3 "2day" 2 "1day" 1 "0day" 0 "Default" ;
VAL_ 653 ACM_FrontACSwitch_Rsp 3 "Reserved" 2 "Open" 1 "Close" 0 "Default" ;
VAL_ 653 ACM_RearACSwitch_Rsp 3 "Reserved" 2 "Open" 1 "Close" 0 "Default" ;
VAL_ 653 ACM_FrontACAuto_Rsp 3 "Reserved" 2 "Open" 1 "Close" 0 "Default" ;
VAL_ 653 ACM_RearACAuto_Rsp 3 "Reserved" 2 "Open" 1 "Close" 0 "Default" ;
VAL_ 653 ACM_FrontDeiceDefrost_Rsp 3 "Reserved" 2 "Open" 1 "Close" 0 "Default" ;
VAL_ 653 VDCM_FD_RT_6_ACM_Available_St 3 "Reserved" 2 "Reserved" 1 "Not available" 0 "Available" ;
VAL_ 938 VDCM_FD_RT_9_BMS_Available_St 3 "Reserved" 2 "Reserved" 1 "Not available" 0 "Available" ;
VAL_ 938 BMS_SOE 4095 "Invalid" ;
VAL_ 527 IFV300_Pilot_Warning_St 15 "Reserved" 14 "Reserved" 13 "Reserved" 12 "Reserved" 11 "Reserved" 10 "Reserved" 9 "Reserved" 8 "Reserved" 7 "Reserved" 6 "Override warning" 5 "Safe stop warning" 4 "Take over warning" 3 "Attention Warning" 2 "Unable to active" 1 "Cancel Warning" 0 "No warning" ;
VAL_ 527 IFV300_CameraBlocked 1 "Blocked" 0 "Not Blocked" ;
VAL_ 527 IFV300_CameraCalibratinSts 1 "Calibration Failed" 0 "Calibration Success" ;
VAL_ 527 IFV300_CamreaFailureSts 1 "Failure" 0 "No Failure" ;
VAL_ 527 VDCM_FD_RT_11_IFV300_Available_St 3 "Reserved" 2 "Reserved" 1 "Not available" 0 "Available" ;
VAL_ 224 MCUF_ActOutputTq 2047 "Invalid" ;
VAL_ 224 MCUF_Speed 65535 "Invalid" ;
VAL_ 224 MCUF_ErrSt 7 "Reserved" 6 "Reserved" 5 "Reserved" 4 "Fault Level 4" 3 "Fault Level 3" 2 "Fault Level 2" 1 "Fault Level 1" 0 "No Fault" ;
VAL_ 224 MCUF_InverterOverTemp 1 "Over Temp" 0 "Normal" ;
VAL_ 224 MCUF_MotorOverTemp 1 "Over Temp" 0 "Normal" ;
VAL_ 658 MCUF_ElectricMachineTemp 255 "Invalid" ;
VAL_ 658 MCUF_InverterTemp 255 "Invalid" ;
VAL_ 658 MCUF_TractionModeSetting_Rsp 3 "Invalid" 2 "Reserved" 1 "Active" 0 "Inactive" ;
VAL_ 225 MCUR_ActOutputTq 2047 "Invalid" ;
VAL_ 225 MCUR_Speed 65535 "Invalid" ;
VAL_ 225 MCUR_ErrSt 7 "Reserved" 6 "Reserved" 5 "Reserved" 4 "Fault Level 4" 3 "Fault Level 3" 2 "Fault Level 2" 1 "Fault Level 1" 0 "No Fault" ;
VAL_ 225 MCUR_InverterOverTemp 1 "Over Temp" 0 "Normal" ;
VAL_ 225 MCUR_MotorOverTemp 1 "Over Temp" 0 "Normal" ;
VAL_ 659 MCUR_ElectricMachineTemp 255 "Invalid" ;
VAL_ 659 MCUR_InverterTemp 255 "Invalid" ;
VAL_ 659 MCUR_TractionModeSetting_Rsp 3 "Invalid" 2 "Reserved" 1 "Active" 0 "Inactive" ;
VAL_ 880 TBOX_AbsoluteTime_Year 255 "Invalid" ;
VAL_ 880 TBOX_AbsoluteTime_Month 15 "Invalid" ;
VAL_ 880 TBOX_AbsoluteTime_Day 63 "Invalid" ;
VAL_ 880 TBOX_AbsoluteTime_Hour 31 "Invalid" ;
VAL_ 880 TBOX_AbsoluteTime_Minute 63 "Invalid" ;
VAL_ 880 TBOX_AbsoluteTime_Second 63 "Invalid" ;
VAL_ 378 TBOX_ChargeReservationSource 7 "Reserved" 6 "Reserved" 5 "Reserved" 4 "Reserved" 3 "Reserved" 2 "Reserved" 1 "Reservation Charge" 0 "No Request" ;
VAL_ 378 TBOX_ReservationChargeActive 3 "Reserved" 2 "Reserved" 1 "Active" 0 "No Request" ;
VAL_ 378 TBOX_ReservationChargeEnable 3 "Reserved" 2 "Reserved" 1 "Charging Request" 0 "No Request" ;
VAL_ 378 TBOX_ReservationChargeTimeHour 63 "Invalid" ;
VAL_ 378 TBOX_ReservationChargeTimeMinute 63 "Invalid" ;
VAL_ 378 TBOX_ReservationChargeDurationSet 65535 "Invalid" ;
VAL_ 378 TBOX_ReservationChargCutoffSOCSet 255 "Invalid" ;
VAL_ 378 TBOX_ReservationChargeStopHour 63 "Invalid" ;
VAL_ 378 TBOX_ReservationChargeStopMinute 63 "Invalid" ;
VAL_ 761 TBOX_BluetoothKey1Availability 3 "Reserved" 2 "Not Connected" 1 "Connected" 0 "None" ;
VAL_ 761 TBOX_BluetoothKey1ZoneID 15 "Reserved" 14 "Reserved" 13 "Reserved" 12 "Reserved" 11 "Reserved" 10 "Reserved" 9 "Reserved" 8 "Reserved" 7 "Reserved" 6 "Reserved" 5 "Zone5" 4 "Zone4" 3 "Zone3 (Welcome Zone)" 2 "Zone2 (Unlock the Door)" 1 "Zone1 (In the Car)" 0 "None" ;
VAL_ 761 TBOX_BluetoothKey2ZoneID 15 "Reserved" 14 "Reserved" 13 "Reserved" 12 "Reserved" 11 "Reserved" 10 "Reserved" 9 "Reserved" 8 "Reserved" 7 "Reserved" 6 "Reserved" 5 "Zone5" 4 "Zone4" 3 "Zone3 (Welcome Zone)" 2 "Zone2 (Unlock the Door)" 1 "Zone1 (In the Car)" 0 "None" ;
VAL_ 761 TBOX_VehicleTotalMileageBackup 16777215 "Invalid" ;
VAL_ 761 TBOX_ECall_St 3 "Reserved" 2 "Connected" 1 "Connecting" 0 "Idle" ;
VAL_ 761 TBOX_BLEConnected_St 3 "Reserved" 2 "Connected" 1 "Connecting" 0 "No Request" ;
VAL_ 761 TBOX_BCall_St 3 "Reserved" 2 "Connected" 1 "Connecting" 0 "Idle" ;
VAL_ 761 TBOX_GuardWakeup 3 "Reserved" 2 "Active" 1 "Inactive" 0 "No Request" ;
VAL_ 761 TBOX_AbnormalMoveWakeup 3 "Reserved" 2 "Active" 1 "Inactive" 0 "No Request" ;
VAL_ 761 TBOX_ScratchWakeup 3 "Reserved" 2 "Active" 1 "Inactive" 0 "No Request" ;
VAL_ 761 TBOX_SVTWakeup 3 "Reserved" 2 "Active" 1 "Inactive" 0 "No Request" ;
VAL_ 761 TBOX_CrashWakeup 3 "Reserved" 2 "Active" 1 "Inactive" 0 "No Request" ;
VAL_ 762 TBOX_V2XFrontCollisionWarn_St 3 "Reserved" 2 "Yes" 1 "No" 0 "No Command" ;
VAL_ 762 TBOX_V2XFrontCollisionWarn_Direction 15 "Reserved" 14 "Reserved" 13 "Reserved" 12 "Reserved" 11 "Reserved" 10 "Reserved" 9 "Reserved" 8 "Reserved" 7 "Reserved" 6 "Reserved" 5 "Reserved" 4 "Reserved" 3 "Reserved" 2 "Reserved" 1 "Front" 0 "No Command" ;
VAL_ 762 TBOX_V2XFrontCollisionWarn_AlarmLevel 3 "Imminent" 2 "Advisory" 1 "Inform" 0 "No Command" ;
VAL_ 762 TBOX_V2XFrontCollisionWarn_Distance 255 "Invalid" ;
VAL_ 762 TBOX_V2XIntersectionCollisionWarn_St 3 "Reserved" 2 "Yes" 1 "No" 0 "No Command" ;
VAL_ 762 TBOX_V2XIntersectionCollisionWarn_Direction 15 "Reserved" 14 "Reserved" 13 "Reserved" 12 "Reserved" 11 "Reserved" 10 "Reserved" 9 "Reserved" 8 "Reserved" 7 "Reserved" 6 "Reserved" 5 "Reserved" 4 "Reserved" 3 "Reserved" 2 "Right Side" 1 "Left Side" 0 "No Command" ;
VAL_ 762 TBOX_V2XIntersectionCollisionWarn_AlarmLevel 3 "Imminent" 2 "Advisory" 1 "Inform" 0 "No Command" ;
VAL_ 762 TBOX_V2XIntersectionCollisionWarn_Distance 255 "Invalid" ;
VAL_ 762 TBOX_V2XTurnLeftAssist_Distance 255 "Invalid" ;
VAL_ 762 TBOX_V2XTurnLeftAssist_St 3 "Reserved" 2 "Yes" 1 "No" 0 "No Command" ;
VAL_ 762 TBOX_V2XTurnLeftAssist_AlarmLevel 3 "Imminent" 2 "Advisory" 1 "Inform" 0 "No Command" ;
VAL_ 762 TBOX_V2XReverseOvertakeWarn_Distance 255 "Invalid" ;
VAL_ 762 TBOX_V2XReverseOvertakeWarn_St 3 "Reserved" 2 "Yes" 1 "No" 0 "No Command" ;
VAL_ 762 TBOX_V2XReverseOvertakeWarn_AlarmLevel 3 "Imminent" 2 "Advisory" 1 "Inform" 0 "No Command" ;
VAL_ 762 TBOX_V2XEmergencyBrakeWarn_St 3 "Reserved" 2 "Yes" 1 "No" 0 "No Command" ;
VAL_ 762 TBOX_V2XEmergencyBrakeWarn_Direction 15 "Reserved" 14 "Reserved" 13 "Reserved" 12 "Reserved" 11 "Reserved" 10 "Reserved" 9 "Reserved" 8 "Reserved" 7 "Reserved" 6 "Reserved" 5 "Reserved" 4 "Reserved" 3 "Reserved" 2 "Reserved" 1 "Front" 0 "No Command" ;
VAL_ 762 TBOX_V2XEmergencyBrakeWarn_AlarmLevel 3 "Imminent" 2 "Advisory" 1 "Inform" 0 "No Command" ;
VAL_ 762 TBOX_V2XEmergencyBrakeWarn_Distance 255 "Invalid" ;
VAL_ 762 TBOX_V2XAbnormalVehicleWarn_Distance 255 "Invalid" ;
VAL_ 762 TBOX_V2XAbnormalVehicleWarn_St 3 "Reserved" 2 "Yes" 1 "No" 0 "No Command" ;
VAL_ 762 TBOX_V2XAbnormalVehicleWarn_AlarmLevel 3 "Imminent" 2 "Advisory" 1 "Inform" 0 "No Command" ;
VAL_ 762 TBOX_V2XAbnormalVehicleWarn_Angle 1023 "Invalid" ;
