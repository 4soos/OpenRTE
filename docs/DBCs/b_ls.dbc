VERSION ""

NS_ :

BS_:

BU_: IDCM ARC ARHUD WHUD VSP FSE_M CGW

BO_ 568 IDCM_FD_20: 32 IDCM
 SG_ IDCM_FD_20_Checksum1 : 0|8@1+ (1,0) [0|255] ""  CGW
 SG_ IDCM_FD_20_RollingCounter1 : 8|4@1+ (1,0) [0|15] ""  CGW
 SG_ IDCM_FD_20_Reserved1 : 12|4@1+ (1,0) [0|0] ""  CGW
 SG_ IDCM_APAPASVirtualSwitch_St : 16|2@1+ (1,0) [0|3] ""  CGW
 SG_ IDCM_APAPIPOSelect : 18|2@1+ (1,0) [0|3] ""  CGW
 SG_ IDCM_APAFunctionSelectResult : 20|2@1+ (1,0) [0|3] ""  CGW
 SG_ IDCM_APACancel : 22|2@1+ (1,0) [0|3] ""  CGW
 SG_ IDCM_SVSShow_Req : 24|2@1+ (1,0) [0|3] ""  CGW
 SG_ IDCM_SVSBootAnimation_Req : 26|2@1+ (1,0) [0|3] ""  CGW
 SG_ IDCM_SVSMode_Req : 28|2@1+ (1,0) [0|3] ""  CGW
 SG_ IDCM_BasePlateTex_Req : 30|2@1+ (1,0) [0|3] ""  CGW
 SG_ IDCM_ObjectOverlay_Req : 32|2@1+ (1,0) [0|3] ""  CGW
 SG_ IDCM_TrajectoryOverlay_Req : 34|2@1+ (1,0) [0|3] ""  CGW
 SG_ IDCM_PASAcousticWarning_Req : 36|2@1+ (1,0) [0|3] ""  CGW
 SG_ IDCM_IntelligentViewChangeSwitch : 38|2@1+ (1,0) [0|3] ""  CGW
 SG_ IDCM_APAParkslotSelection : 40|3@1+ (1,0) [0|7] ""  CGW
 SG_ IDCM_SVSView_Req : 43|5@1+ (1,0) [0|31] ""  CGW
 SG_ IDCM_DefaultTopview_Req : 48|2@1+ (1,0) [0|3] ""  CGW
 SG_ IDCM_DefaultNormalview_Req : 50|2@1+ (1,0) [0|3] ""  CGW
 SG_ IDCM_SVSBootAnimationSwitch_Req : 54|2@1+ (1,0) [0|3] ""  CGW
 SG_ IDCM_SVSActiveShowOpen_St : 56|2@1+ (1,0) [0|3] ""  CGW
 SG_ IDCM_SVSTopview_Req : 58|2@1+ (1,0) [0|3] ""  CGW
 SG_ IDCM_PMAEBSwitch : 60|2@1+ (1,0) [0|3] ""  CGW
 SG_ IDCM_FD_20_Reserved2 : 62|2@1+ (1,0) [0|0] ""  CGW
 SG_ IDCM_FD_20_Reserved3 : 64|64@1+ (1,0) [0|0] ""  CGW
 SG_ IDCM_FD_20_Reserved4 : 128|64@1+ (1,0) [0|0] ""  CGW
 SG_ IDCM_FD_20_Reserved5 : 192|64@1+ (1,0) [0|0] ""  CGW

BO_ 766 IDCM_FD_21: 32 IDCM
 SG_ IDCM_FrontACSwitch_Cmd : 0|2@1+ (1,0) [0|3] ""  CGW
 SG_ IDCM_FrontDeFrostFog_Cmd : 2|2@1+ (1,0) [0|3] ""  CGW
 SG_ IDCM_FrontAutoAC_Cmd : 4|2@1+ (1,0) [0|3] ""  CGW
 SG_ IDCM_ACCompressorSwitch_Cmd : 6|2@1+ (1,0) [0|3] ""  CGW
 SG_ IDCM_FrontACAirFlowLevel_Cmd : 8|4@1+ (1,0) [0|15] ""  CGW
 SG_ IDCM_TempAreaSynchronization_Cmd : 12|2@1+ (1,0) [0|3] ""  CGW
 SG_ IDCM_AQSSet_Cmd : 14|2@1+ (1,0) [0|3] ""  CGW
 SG_ IDCM_FD_21_Reserved4 : 16|3@1+ (1,0) [0|0] ""  CGW
 SG_ IDCM_FrontACMode_Cmd : 19|3@1+ (1,0) [0|7] ""  CGW
 SG_ IDCM_InOutLoopMode_Cmd : 22|2@1+ (1,0) [0|3] ""  CGW
 SG_ IDCM_DriverTempSet_Cmd : 24|6@1+ (1,0) [0|63] ""  CGW
 SG_ IDCM_PM25Set_Cmd : 30|2@1+ (1,0) [0|3] ""  CGW
 SG_ IDCM_PassengerTempSet_Cmd : 32|6@1+ (1,0) [0|63] ""  CGW
 SG_ IDCM_IONSet_Cmd : 38|2@1+ (1,0) [0|3] ""  CGW
 SG_ IDCM_ACOperationMode_Cmd : 40|2@1+ (1,0) [0|3] ""  CGW
 SG_ IDCM_FD_21_Reserved5 : 42|2@1+ (1,0) [0|0] ""  CGW
 SG_ IDCM_RearACAuto_Cmd : 44|2@1+ (1,0) [0|3] ""  CGW
 SG_ IDCM_RearACSwitch_Cmd : 46|2@1+ (1,0) [0|3] ""  CGW
 SG_ IDCM_RearRowTempSet_Cmd : 48|6@1+ (1,0) [0|63] ""  CGW
 SG_ IDCM_AutoDefrostSet_Cmd : 54|2@1+ (1,0) [0|3] ""  CGW
 SG_ IDCM_FD_21_Reserved6 : 56|3@1+ (1,0) [0|0] ""  CGW
 SG_ IDCM_RearACMode_Cmd : 59|3@1+ (1,0) [0|7] ""  CGW
 SG_ IDCM_InsideFilterReset : 62|2@1+ (1,0) [0|3] ""  CGW
 SG_ IDCM_RearACAirFlowLevel_Cmd : 64|4@1+ (1,0) [0|15] ""  CGW
 SG_ IDCM_InsideFilterLifeRemind : 68|2@1+ (1,0) [0|3] ""  CGW
 SG_ IDCM_AirFragranceSwitchEnable : 70|2@1+ (1,0) [0|3] ""  CGW
 SG_ IDCM_AirFragranceChannel1 : 72|2@1+ (1,0) [0|3] ""  CGW
 SG_ IDCM_AirFragranceChannel2 : 74|2@1+ (1,0) [0|3] ""  CGW
 SG_ IDCM_AirFragranceChannel3 : 76|2@1+ (1,0) [0|3] ""  CGW
 SG_ IDCM_OutsideFilterReset : 78|2@1+ (1,0) [0|3] ""  CGW
 SG_ IDCM_FragranceConcentration_Req : 80|3@1+ (1,0) [0|7] ""  CGW
 SG_ IDCM_OutsideFilterLifeRemind : 83|2@1+ (1,0) [0|3] ""  CGW
 SG_ IDCM_DSMremindwayset : 85|2@1+ (1,0) [0|3] ""  CGW
 SG_ IDCM_FD_21_Reserved1 : 87|41@1+ (1,0) [0|0] ""  CGW
 SG_ IDCM_FD_21_Reserved2 : 128|64@1+ (1,0) [0|0] ""  CGW
 SG_ IDCM_FD_21_Reserved3 : 192|64@1+ (1,0) [0|0] ""  CGW

BO_ 382 IDCM_FD_22: 32 IDCM
 SG_ IDCM_FaceRegister_Req : 0|2@1+ (1,0) [0|3] ""  CGW
 SG_ IDCM_FaceRegisterResponse_St : 2|2@1+ (1,0) [0|3] ""  CGW
 SG_ IDCM_DeleteFaceID_Req : 4|2@1+ (1,0) [0|3] ""  CGW
 SG_ IDCM_FaceRecognition_Req : 6|2@1+ (1,0) [0|3] ""  CGW
 SG_ IDCM_DSMUserID : 8|8@1+ (1,0) [0|255] ""  CGW
 SG_ IDCM_DSMSwitch : 16|2@1+ (1,0) [0|3] ""  CGW
 SG_ IDCM_FD_22_Reserved1 : 18|46@1+ (1,0) [0|0] ""  CGW
 SG_ IDCM_FD_22_Reserved2 : 64|64@1+ (1,0) [0|0] ""  CGW
 SG_ IDCM_FD_22_Reserved3 : 128|64@1+ (1,0) [0|0] ""  CGW
 SG_ IDCM_FD_22_Reserved4 : 192|64@1+ (1,0) [0|0] ""  CGW

BO_ 1011 IDCM_FD_23: 32 IDCM
 SG_ IDCM_DestinationDistance : 0|32@1+ (1,0) [0|9999000] "m"  ARC,WHUD,CGW
 SG_ IDCM_FrontCrossDistance : 32|32@1+ (1,0) [0|10000] "m"  ARC,WHUD,CGW
 SG_ IDCM_FrontCrossName : 64|48@1+ (1,0) [0|0] ""  ARC,WHUD,CGW
 SG_ IDCM_DestinationRemainTime : 112|22@1+ (1,0) [0|3596400] "s"  ARC,WHUD,CGW
 SG_ IDCM_CameraInformation : 134|2@1+ (1,0) [0|3] ""  ARC,WHUD,CGW
 SG_ IDCM_NextCrossDirection : 136|4@1+ (1,0) [0|15] ""  ARC,WHUD,CGW
 SG_ IDCM_TrafficInformation : 140|4@1+ (1,0) [0|15] ""  ARC,WHUD,CGW
 SG_ IDCM_CurrentSpeedLimit : 144|8@1+ (1,0) [0|200] "km/h"  ARC,WHUD,CGW
 SG_ IDCM_SpecialRoad : 152|8@1+ (1,0) [0|255] ""  ARC,WHUD,CGW
 SG_ IDCM_FrontCrossNameLength : 160|10@1+ (1,0) [1|512] ""  ARC,WHUD,CGW
 SG_ IDCM_FrontRoadBacklane : 170|6@1+ (1,0) [0|50] ""  ARC,WHUD,CGW
 SG_ IDCM_FrontRoadFrontlane : 176|6@1+ (1,0) [0|50] ""  ARC,WHUD,CGW
 SG_ IDCM_DestinationReachFlag : 182|2@1+ (1,0) [0|3] ""  ARC,WHUD,CGW
 SG_ IDCM_FrontCrossNameFrameIndex : 184|4@1+ (1,0) [1|15] ""  ARC,WHUD,CGW
 SG_ IDCM_FD_2_Reserved1 : 188|4@1+ (1,0) [0|0] ""  CGW
 SG_ IDCM_FD_2_Reserved2 : 192|64@1+ (1,0) [0|0] ""  CGW

BO_ 383 IDCM_FD_24: 32 IDCM
 SG_ IDCM_FaceEigenvalueData_Length : 0|16@1+ (1,0) [0|65534] ""  CGW
 SG_ IDCM_FaceEigenvalueData_Index : 16|16@1+ (1,0) [0|2341] ""  CGW
 SG_ IDCM_FaceEigenvalueData_Byte1 : 32|8@1+ (1,0) [0|0] ""  CGW
 SG_ IDCM_FaceEigenvalueData_Byte2 : 40|8@1+ (1,0) [0|0] ""  CGW
 SG_ IDCM_FaceEigenvalueData_Byte3 : 48|8@1+ (1,0) [0|0] ""  CGW
 SG_ IDCM_FaceEigenvalueData_Byte4 : 56|8@1+ (1,0) [0|0] ""  CGW
 SG_ IDCM_FaceEigenvalueData_Byte5 : 64|8@1+ (1,0) [0|0] ""  CGW
 SG_ IDCM_FaceEigenvalueData_Byte6 : 72|8@1+ (1,0) [0|0] ""  CGW
 SG_ IDCM_FaceEigenvalueData_Byte7 : 80|8@1+ (1,0) [0|0] ""  CGW
 SG_ IDCM_FaceEigenvalueData_Byte8 : 88|8@1+ (1,0) [0|0] ""  CGW
 SG_ IDCM_FaceEigenvalueData_Byte9 : 96|8@1+ (1,0) [0|0] ""  CGW
 SG_ IDCM_FaceEigenvalueData_Byte10 : 104|8@1+ (1,0) [0|0] ""  CGW
 SG_ IDCM_FaceEigenvalueData_Byte11 : 112|8@1+ (1,0) [0|0] ""  CGW
 SG_ IDCM_FaceEigenvalueData_Byte12 : 120|8@1+ (1,0) [0|0] ""  CGW
 SG_ IDCM_FaceEigenvalueData_Byte13 : 128|8@1+ (1,0) [0|0] ""  CGW
 SG_ IDCM_FaceEigenvalueData_Byte14 : 136|8@1+ (1,0) [0|0] ""  CGW
 SG_ IDCM_FaceEigenvalueData_Byte15 : 144|8@1+ (1,0) [0|0] ""  CGW
 SG_ IDCM_FaceEigenvalueData_Byte16 : 152|8@1+ (1,0) [0|0] ""  CGW
 SG_ IDCM_FaceEigenvalueData_Byte17 : 160|8@1+ (1,0) [0|0] ""  CGW
 SG_ IDCM_FaceEigenvalueData_Byte18 : 168|8@1+ (1,0) [0|0] ""  CGW
 SG_ IDCM_FaceEigenvalueData_Byte19 : 176|8@1+ (1,0) [0|0] ""  CGW
 SG_ IDCM_FaceEigenvalueData_Byte20 : 184|8@1+ (1,0) [0|0] ""  CGW
 SG_ IDCM_FaceEigenvalueData_Byte21 : 192|8@1+ (1,0) [0|0] ""  CGW
 SG_ IDCM_FaceEigenvalueData_Byte22 : 200|8@1+ (1,0) [0|0] ""  CGW
 SG_ IDCM_FaceEigenvalueData_Byte23 : 208|8@1+ (1,0) [0|0] ""  CGW
 SG_ IDCM_FaceEigenvalueData_Byte24 : 216|8@1+ (1,0) [0|0] ""  CGW
 SG_ IDCM_FaceEigenvalueData_Byte25 : 224|8@1+ (1,0) [0|0] ""  CGW
 SG_ IDCM_FaceEigenvalueData_Byte26 : 232|8@1+ (1,0) [0|0] ""  CGW
 SG_ IDCM_FaceEigenvalueData_Byte27 : 240|8@1+ (1,0) [0|0] ""  CGW
 SG_ IDCM_FaceEigenvalueData_Byte28 : 248|8@1+ (1,0) [0|0] ""  CGW

BO_ 1019 IDCM_FD_RT_1: 32 IDCM
 SG_ ALMIP_CustomColorSet_St : 0|8@1+ (1,0) [0|128] ""  CGW
 SG_ ALMIP_CustomLuminanceSet_St : 8|8@1+ (1,0) [0|100] ""  CGW
 SG_ ALMIP_ThemeMode_St : 16|4@1+ (1,0) [0|15] ""  CGW
 SG_ ALMIP_ONOFF_St : 20|1@1+ (1,0) [0|1] ""  CGW
 SG_ WPC_ControllerFaultStatus : 21|1@1+ (1,0) [0|1] ""  CGW
 SG_ AMP_ControllerFaultStatus : 22|1@1+ (1,0) [0|1] ""  CGW
 SG_ ALM_IP_ControllerFaultStatus : 23|1@1+ (1,0) [0|1] ""  CGW
 SG_ ALM_IPR_ControllerFaultStatus : 24|1@1+ (1,0) [0|1] ""  CGW
 SG_ ALM_FL_ControllerFaultStatus : 25|1@1+ (1,0) [0|1] ""  CGW
 SG_ ALM_FR_ControllerFaultStatus : 26|1@1+ (1,0) [0|1] ""  CGW
 SG_ IDCM_FD_RT_1_Reserved5 : 27|1@1+ (1,0) [0|0] ""  CGW
 SG_ IDCM_FD_RT_1_WPC_Available_St : 28|2@1+ (1,0) [0|3] ""  CGW
 SG_ IDCM_FD_RT_1_AMP_Available_St : 30|2@1+ (1,0) [0|3] ""  CGW
 SG_ IDCM_FD_RT_1_ALMIP_Available_St : 32|2@1+ (1,0) [0|3] ""  CGW
 SG_ IDCM_FD_RT_1_ALMIPR_Available_St : 34|2@1+ (1,0) [0|3] ""  CGW
 SG_ IDCM_FD_RT_1_ALMFL_Available_St : 36|2@1+ (1,0) [0|3] ""  CGW
 SG_ IDCM_FD_RT_1_ALMFR_Available_St : 38|2@1+ (1,0) [0|3] ""  CGW
 SG_ IDCM_FD_RT_1_Reserved1 : 40|24@1+ (1,0) [0|0] ""  CGW
 SG_ IDCM_FD_RT_1_Reserved2 : 64|64@1+ (1,0) [0|0] ""  CGW
 SG_ IDCM_FD_RT_1_Reserved3 : 128|64@1+ (1,0) [0|0] ""  CGW
 SG_ IDCM_FD_RT_1_Reserved4 : 192|64@1+ (1,0) [0|0] ""  CGW

BO_ 752 VSP_FD_3: 32 VSP
 SG_ VSP_WakeupUserID_OnlyForIV2 : 32|16@1+ (1,0) [0|65534] ""  IDCM,CGW
 SG_ VSP_WakeupSuperID : 64|32@1+ (1,0) [0|4294967295] ""  IDCM,CGW

BO_ 1104 IDCM_NM: 8 IDCM
 SG_ IDCM_NodeAddress : 0|8@1+ (1,0) [0|255] ""  ARC,ARHUD,WHUD,VSP,FSE_M,CGW
 SG_ IDCM_RepeatMsgReq : 8|1@1+ (1,0) [0|1] ""  ARC,ARHUD,WHUD,VSP,FSE_M,CGW
 SG_ IDCM_ActiveWakeup : 12|1@1+ (1,0) [0|1] ""  ARC,ARHUD,WHUD,VSP,FSE_M,CGW
 SG_ IDCM_RepeatMsgSt : 16|1@1+ (1,0) [0|1] ""  ARC,ARHUD,WHUD,VSP,FSE_M,CGW
 SG_ IDCM_WakeupCGW_TBOX_CANFD : 24|1@1+ (1,0) [0|1] ""  ARC,ARHUD,WHUD,VSP,FSE_M,CGW
 SG_ IDCM_WakeupCGW_IOV_Backbone : 25|1@1+ (1,0) [0|1] ""  ARC,ARHUD,WHUD,VSP,FSE_M,CGW
 SG_ IDCM_WakeupCGW_ADAS_Backbone : 26|1@1+ (1,0) [0|1] ""  ARC,ARHUD,WHUD,VSP,FSE_M,CGW
 SG_ IDCM_WakeupCGW_Chassis_Backbone : 27|1@1+ (1,0) [0|1] ""  ARC,ARHUD,WHUD,VSP,FSE_M,CGW
 SG_ IDCM_WakeupCGW_PT_Backbone : 28|1@1+ (1,0) [0|1] ""  ARC,ARHUD,WHUD,VSP,FSE_M,CGW
 SG_ IDCM_WakeupCGW_BD_Backbone : 29|1@1+ (1,0) [0|1] ""  ARC,ARHUD,WHUD,VSP,FSE_M,CGW
 SG_ IDCM_WakeupCGW_Diagnostic_CANFD : 30|1@1+ (1,0) [0|1] ""  ARC,ARHUD,WHUD,VSP,FSE_M,CGW
 SG_ IDCM_WakeupCGW_CGW_LIN1 : 31|1@1+ (1,0) [0|1] ""  ARC,ARHUD,WHUD,VSP,FSE_M,CGW
 SG_ IDCM_WakeupBDCM_Body_CAN1 : 32|1@1+ (1,0) [0|1] ""  ARC,ARHUD,WHUD,VSP,FSE_M,CGW
 SG_ IDCM_WakeupBDCM_Body_CAN2 : 33|1@1+ (1,0) [0|1] ""  ARC,ARHUD,WHUD,VSP,FSE_M,CGW
 SG_ IDCM_WakeupBDCM_Body_LIN1 : 34|1@1+ (1,0) [0|1] ""  ARC,ARHUD,WHUD,VSP,FSE_M,CGW
 SG_ IDCM_WakeupBDCM_Body_LIN2 : 35|1@1+ (1,0) [0|1] ""  ARC,ARHUD,WHUD,VSP,FSE_M,CGW
 SG_ IDCM_WakeupBDCM_Body_LIN3 : 36|1@1+ (1,0) [0|1] ""  ARC,ARHUD,WHUD,VSP,FSE_M,CGW
 SG_ IDCM_WakeupBDCM_SCM_LIN : 37|1@1+ (1,0) [0|1] ""  ARC,ARHUD,WHUD,VSP,FSE_M,CGW
 SG_ IDCM_WakeupIDCM_IOV_CAN : 40|1@1+ (1,0) [0|1] ""  ARC,ARHUD,WHUD,VSP,FSE_M,CGW
 SG_ IDCM_WakeupVDCM_PT_CANFD1 : 48|1@1+ (1,0) [0|1] ""  ARC,ARHUD,WHUD,VSP,FSE_M,CGW
 SG_ IDCM_WakeupVDCM_PT_CANFD2 : 49|1@1+ (1,0) [0|1] ""  ARC,ARHUD,WHUD,VSP,FSE_M,CGW
 SG_ IDCM_WakeupVDCM_PT_CAN1 : 50|1@1+ (1,0) [0|1] ""  ARC,ARHUD,WHUD,VSP,FSE_M,CGW
 SG_ IDCM_WakeupVDCM_PT_LIN2 : 51|1@1+ (1,0) [0|1] ""  ARC,ARHUD,WHUD,VSP,FSE_M,CGW
 SG_ IDCM_WakeupVDCM_Chassis_Backup : 52|1@1+ (1,0) [0|1] ""  ARC,ARHUD,WHUD,VSP,FSE_M,CGW
 SG_ IDCM_KeepAwakeReason_KL15 : 56|1@1+ (1,0) [0|1] ""  ARC,ARHUD,WHUD,VSP,FSE_M,CGW
 SG_ IDCM_KeepAwakeReason_Local : 57|1@1+ (1,0) [0|1] ""  ARC,ARHUD,WHUD,VSP,FSE_M,CGW
 SG_ IDCM_KeepAwakeReason_Diagnostic : 58|1@1+ (1,0) [0|1] ""  ARC,ARHUD,WHUD,VSP,FSE_M,CGW
 SG_ IDCM_KeepAwakeReason_Network : 59|1@1+ (1,0) [0|1] ""  ARC,ARHUD,WHUD,VSP,FSE_M,CGW

BO_ 1106 ARC_NM: 8 ARC
 SG_ ARC_NodeAddress : 0|8@1+ (1,0) [0|255] ""  IDCM,ARHUD,WHUD,VSP,FSE_M,CGW
 SG_ ARC_RepeatMsgReq : 8|1@1+ (1,0) [0|1] ""  IDCM,ARHUD,WHUD,VSP,FSE_M,CGW
 SG_ ARC_ActiveWakeup : 12|1@1+ (1,0) [0|1] ""  IDCM,ARHUD,WHUD,VSP,FSE_M,CGW
 SG_ ARC_RepeatMsgSt : 16|1@1+ (1,0) [0|1] ""  IDCM,ARHUD,WHUD,VSP,FSE_M,CGW
 SG_ ARC_WakeupCGW_TBOX_CANFD : 24|1@1+ (1,0) [0|1] ""  IDCM,ARHUD,WHUD,VSP,FSE_M,CGW
 SG_ ARC_WakeupCGW_IOV_Backbone : 25|1@1+ (1,0) [0|1] ""  IDCM,ARHUD,WHUD,VSP,FSE_M,CGW
 SG_ ARC_WakeupCGW_ADAS_Backbone : 26|1@1+ (1,0) [0|1] ""  IDCM,ARHUD,WHUD,VSP,FSE_M,CGW
 SG_ ARC_WakeupCGW_Chassis_Backbone : 27|1@1+ (1,0) [0|1] ""  IDCM,ARHUD,WHUD,VSP,FSE_M,CGW
 SG_ ARC_WakeupCGW_PT_Backbone : 28|1@1+ (1,0) [0|1] ""  IDCM,ARHUD,WHUD,VSP,FSE_M,CGW
 SG_ ARC_WakeupCGW_BD_Backbone : 29|1@1+ (1,0) [0|1] ""  IDCM,ARHUD,WHUD,VSP,FSE_M,CGW
 SG_ ARC_WakeupCGW_Diagnostic_CANFD : 30|1@1+ (1,0) [0|1] ""  IDCM,ARHUD,WHUD,VSP,FSE_M,CGW
 SG_ ARC_WakeupCGW_CGW_LIN1 : 31|1@1+ (1,0) [0|1] ""  IDCM,ARHUD,WHUD,VSP,FSE_M,CGW
 SG_ ARC_WakeupBDCM_Body_CAN1 : 32|1@1+ (1,0) [0|1] ""  IDCM,ARHUD,WHUD,VSP,FSE_M,CGW
 SG_ ARC_WakeupBDCM_Body_CAN2 : 33|1@1+ (1,0) [0|1] ""  IDCM,ARHUD,WHUD,VSP,FSE_M,CGW
 SG_ ARC_WakeupBDCM_Body_LIN1 : 34|1@1+ (1,0) [0|1] ""  IDCM,ARHUD,WHUD,VSP,FSE_M,CGW
 SG_ ARC_WakeupBDCM_Body_LIN2 : 35|1@1+ (1,0) [0|1] ""  IDCM,ARHUD,WHUD,VSP,FSE_M,CGW
 SG_ ARC_WakeupBDCM_Body_LIN3 : 36|1@1+ (1,0) [0|1] ""  IDCM,ARHUD,WHUD,VSP,FSE_M,CGW
 SG_ ARC_WakeupBDCM_SCM_LIN : 37|1@1+ (1,0) [0|1] ""  IDCM,ARHUD,WHUD,VSP,FSE_M,CGW
 SG_ ARC_WakeupIDCM_IOV_CAN : 40|1@1+ (1,0) [0|1] ""  IDCM,ARHUD,WHUD,VSP,FSE_M,CGW
 SG_ ARC_WakeupVDCM_PT_CANFD1 : 48|1@1+ (1,0) [0|1] ""  IDCM,ARHUD,WHUD,VSP,FSE_M,CGW
 SG_ ARC_WakeupVDCM_PT_CANFD2 : 49|1@1+ (1,0) [0|1] ""  IDCM,ARHUD,WHUD,VSP,FSE_M,CGW
 SG_ ARC_WakeupVDCM_PT_CAN1 : 50|1@1+ (1,0) [0|1] ""  IDCM,ARHUD,WHUD,VSP,FSE_M,CGW
 SG_ ARC_WakeupVDCM_PT_LIN2 : 51|1@1+ (1,0) [0|1] ""  IDCM,ARHUD,WHUD,VSP,FSE_M,CGW
 SG_ ARC_WakeupVDCM_Chassis_Backup : 52|1@1+ (1,0) [0|1] ""  IDCM,ARHUD,WHUD,VSP,FSE_M,CGW
 SG_ ARC_KeepAwakeReason_KL15 : 56|1@1+ (1,0) [0|1] ""  IDCM,ARHUD,WHUD,VSP,FSE_M,CGW
 SG_ ARC_KeepAwakeReason_Local : 57|1@1+ (1,0) [0|1] ""  IDCM,ARHUD,WHUD,VSP,FSE_M,CGW
 SG_ ARC_KeepAwakeReason_Diagnostic : 58|1@1+ (1,0) [0|1] ""  IDCM,ARHUD,WHUD,VSP,FSE_M,CGW
 SG_ ARC_KeepAwakeReason_Network : 59|1@1+ (1,0) [0|1] ""  IDCM,ARHUD,WHUD,VSP,FSE_M,CGW

BO_ 1107 ARHUD_NM: 8 ARHUD
 SG_ ARHUD_NodeAddress : 0|8@1+ (1,0) [0|255] ""  IDCM,ARC,WHUD,VSP,FSE_M,CGW
 SG_ ARHUD_RepeatMsgReq : 8|1@1+ (1,0) [0|1] ""  IDCM,ARC,WHUD,VSP,FSE_M,CGW
 SG_ ARHUD_ActiveWakeup : 12|1@1+ (1,0) [0|1] ""  IDCM,ARC,WHUD,VSP,FSE_M,CGW
 SG_ ARHUD_RepeatMsgSt : 16|1@1+ (1,0) [0|1] ""  IDCM,ARC,WHUD,VSP,FSE_M,CGW
 SG_ ARHUD_WakeupCGW_TBOX_CANFD : 24|1@1+ (1,0) [0|1] ""  IDCM,ARC,WHUD,VSP,FSE_M,CGW
 SG_ ARHUD_WakeupCGW_IOV_Backbone : 25|1@1+ (1,0) [0|1] ""  IDCM,ARC,WHUD,VSP,FSE_M,CGW
 SG_ ARHUD_WakeupCGW_ADAS_Backbone : 26|1@1+ (1,0) [0|1] ""  IDCM,ARC,WHUD,VSP,FSE_M,CGW
 SG_ ARHUD_WakeupCGW_Chassis_Backbone : 27|1@1+ (1,0) [0|1] ""  IDCM,ARC,WHUD,VSP,FSE_M,CGW
 SG_ ARHUD_WakeupCGW_PT_Backbone : 28|1@1+ (1,0) [0|1] ""  IDCM,ARC,WHUD,VSP,FSE_M,CGW
 SG_ ARHUD_WakeupCGW_BD_Backbone : 29|1@1+ (1,0) [0|1] ""  IDCM,ARC,WHUD,VSP,FSE_M,CGW
 SG_ ARHUD_WakeupCGW_Diagnostic_CANFD : 30|1@1+ (1,0) [0|1] ""  IDCM,ARC,WHUD,VSP,FSE_M,CGW
 SG_ ARHUD_WakeupCGW_CGW_LIN1 : 31|1@1+ (1,0) [0|1] ""  IDCM,ARC,WHUD,VSP,FSE_M,CGW
 SG_ ARHUD_WakeupBDCM_Body_CAN1 : 32|1@1+ (1,0) [0|1] ""  IDCM,ARC,WHUD,VSP,FSE_M,CGW
 SG_ ARHUD_WakeupBDCM_Body_CAN2 : 33|1@1+ (1,0) [0|1] ""  IDCM,ARC,WHUD,VSP,FSE_M,CGW
 SG_ ARHUD_WakeupBDCM_Body_LIN1 : 34|1@1+ (1,0) [0|1] ""  IDCM,ARC,WHUD,VSP,FSE_M,CGW
 SG_ ARHUD_WakeupBDCM_Body_LIN2 : 35|1@1+ (1,0) [0|1] ""  IDCM,ARC,WHUD,VSP,FSE_M,CGW
 SG_ ARHUD_WakeupBDCM_Body_LIN3 : 36|1@1+ (1,0) [0|1] ""  IDCM,ARC,WHUD,VSP,FSE_M,CGW
 SG_ ARHUD_WakeupBDCM_SCM_LIN : 37|1@1+ (1,0) [0|1] ""  IDCM,ARC,WHUD,VSP,FSE_M,CGW
 SG_ ARHUD_WakeupIDCM_IOV_CAN : 40|1@1+ (1,0) [0|1] ""  IDCM,ARC,WHUD,VSP,FSE_M,CGW
 SG_ ARHUD_WakeupVDCM_PT_CANFD1 : 48|1@1+ (1,0) [0|1] ""  IDCM,ARC,WHUD,VSP,FSE_M,CGW
 SG_ ARHUD_WakeupVDCM_PT_CANFD2 : 49|1@1+ (1,0) [0|1] ""  IDCM,ARC,WHUD,VSP,FSE_M,CGW
 SG_ ARHUD_WakeupVDCM_PT_CAN1 : 50|1@1+ (1,0) [0|1] ""  IDCM,ARC,WHUD,VSP,FSE_M,CGW
 SG_ ARHUD_WakeupVDCM_PT_LIN2 : 51|1@1+ (1,0) [0|1] ""  IDCM,ARC,WHUD,VSP,FSE_M,CGW
 SG_ ARHUD_WakeupVDCM_Chassis_Backup : 52|1@1+ (1,0) [0|1] ""  IDCM,ARC,WHUD,VSP,FSE_M,CGW
 SG_ ARHUD_KeepAwakeReason_KL15 : 56|1@1+ (1,0) [0|1] ""  IDCM,ARC,WHUD,VSP,FSE_M,CGW
 SG_ ARHUD_KeepAwakeReason_Local : 57|1@1+ (1,0) [0|1] ""  IDCM,ARC,WHUD,VSP,FSE_M,CGW
 SG_ ARHUD_KeepAwakeReason_Diagnostic : 58|1@1+ (1,0) [0|1] ""  IDCM,ARC,WHUD,VSP,FSE_M,CGW
 SG_ ARHUD_KeepAwakeReason_Network : 59|1@1+ (1,0) [0|1] ""  IDCM,ARC,WHUD,VSP,FSE_M,CGW

BO_ 1108 WHUD_NM: 8 WHUD
 SG_ WHUD_NodeAddress : 0|8@1+ (1,0) [0|255] ""  IDCM,ARC,ARHUD,VSP,FSE_M,CGW
 SG_ WHUD_RepeatMsgReq : 8|1@1+ (1,0) [0|1] ""  IDCM,ARC,ARHUD,VSP,FSE_M,CGW
 SG_ WHUD_ActiveWakeup : 12|1@1+ (1,0) [0|1] ""  IDCM,ARC,ARHUD,VSP,FSE_M,CGW
 SG_ WHUD_RepeatMsgSt : 16|1@1+ (1,0) [0|1] ""  IDCM,ARC,ARHUD,VSP,FSE_M,CGW
 SG_ WHUD_WakeupCGW_TBOX_CANFD : 24|1@1+ (1,0) [0|1] ""  IDCM,ARC,ARHUD,VSP,FSE_M,CGW
 SG_ WHUD_WakeupCGW_IOV_Backbone : 25|1@1+ (1,0) [0|1] ""  IDCM,ARC,ARHUD,VSP,FSE_M,CGW
 SG_ WHUD_WakeupCGW_ADAS_Backbone : 26|1@1+ (1,0) [0|1] ""  IDCM,ARC,ARHUD,VSP,FSE_M,CGW
 SG_ WHUD_WakeupCGW_Chassis_Backbone : 27|1@1+ (1,0) [0|1] ""  IDCM,ARC,ARHUD,VSP,FSE_M,CGW
 SG_ WHUD_WakeupCGW_PT_Backbone : 28|1@1+ (1,0) [0|1] ""  IDCM,ARC,ARHUD,VSP,FSE_M,CGW
 SG_ WHUD_WakeupCGW_BD_Backbone : 29|1@1+ (1,0) [0|1] ""  IDCM,ARC,ARHUD,VSP,FSE_M,CGW
 SG_ WHUD_WakeupCGW_Diagnostic_CANFD : 30|1@1+ (1,0) [0|1] ""  IDCM,ARC,ARHUD,VSP,FSE_M,CGW
 SG_ WHUD_WakeupCGW_CGW_LIN1 : 31|1@1+ (1,0) [0|1] ""  IDCM,ARC,ARHUD,VSP,FSE_M,CGW
 SG_ WHUD_WakeupBDCM_Body_CAN1 : 32|1@1+ (1,0) [0|1] ""  IDCM,ARC,ARHUD,VSP,FSE_M,CGW
 SG_ WHUD_WakeupBDCM_Body_CAN2 : 33|1@1+ (1,0) [0|1] ""  IDCM,ARC,ARHUD,VSP,FSE_M,CGW
 SG_ WHUD_WakeupBDCM_Body_LIN1 : 34|1@1+ (1,0) [0|1] ""  IDCM,ARC,ARHUD,VSP,FSE_M,CGW
 SG_ WHUD_WakeupBDCM_Body_LIN2 : 35|1@1+ (1,0) [0|1] ""  IDCM,ARC,ARHUD,VSP,FSE_M,CGW
 SG_ WHUD_WakeupBDCM_Body_LIN3 : 36|1@1+ (1,0) [0|1] ""  IDCM,ARC,ARHUD,VSP,FSE_M,CGW
 SG_ WHUD_WakeupBDCM_SCM_LIN : 37|1@1+ (1,0) [0|1] ""  IDCM,ARC,ARHUD,VSP,FSE_M,CGW
 SG_ WHUD_WakeupIDCM_IOV_CAN : 40|1@1+ (1,0) [0|1] ""  IDCM,ARC,ARHUD,VSP,FSE_M,CGW
 SG_ WHUD_WakeupVDCM_PT_CANFD1 : 48|1@1+ (1,0) [0|1] ""  IDCM,ARC,ARHUD,VSP,FSE_M,CGW
 SG_ WHUD_WakeupVDCM_PT_CANFD2 : 49|1@1+ (1,0) [0|1] ""  IDCM,ARC,ARHUD,VSP,FSE_M,CGW
 SG_ WHUD_WakeupVDCM_PT_CAN1 : 50|1@1+ (1,0) [0|1] ""  IDCM,ARC,ARHUD,VSP,FSE_M,CGW
 SG_ WHUD_WakeupVDCM_PT_LIN2 : 51|1@1+ (1,0) [0|1] ""  IDCM,ARC,ARHUD,VSP,FSE_M,CGW
 SG_ WHUD_WakeupVDCM_Chassis_Backup : 52|1@1+ (1,0) [0|1] ""  IDCM,ARC,ARHUD,VSP,FSE_M,CGW
 SG_ WHUD_KeepAwakeReason_KL15 : 56|1@1+ (1,0) [0|1] ""  IDCM,ARC,ARHUD,VSP,FSE_M,CGW
 SG_ WHUD_KeepAwakeReason_Local : 57|1@1+ (1,0) [0|1] ""  IDCM,ARC,ARHUD,VSP,FSE_M,CGW
 SG_ WHUD_KeepAwakeReason_Diagnostic : 58|1@1+ (1,0) [0|1] ""  IDCM,ARC,ARHUD,VSP,FSE_M,CGW
 SG_ WHUD_KeepAwakeReason_Network : 59|1@1+ (1,0) [0|1] ""  IDCM,ARC,ARHUD,VSP,FSE_M,CGW

BO_ 1109 VSP_NM: 8 VSP
 SG_ VSP_NodeAddress : 0|8@1+ (1,0) [0|255] ""  IDCM,ARC,ARHUD,WHUD,FSE_M,CGW
 SG_ VSP_RepeatMsgReq : 8|1@1+ (1,0) [0|1] ""  IDCM,ARC,ARHUD,WHUD,FSE_M,CGW
 SG_ VSP_ActiveWakeup : 12|1@1+ (1,0) [0|1] ""  IDCM,ARC,ARHUD,WHUD,FSE_M,CGW
 SG_ VSP_RepeatMsgSt : 16|1@1+ (1,0) [0|1] ""  IDCM,ARC,ARHUD,WHUD,FSE_M,CGW
 SG_ VSP_WakeupCGW_TBOX_CANFD : 24|1@1+ (1,0) [0|1] ""  IDCM,ARC,ARHUD,WHUD,FSE_M,CGW
 SG_ VSP_WakeupCGW_IOV_Backbone : 25|1@1+ (1,0) [0|1] ""  IDCM,ARC,ARHUD,WHUD,FSE_M,CGW
 SG_ VSP_WakeupCGW_ADAS_Backbone : 26|1@1+ (1,0) [0|1] ""  IDCM,ARC,ARHUD,WHUD,FSE_M,CGW
 SG_ VSP_WakeupCGW_Chassis_Backbone : 27|1@1+ (1,0) [0|1] ""  IDCM,ARC,ARHUD,WHUD,FSE_M,CGW
 SG_ VSP_WakeupCGW_PT_Backbone : 28|1@1+ (1,0) [0|1] ""  IDCM,ARC,ARHUD,WHUD,FSE_M,CGW
 SG_ VSP_WakeupCGW_BD_Backbone : 29|1@1+ (1,0) [0|1] ""  IDCM,ARC,ARHUD,WHUD,FSE_M,CGW
 SG_ VSP_WakeupCGW_Diagnostic_CANFD : 30|1@1+ (1,0) [0|1] ""  IDCM,ARC,ARHUD,WHUD,FSE_M,CGW
 SG_ VSP_WakeupCGW_CGW_LIN1 : 31|1@1+ (1,0) [0|1] ""  IDCM,ARC,ARHUD,WHUD,FSE_M,CGW
 SG_ VSP_WakeupBDCM_Body_CAN1 : 32|1@1+ (1,0) [0|1] ""  IDCM,ARC,ARHUD,WHUD,FSE_M,CGW
 SG_ VSP_WakeupBDCM_Body_CAN2 : 33|1@1+ (1,0) [0|1] ""  IDCM,ARC,ARHUD,WHUD,FSE_M,CGW
 SG_ VSP_WakeupBDCM_Body_LIN1 : 34|1@1+ (1,0) [0|1] ""  IDCM,ARC,ARHUD,WHUD,FSE_M,CGW
 SG_ VSP_WakeupBDCM_Body_LIN2 : 35|1@1+ (1,0) [0|1] ""  IDCM,ARC,ARHUD,WHUD,FSE_M,CGW
 SG_ VSP_WakeupBDCM_Body_LIN3 : 36|1@1+ (1,0) [0|1] ""  IDCM,ARC,ARHUD,WHUD,FSE_M,CGW
 SG_ VSP_WakeupBDCM_SCM_LIN : 37|1@1+ (1,0) [0|1] ""  IDCM,ARC,ARHUD,WHUD,FSE_M,CGW
 SG_ VSP_WakeupIDCM_IOV_CAN : 40|1@1+ (1,0) [0|1] ""  IDCM,ARC,ARHUD,WHUD,FSE_M,CGW
 SG_ VSP_WakeupVDCM_PT_CANFD1 : 48|1@1+ (1,0) [0|1] ""  IDCM,ARC,ARHUD,WHUD,FSE_M,CGW
 SG_ VSP_WakeupVDCM_PT_CANFD2 : 49|1@1+ (1,0) [0|1] ""  IDCM,ARC,ARHUD,WHUD,FSE_M,CGW
 SG_ VSP_WakeupVDCM_PT_CAN1 : 50|1@1+ (1,0) [0|1] ""  IDCM,ARC,ARHUD,WHUD,FSE_M,CGW
 SG_ VSP_WakeupVDCM_PT_LIN2 : 51|1@1+ (1,0) [0|1] ""  IDCM,ARC,ARHUD,WHUD,FSE_M,CGW
 SG_ VSP_WakeupVDCM_Chassis_Backup : 52|1@1+ (1,0) [0|1] ""  IDCM,ARC,ARHUD,WHUD,FSE_M,CGW
 SG_ VSP_KeepAwakeReason_KL15 : 56|1@1+ (1,0) [0|1] ""  IDCM,ARC,ARHUD,WHUD,FSE_M,CGW
 SG_ VSP_KeepAwakeReason_Local : 57|1@1+ (1,0) [0|1] ""  IDCM,ARC,ARHUD,WHUD,FSE_M,CGW
 SG_ VSP_KeepAwakeReason_Diagnostic : 58|1@1+ (1,0) [0|1] ""  IDCM,ARC,ARHUD,WHUD,FSE_M,CGW
 SG_ VSP_KeepAwakeReason_Network : 59|1@1+ (1,0) [0|1] ""  IDCM,ARC,ARHUD,WHUD,FSE_M,CGW

BO_ 1025 CGW_NM: 8 CGW
 SG_ CGW_NodeAddress : 0|8@1+ (1,0) [0|255] ""  IDCM,ARC,ARHUD,WHUD,VSP,FSE_M
 SG_ CGW_RepeatMsgReq : 8|1@1+ (1,0) [0|1] ""  IDCM,ARC,ARHUD,WHUD,VSP,FSE_M
 SG_ CGW_ActiveWakeup : 12|1@1+ (1,0) [0|1] ""  IDCM,ARC,ARHUD,WHUD,VSP,FSE_M
 SG_ CGW_RepeatMsgSt : 16|1@1+ (1,0) [0|1] ""  IDCM,ARC,ARHUD,WHUD,VSP,FSE_M
 SG_ CGW_WakeupCGW_TBOX_CANFD : 24|1@1+ (1,0) [0|1] ""  IDCM,ARC,ARHUD,WHUD,VSP,FSE_M
 SG_ CGW_WakeupCGW_IOV_Backbone : 25|1@1+ (1,0) [0|1] ""  IDCM,ARC,ARHUD,WHUD,VSP,FSE_M
 SG_ CGW_WakeupCGW_ADAS_Backbone : 26|1@1+ (1,0) [0|1] ""  IDCM,ARC,ARHUD,WHUD,VSP,FSE_M
 SG_ CGW_WakeupCGW_Chassis_Backbone : 27|1@1+ (1,0) [0|1] ""  IDCM,ARC,ARHUD,WHUD,VSP,FSE_M
 SG_ CGW_WakeupCGW_PT_Backbone : 28|1@1+ (1,0) [0|1] ""  IDCM,ARC,ARHUD,WHUD,VSP,FSE_M
 SG_ CGW_WakeupCGW_BD_Backbone : 29|1@1+ (1,0) [0|1] ""  IDCM,ARC,ARHUD,WHUD,VSP,FSE_M
 SG_ CGW_WakeupCGW_Diagnostic_CANFD : 30|1@1+ (1,0) [0|1] ""  IDCM,ARC,ARHUD,WHUD,VSP,FSE_M
 SG_ CGW_WakeupCGW_CGW_LIN1 : 31|1@1+ (1,0) [0|1] ""  IDCM,ARC,ARHUD,WHUD,VSP,FSE_M
 SG_ CGW_WakeupBDCM_Body_CAN1 : 32|1@1+ (1,0) [0|1] ""  IDCM,ARC,ARHUD,WHUD,VSP,FSE_M
 SG_ CGW_WakeupBDCM_Body_CAN2 : 33|1@1+ (1,0) [0|1] ""  IDCM,ARC,ARHUD,WHUD,VSP,FSE_M
 SG_ CGW_WakeupBDCM_Body_LIN1 : 34|1@1+ (1,0) [0|1] ""  IDCM,ARC,ARHUD,WHUD,VSP,FSE_M
 SG_ CGW_WakeupBDCM_Body_LIN2 : 35|1@1+ (1,0) [0|1] ""  IDCM,ARC,ARHUD,WHUD,VSP,FSE_M
 SG_ CGW_WakeupBDCM_Body_LIN3 : 36|1@1+ (1,0) [0|1] ""  IDCM,ARC,ARHUD,WHUD,VSP,FSE_M
 SG_ CGW_WakeupBDCM_SCM_LIN : 37|1@1+ (1,0) [0|1] ""  IDCM,ARC,ARHUD,WHUD,VSP,FSE_M
 SG_ CGW_WakeupIDCM_IOV_CAN : 40|1@1+ (1,0) [0|1] ""  IDCM,ARC,ARHUD,WHUD,VSP,FSE_M
 SG_ CGW_WakeupVDCM_PT_CANFD1 : 48|1@1+ (1,0) [0|1] ""  IDCM,ARC,ARHUD,WHUD,VSP,FSE_M
 SG_ CGW_WakeupVDCM_PT_CANFD2 : 49|1@1+ (1,0) [0|1] ""  IDCM,ARC,ARHUD,WHUD,VSP,FSE_M
 SG_ CGW_WakeupVDCM_PT_CAN1 : 50|1@1+ (1,0) [0|1] ""  IDCM,ARC,ARHUD,WHUD,VSP,FSE_M
 SG_ CGW_WakeupVDCM_PT_LIN2 : 51|1@1+ (1,0) [0|1] ""  IDCM,ARC,ARHUD,WHUD,VSP,FSE_M
 SG_ CGW_WakeupVDCM_Chassis_Backup : 52|1@1+ (1,0) [0|1] ""  IDCM,ARC,ARHUD,WHUD,VSP,FSE_M
 SG_ CGW_KeepAwakeReason_KL15 : 56|1@1+ (1,0) [0|1] ""  IDCM,ARC,ARHUD,WHUD,VSP,FSE_M
 SG_ CGW_KeepAwakeReason_Local : 57|1@1+ (1,0) [0|1] ""  IDCM,ARC,ARHUD,WHUD,VSP,FSE_M
 SG_ CGW_KeepAwakeReason_Diagnostic : 58|1@1+ (1,0) [0|1] ""  IDCM,ARC,ARHUD,WHUD,VSP,FSE_M
 SG_ CGW_KeepAwakeReason_Network : 59|1@1+ (1,0) [0|1] ""  IDCM,ARC,ARHUD,WHUD,VSP,FSE_M

BO_ 1110 FSE_M_NM: 8 FSE_M
 SG_ FSE_M_NodeAddress : 0|8@1+ (1,0) [0|255] ""  IDCM,ARC,ARHUD,WHUD,VSP,CGW
 SG_ FSE_M_RepeatMsgReq : 8|1@1+ (1,0) [0|1] ""  IDCM,ARC,ARHUD,WHUD,VSP,CGW
 SG_ FSE_M_ActiveWakeup : 12|1@1+ (1,0) [0|1] ""  IDCM,ARC,ARHUD,WHUD,VSP,CGW
 SG_ FSE_M_RepeatMsgSt : 16|1@1+ (1,0) [0|1] ""  IDCM,ARC,ARHUD,WHUD,VSP,CGW
 SG_ FSE_M_WakeupCGW_TBOX_CANFD : 24|1@1+ (1,0) [0|1] ""  IDCM,ARC,ARHUD,WHUD,VSP,CGW
 SG_ FSE_M_WakeupCGW_IOV_Backbone : 25|1@1+ (1,0) [0|1] ""  IDCM,ARC,ARHUD,WHUD,VSP,CGW
 SG_ FSE_M_WakeupCGW_ADAS_Backbone : 26|1@1+ (1,0) [0|1] ""  IDCM,ARC,ARHUD,WHUD,VSP,CGW
 SG_ FSE_M_WakeupCGW_Chassis_Backbone : 27|1@1+ (1,0) [0|1] ""  IDCM,ARC,ARHUD,WHUD,VSP,CGW
 SG_ FSE_M_WakeupCGW_PT_Backbone : 28|1@1+ (1,0) [0|1] ""  IDCM,ARC,ARHUD,WHUD,VSP,CGW
 SG_ FSE_M_WakeupCGW_BD_Backbone : 29|1@1+ (1,0) [0|1] ""  IDCM,ARC,ARHUD,WHUD,VSP,CGW
 SG_ FSE_M_WakeupCGW_Diagnostic_CANFD : 30|1@1+ (1,0) [0|1] ""  IDCM,ARC,ARHUD,WHUD,VSP,CGW
 SG_ FSE_M_WakeupCGW_CGW_LIN1 : 31|1@1+ (1,0) [0|1] ""  IDCM,ARC,ARHUD,WHUD,VSP,CGW
 SG_ FSE_M_WakeupBDCM_Body_CAN1 : 32|1@1+ (1,0) [0|1] ""  IDCM,ARC,ARHUD,WHUD,VSP,CGW
 SG_ FSE_M_WakeupBDCM_Body_CAN2 : 33|1@1+ (1,0) [0|1] ""  IDCM,ARC,ARHUD,WHUD,VSP,CGW
 SG_ FSE_M_WakeupBDCM_Body_LIN1 : 34|1@1+ (1,0) [0|1] ""  IDCM,ARC,ARHUD,WHUD,VSP,CGW
 SG_ FSE_M_WakeupBDCM_Body_LIN2 : 35|1@1+ (1,0) [0|1] ""  IDCM,ARC,ARHUD,WHUD,VSP,CGW
 SG_ FSE_M_WakeupBDCM_Body_LIN3 : 36|1@1+ (1,0) [0|1] ""  IDCM,ARC,ARHUD,WHUD,VSP,CGW
 SG_ FSE_M_WakeupBDCM_SCM_LIN : 37|1@1+ (1,0) [0|1] ""  IDCM,ARC,ARHUD,WHUD,VSP,CGW
 SG_ FSE_M_WakeupFSE_M_IOV_CAN : 40|1@1+ (1,0) [0|1] ""  IDCM,ARC,ARHUD,WHUD,VSP,CGW
 SG_ FSE_M_WakeupVDCM_PT_CANFD1 : 48|1@1+ (1,0) [0|1] ""  IDCM,ARC,ARHUD,WHUD,VSP,CGW
 SG_ FSE_M_WakeupVDCM_PT_CANFD2 : 49|1@1+ (1,0) [0|1] ""  IDCM,ARC,ARHUD,WHUD,VSP,CGW
 SG_ FSE_M_WakeupVDCM_PT_CAN1 : 50|1@1+ (1,0) [0|1] ""  IDCM,ARC,ARHUD,WHUD,VSP,CGW
 SG_ FSE_M_WakeupVDCM_PT_LIN2 : 51|1@1+ (1,0) [0|1] ""  IDCM,ARC,ARHUD,WHUD,VSP,CGW
 SG_ FSE_M_WakeupVDCM_Chassis_Backup : 52|1@1+ (1,0) [0|1] ""  IDCM,ARC,ARHUD,WHUD,VSP,CGW
 SG_ FSE_M_KeepAwakeReason_KL15 : 56|1@1+ (1,0) [0|1] ""  IDCM,ARC,ARHUD,WHUD,VSP,CGW
 SG_ FSE_M_KeepAwakeReason_Local : 57|1@1+ (1,0) [0|1] ""  IDCM,ARC,ARHUD,WHUD,VSP,CGW
 SG_ FSE_M_KeepAwakeReason_Diagnostic : 58|1@1+ (1,0) [0|1] ""  IDCM,ARC,ARHUD,WHUD,VSP,CGW
 SG_ FSE_M_KeepAwakeReason_Network : 59|1@1+ (1,0) [0|1] ""  IDCM,ARC,ARHUD,WHUD,VSP,CGW

BO_ 554 BDCM_FD_1: 32 CGW
 SG_ BDCM_Checksum_1 : 0|8@1+ (1,0) [0|255] ""  IDCM,FSE_M
 SG_ BDCM_RollingCounter_1 : 8|4@1+ (1,0) [0|15] ""  IDCM,FSE_M
 SG_ BDCM_LockUnlock : 12|2@1+ (1,0) [0|3] ""  IDCM,FSE_M
 SG_ BDCM_LogicLock_St : 14|2@1+ (1,0) [0|3] ""  IDCM,VSP,FSE_M
 SG_ BDCM_HoodLock_St : 16|2@1+ (1,0) [0|3] ""  IDCM
 SG_ BDCM_FLDoorLock_St : 18|2@1+ (1,0) [0|3] ""  IDCM,VSP
 SG_ BDCM_FRDoorLock_St : 20|2@1+ (1,0) [0|3] ""  IDCM,VSP
 SG_ BDCM_RLDoorLock_St : 22|2@1+ (1,0) [0|3] ""  IDCM,VSP
 SG_ BDCM_PowerMode : 24|2@1+ (1,0) [0|3] ""  IDCM,ARC,ARHUD,WHUD,VSP,FSE_M
 SG_ BDCM_RRDoorLock_St : 26|2@1+ (1,0) [0|3] ""  IDCM,VSP
 SG_ BDCM_RLNTDoorLock_St : 28|2@1+ (1,0) [0|3] ""  IDCM,VSP
 SG_ BDCM_RRNTDoorLock_St : 30|2@1+ (1,0) [0|3] ""  IDCM,VSP
 SG_ BDCM_HazardWarnLamp_St : 32|2@1+ (1,0) [0|3] ""  IDCM
 SG_ BDCM_WarnLampSwitch_St : 34|1@1+ (1,0) [0|1] ""  IDCM
 SG_ BDCM_WarnLampSwitch_Valid : 35|1@1+ (1,0) [0|1] ""  IDCM
 SG_ BDCM_LeftTurnLamp_Cmd : 36|1@1+ (1,0) [0|1] ""  IDCM
 SG_ BDCM_RightTurnLamp_Cmd : 37|1@1+ (1,0) [0|1] ""  IDCM
 SG_ BDCM_FLSeatOccupied_St : 38|2@1+ (1,0) [0|3] ""  IDCM,ARC,VSP
 SG_ BDCM_FRDoor_St : 49|2@1+ (1,0) [0|3] ""  IDCM
 SG_ BDCM_RRDoor_St : 51|2@1+ (1,0) [0|3] ""  IDCM
 SG_ BDCM_FLDoor_St : 53|2@1+ (1,0) [0|3] ""  IDCM
 SG_ BDCM_RLDoor_St : 56|2@1+ (1,0) [0|3] ""  IDCM
 SG_ BDCM_RLNTDoor_St : 58|2@1+ (1,0) [0|3] ""  IDCM
 SG_ BDCM_RRNTDoor_St : 60|2@1+ (1,0) [0|3] ""  IDCM
 SG_ BDCM_BurglarAlarmWarn : 62|1@1+ (1,0) [0|1] ""  IDCM
 SG_ BDCM_SteeringWheelHeating_St : 66|2@1+ (1,0) [0|3] ""  IDCM
 SG_ BDCM_BackMirrorHeat_St : 68|2@1+ (1,0) [0|3] ""  IDCM
 SG_ BDCM_RearDefrost_St : 70|2@1+ (1,0) [0|3] ""  IDCM
 SG_ BDCM_BackLight_St : 72|2@1+ (1,0) [0|3] ""  IDCM,FSE_M
 SG_ BDCM_TopLightLF_St : 74|1@1+ (1,0) [0|1] ""  IDCM
 SG_ BDCM_TopLightRF_St : 75|1@1+ (1,0) [0|1] ""  IDCM
 SG_ BDCM_TopLightLM_St : 76|1@1+ (1,0) [0|1] ""  IDCM
 SG_ BDCM_TopLightRM_St : 77|1@1+ (1,0) [0|1] ""  IDCM
 SG_ BDCM_TopLightLR_St : 78|1@1+ (1,0) [0|1] ""  IDCM
 SG_ BDCM_TopLightRR_St : 79|1@1+ (1,0) [0|1] ""  IDCM
 SG_ BDCM_BackLightIntensityAdjust_Rsp : 80|4@1+ (1,0) [0|15] ""  IDCM,FSE_M
 SG_ BDCM_ChargeCapErr_St : 84|1@1+ (1,0) [0|1] ""  IDCM
 SG_ BDCM_ChargeCap_St : 85|2@1+ (1,0) [0|3] ""  IDCM
 SG_ BDCM_FLBColumnSwitch : 88|1@1+ (1,0) [0|1] ""  IDCM,VSP
 SG_ BDCM_RLBColumnSwitch : 89|1@1+ (1,0) [0|1] ""  IDCM,VSP
 SG_ BDCM_FRBColumnSwitch : 90|1@1+ (1,0) [0|1] ""  IDCM,VSP
 SG_ BDCM_RRBColumnSwitch : 91|1@1+ (1,0) [0|1] ""  IDCM,VSP
 SG_ BDCM_FLDoorWorkSound_Req : 92|2@1+ (1,0) [0|3] ""  IDCM
 SG_ BDCM_FRDoorWorkSound_Req : 94|2@1+ (1,0) [0|3] ""  IDCM
 SG_ BDCM_RLDoorWorkSound_Req : 96|2@1+ (1,0) [0|3] ""  IDCM
 SG_ BDCM_RRDoorWorkSound_Req : 98|2@1+ (1,0) [0|3] ""  IDCM
 SG_ BDCM_RLNTDoorWorkSound_Req : 100|2@1+ (1,0) [0|3] ""  IDCM
 SG_ BDCM_RRNTDoorWorkSound_Req : 102|2@1+ (1,0) [0|3] ""  IDCM
 SG_ BDCM_FLDoorUssSelfCheck_Rsp : 104|2@1+ (1,0) [0|3] ""  IDCM
 SG_ BDCM_FRDoorUssSelfCheck_Rsp : 106|2@1+ (1,0) [0|3] ""  IDCM
 SG_ BDCM_RLDoorUssSelfCheck_Rsp : 108|2@1+ (1,0) [0|3] ""  IDCM
 SG_ BDCM_RRDoorUssSelfCheck_Rsp : 110|2@1+ (1,0) [0|3] ""  IDCM
 SG_ BDCM_RLNTDoorUssSelfCheck_Rsp : 112|2@1+ (1,0) [0|3] ""  IDCM
 SG_ BDCM_RRNTDoorUssSelfCheck_Rsp : 114|2@1+ (1,0) [0|3] ""  IDCM
 SG_ BDCM_FLObstacleAvoidSt_Rsp : 116|2@1+ (1,0) [0|3] ""  IDCM
 SG_ BDCM_FRObstacleAvoidSt_Rsp : 118|2@1+ (1,0) [0|3] ""  IDCM
 SG_ BDCM_RLObstacleAvoidSt_Rsp : 120|2@1+ (1,0) [0|3] ""  IDCM
 SG_ BDCM_RRObstacleAvoidSt_Rsp : 122|2@1+ (1,0) [0|3] ""  IDCM
 SG_ BDCM_FaceIDRecognition_Req : 124|2@1+ (1,0) [0|3] ""  IDCM,VSP
 SG_ BDCM_WpcCtl_Req : 126|1@1+ (1,0) [0|1] ""  IDCM
 SG_ BDCM_FrontWiperService_St : 133|2@1+ (1,0) [0|3] ""  IDCM
 SG_ BDCM_WiperMotorErr : 135|1@1+ (1,0) [0|1] ""  IDCM
 SG_ BDCM_WashLiquidHght : 136|8@1+ (0.5,0) [0|100] "%"  IDCM
 SG_ BDCM_RLS_LightSwitchRequest : 181|2@1+ (1,0) [0|3] ""  IDCM
 SG_ BDCM_RainAutoCloseWndwFinish : 183|1@1+ (1,0) [0|1] ""  IDCM
 SG_ BDCM_UndetectkeyReminder : 184|4@1+ (1,0) [0|15] ""  IDCM
 SG_ BDCM_KeyLocation_St : 188|4@1+ (1,0) [0|15] ""  IDCM
 SG_ BDCM_KeyBatterySOC_St : 192|4@1+ (1,0) [0|15] ""  IDCM
 SG_ BDCM_KeyInCarWarn_Req : 196|1@1+ (1,0) [0|1] ""  IDCM
 SG_ BDCM_KeyNotInCarWarn_Req : 197|1@1+ (1,0) [0|1] ""  IDCM
 SG_ BDCM_SysError_Rsp : 199|1@1+ (1,0) [0|1] ""  IDCM
 SG_ BDCM_IGRelayErr : 200|2@1+ (1,0) [0|3] ""  IDCM
 SG_ BDCM_DriverSWSAdjust_St : 203|2@1+ (1,0) [0|3] ""  IDCM,ARC,ARHUD,WHUD
 SG_ BDCM_WashLiquidHeightWarn_St : 205|2@1+ (1,0) [0|3] ""  IDCM
 SG_ BDCM_VMVehicleModeInfo : 208|3@1+ (1,0) [0|7] ""  IDCM,ARC,ARHUD,WHUD,VSP,FSE_M
 SG_ BDCM_RKE_Detect : 211|2@1+ (1,0) [0|3] ""  IDCM
 SG_ BDCM_DriverPositionMemoryWindow_Req : 215|1@1+ (1,0) [0|0] ""  IDCM
 SG_ BDCM_PassengerPositionMemoryWindow_Req : 216|1@1+ (1,0) [0|0] ""  IDCM
 SG_ BDCM_ReverseBackMirTurndown_St : 217|2@1+ (1,0) [0|3] ""  IDCM
 SG_ BDCM_FogLampSt_Rsp : 219|2@1+ (1,0) [0|3] ""  IDCM
 SG_ BDCM_SCAMCalibration_St : 221|2@1+ (1,0) [0|3] ""  IDCM

BO_ 713 BDCM_FD_2: 32 CGW
 SG_ BDCM_RainAutoCloseWndwSet_Rsp : 0|1@1+ (1,0) [0|1] ""  IDCM
 SG_ BDCM_DriverSideApproachOpenDoorSet_Rsp : 1|1@1+ (1,0) [0|1] ""  IDCM
 SG_ BDCM_PassengerSideApproachOpenDoorSet_Rsp : 2|1@1+ (1,0) [0|1] ""  IDCM
 SG_ BDCM_TopLightSwitch_Rsp : 3|1@1+ (1,0) [0|1] ""  IDCM
 SG_ BDCM_FrontWiperMode_Rsp : 4|2@1+ (1,0) [0|3] ""  IDCM
 SG_ BDCM_SafetyLockSet_Rsp : 6|2@1+ (1,0) [0|3] ""  IDCM
 SG_ BDCM_ApproachUnlockConfig_Rsp : 8|3@1+ (1,0) [0|7] ""  IDCM
 SG_ BDCM_CampingMode_Rsp : 12|2@1+ (1,0) [0|3] ""  IDCM
 SG_ BDCM_UnlockModeSet_Rsp : 14|2@1+ (1,0) [0|3] ""  IDCM
 SG_ BDCM_RemoteLowPressureWarnSet_Rsp : 16|1@1+ (1,0) [0|1] ""  IDCM
 SG_ BDCM_HornModeSet_Rsp_OnlyForIV2 : 17|1@1+ (1,0) [0|1] ""  IDCM
 SG_ BDCM_BackMirrorAutoFoldSet_Rsp_OnlyForIV2 : 19|1@1+ (1,0) [0|1] ""  IDCM
 SG_ BDCM_BackMirrorAutoTurnOverSet_Rsp_OnlyForIV2 : 20|2@1+ (1,0) [0|3] ""  IDCM
 SG_ BDCM_BackMirrorAutoUnfoldSet_Rsp_OnlyForIV2 : 22|2@1+ (1,0) [0|3] ""  IDCM
 SG_ BDCM_ApproachUnlockSet_Rsp_OnlyForIV2 : 24|1@1+ (1,0) [0|1] ""  IDCM
 SG_ BDCM_WalkAwayLockSet_Rsp : 25|1@1+ (1,0) [0|1] ""  IDCM
 SG_ BDCM_ValetModeHoodForbid_Rsp : 26|2@1+ (1,0) [0|3] ""  IDCM
 SG_ BDCM_TailFootOpenSet_Rsp : 28|1@1+ (1,0) [0|1] ""  IDCM
 SG_ BDCM_TailOpenModeSet_Rsp : 29|2@1+ (1,0) [0|3] ""  IDCM
 SG_ BDCM_TailNormallyOpenAngleSet_Rsp : 32|8@1+ (0.5,0) [0|100] "％"  IDCM
 SG_ BDCM_TailGarageOpenAngleSet_Rsp : 40|8@1+ (0.5,0) [0|100] "％"  IDCM
 SG_ BDCM_LightSet_Rsp : 48|3@1+ (1,0) [0|7] ""  IDCM
 SG_ BDCM_NTModeSet_Rsp : 64|2@1+ (1,0) [0|3] ""  IDCM
 SG_ BDCM_LNTTourismMode_Rsp : 66|1@1+ (1,0) [0|1] ""  IDCM
 SG_ BDCM_RNTTourismMode_Rsp : 67|1@1+ (1,0) [0|1] ""  IDCM
 SG_ BDCM_NTVariableRateSet_Rsp : 68|3@1+ (1,0) [0|7] ""  IDCM
 SG_ BDCM_NTOpenAngelSet_Rsp : 72|8@1+ (0.5,0) [0|100] "％"  IDCM
 SG_ BDCM_PassengerSeatSoftPointposition_Rsp : 80|8@1+ (0.5,0) [0|100] "%"  IDCM
 SG_ BDCM_NTTourismModeOpenAngelSet_Rsp : 88|8@1+ (0.5,0) [0|100] "％"  IDCM
 SG_ BDCM_FDoorVariableRateSet_Rsp : 96|3@1+ (1,0) [0|7] ""  IDCM
 SG_ BDCM_RDoorVariableRateSet_Rsp : 99|3@1+ (1,0) [0|7] ""  IDCM
 SG_ BDCM_FDoorOpenAngelSet_Rsp : 104|8@1+ (0.5,0) [0|100] "％"  IDCM
 SG_ BDCM_RDoorOpenAngelSet_Rsp : 112|8@1+ (0.5,0) [0|100] "％"  IDCM
 SG_ BDCN_RLWindowSwitchForbid_Rsp : 120|2@1+ (1,0) [0|3] ""  IDCM
 SG_ BDCN_RRWindowSwitchForbid_Rsp : 122|2@1+ (1,0) [0|3] ""  IDCM
 SG_ BDCM_AutoLightSet_Rsp_OnlyForIV2 : 124|1@1+ (1,0) [0|1] ""  IDCM
 SG_ BDCM_AutoHighBeamLamp_Rsp : 125|1@1+ (1,0) [0|1] ""  IDCM
 SG_ BDCM_LightDelayCloseTimeSet_Rsp : 126|2@1+ (1,0) [0|3] ""  IDCM
 SG_ BDCM_WelcomeMode_Rsp : 128|2@1+ (1,0) [0|3] ""  IDCM
 SG_ BDCM_TopLightMode_Rsp : 130|1@1+ (1,0) [0|1] ""  IDCM
 SG_ BDCM_SmartLightEN_Rsp : 132|2@1+ (1,0) [0|3] ""  IDCM
 SG_ BDCM_DriverPositionMemorySave_St_OnlyForIV2 : 134|2@1+ (1,0) [0|3] ""  IDCM
 SG_ BDCM_DriverPositionMemoryExport_St_OnlyForIV2 : 136|2@1+ (1,0) [0|3] ""  IDCM
 SG_ BDCM_PassengerPositionMemoryMemSave_St_OnlyForIV2 : 138|2@1+ (1,0) [0|3] ""  IDCM
 SG_ BDCM_PassengerPositionMemoryMemExport_OnlyForIV2 : 140|2@1+ (1,0) [0|3] ""  IDCM
 SG_ BDCM_RearFogLightCmd_Rsp : 142|2@1+ (1,0) [0|3] ""  IDCM
 SG_ BDCM_SCMSRLZeroGravitySt_Rsp : 146|3@1+ (1,0) [0|7] ""  IDCM
 SG_ BDCM_SCMSRRZeroGravitySt_Rsp : 149|3@1+ (1,0) [0|7] ""  IDCM
 SG_ BDCM_SCMSRLEasyEntrySt_Rsp : 152|3@1+ (1,0) [0|7] ""  IDCM
 SG_ BDCM_SCMSRREasyEntrySt_Rsp : 155|3@1+ (1,0) [0|7] ""  IDCM
 SG_ BDCM_FLMemorySelectErrReason : 160|8@1+ (1,0) [0|255] ""  IDCM
 SG_ BDCM_FRMemorySelectErrReason : 168|8@1+ (1,0) [0|255] ""  IDCM
 SG_ BDCM_SRLEasyEntryStopReason : 176|8@1+ (1,0) [0|255] ""  IDCM
 SG_ BDCM_SRREasyEntryStopReason : 184|8@1+ (1,0) [0|255] ""  IDCM
 SG_ BDCM_SRLZeroGravityStopReason : 192|8@1+ (1,0) [0|255] ""  IDCM
 SG_ BDCM_SRRZeroGravityStopReason : 200|8@1+ (1,0) [0|255] ""  IDCM
 SG_ BDCM_PassengerSeatSoftPointSet_Rsp : 208|1@1+ (1,0) [0|1] ""  IDCM
 SG_ BDCM_SCMSRLZeroGravityMotionSt_Rsp : 209|2@1+ (1,0) [0|3] ""  IDCM
 SG_ BDCM_SCMSRRZeroGravityMotionSt_Rsp : 211|2@1+ (1,0) [0|3] ""  IDCM

BO_ 698 BDCM_FD_3: 32 CGW
 SG_ BDCM_FD_3_Checksum_1 : 0|8@1+ (1,0) [0|255] ""  IDCM
 SG_ BDCM_FD_3_RollingCounter_1 : 8|4@1+ (1,0) [0|15] ""  IDCM
 SG_ BDCM_FLTpmsWheellPressure : 16|8@1+ (1.373,0) [0|350] "Kpa"  IDCM
 SG_ BDCM_FRTpmsWheellPressure : 24|8@1+ (1.373,0) [0|350] "Kpa"  IDCM
 SG_ BDCM_RLTpmsWheellPressure : 32|8@1+ (1.373,0) [0|350] "Kpa"  IDCM
 SG_ BDCM_RRTpmsWheellPressure : 40|8@1+ (1.373,0) [0|350] "Kpa"  IDCM
 SG_ BDCM_FLTpmsWheellPressureWarn_St : 48|2@1+ (1,0) [0|3] ""  IDCM
 SG_ BDCM_FRTpmsWheellPressureWarn_St : 50|2@1+ (1,0) [0|3] ""  IDCM
 SG_ BDCM_RLTpmsWheellPressureWarn_St : 52|2@1+ (1,0) [0|3] ""  IDCM
 SG_ BDCM_RRTpmsWheellPressureWarn_St : 54|2@1+ (1,0) [0|3] ""  IDCM
 SG_ BDCM_FD_3_Checksum_2 : 64|8@1+ (1,0) [0|255] ""  IDCM
 SG_ BDCM_FD_3_RollingCounter_2 : 72|4@1+ (1,0) [0|15] ""  IDCM
 SG_ BDCM_FLTpmsWheelTemp : 80|8@1+ (1,-40) [-40|214] "°C"  IDCM
 SG_ BDCM_FRTpmsWheelTemp : 88|8@1+ (1,-40) [-40|214] "°C"  IDCM
 SG_ BDCM_RLTpmsWheelTemp : 96|8@1+ (1,-40) [-40|214] "°C"  IDCM
 SG_ BDCM_RRTpmsWheelTemp : 104|8@1+ (1,-40) [-40|214] "°C"  IDCM
 SG_ BDCM_FLTpmsWheelTempWarn_St : 112|1@1+ (1,0) [0|1] ""  IDCM
 SG_ BDCM_FRTpmsWheelTempWarn_St : 113|1@1+ (1,0) [0|1] ""  IDCM
 SG_ BDCM_RLTpmsWheelTempWarn_St : 114|1@1+ (1,0) [0|1] ""  IDCM
 SG_ BDCM_RRTpmsWheelTempWarn_St : 115|1@1+ (1,0) [0|1] ""  IDCM
 SG_ BDCM_FLTpmsBattle_St : 116|1@1+ (1,0) [0|1] ""  IDCM
 SG_ BDCM_FRTpmsBattle_St : 117|1@1+ (1,0) [0|1] ""  IDCM
 SG_ BDCM_RLTpmsBattle_St : 118|1@1+ (1,0) [0|1] ""  IDCM
 SG_ BDCM_RRTpmsBattle_St : 119|1@1+ (1,0) [0|1] ""  IDCM
 SG_ BDCM_FLTpmsSensorFailure_St : 120|1@1+ (1,0) [0|1] ""  IDCM
 SG_ BDCM_FRTpmsSensorFailure_St : 121|1@1+ (1,0) [0|1] ""  IDCM
 SG_ BDCM_RLTpmsSensorFailure_St : 122|1@1+ (1,0) [0|1] ""  IDCM
 SG_ BDCM_RRTpmsSensorFailure_St : 123|1@1+ (1,0) [0|1] ""  IDCM
 SG_ BDCM_FLTpmsIDRegisterFailureWarn : 142|1@1+ (1,0) [0|1] ""  IDCM
 SG_ BDCM_FRTpmsIDRegisterFailureWarn : 143|1@1+ (1,0) [0|1] ""  IDCM
 SG_ BDCM_RLTpmsIDRegisterFailureWarn : 144|1@1+ (1,0) [0|1] ""  IDCM
 SG_ BDCM_RRTpmsIDRegisterFailureWarn : 145|1@1+ (1,0) [0|1] ""  IDCM
 SG_ BDCM_TpmsRFAntennaErr_Rsp : 146|1@1+ (1,0) [0|1] ""  IDCM
 SG_ BDCM_FLTpmsRapidLeakWarn : 147|1@1+ (1,0) [0|1] ""  IDCM
 SG_ BDCM_FRTpmsRapidLeakWarn : 148|1@1+ (1,0) [0|1] ""  IDCM
 SG_ BDCM_RLTpmsRapidLeakWarn : 149|1@1+ (1,0) [0|1] ""  IDCM
 SG_ BDCM_RRTpmsRapidLeakWarn : 150|1@1+ (1,0) [0|1] ""  IDCM

BO_ 564 BDCM_FD_9: 32 CGW
 SG_ BDCM_DriverSetVehicleTimeGap : 52|2@1+ (1,0) [0|3] ""  IDCM,ARC,ARHUD,WHUD
 SG_ BDCM_SWS_L_HHPilot : 54|2@1+ (1,0) [0|3] ""  IDCM
 SG_ BDCM_DriverSetVehicleSpeed : 57|7@1+ (1,30) [30|150] "km/h"  IDCM,ARC,ARHUD,WHUD
 SG_ BDCM_SWS_L_Upslip_Cmd : 64|3@1+ (1,0) [0|7] ""  IDCM
 SG_ BDCM_SWS_L_UpslipFast_Cmd : 67|3@1+ (1,0) [0|7] ""  IDCM
 SG_ BDCM_SWS_L_Dwnslip_Cmd : 72|3@1+ (1,0) [0|7] ""  IDCM
 SG_ BDCM_SWS_L_DownslipFast_Cmd : 75|3@1+ (1,0) [0|7] ""  IDCM
 SG_ BDCM_SWS_L_Leftslip_Cmd : 80|3@1+ (1,0) [0|7] ""  IDCM
 SG_ BDCM_SWS_L_LeftslipFast_Cmd : 83|3@1+ (1,0) [0|7] ""  IDCM
 SG_ BDCM_SWS_L_RightSlip_Cmd : 88|3@1+ (1,0) [0|7] ""  IDCM
 SG_ BDCM_SWS_L_RightslipFast_Cmd : 91|3@1+ (1,0) [0|7] ""  IDCM
 SG_ BDCM_SWS_L_Doubleclick_Cmd : 94|2@1+ (1,0) [0|3] ""  IDCM
 SG_ BDCM_SWS_L_zoomin_Cmd : 96|2@1+ (1,0) [0|3] ""  IDCM
 SG_ BDCM_SWS_L_zoomout_Cmd : 98|2@1+ (1,0) [0|3] ""  IDCM
 SG_ BDCM_SWS_L_Button_St : 100|2@1+ (1,0) [0|3] ""  IDCM
 SG_ BDCM_SWS_L_HHPilot_OnlyForIV2 : 102|2@1+ (1,0) [0|3] ""  IDCM
 SG_ BDCM_SWS_L_PickSwitch : 104|2@1+ (1,0) [0|3] ""  IDCM
 SG_ SWS_L_TwofingerUpSlip_Cmd : 106|3@1+ (1,0) [0|7] ""  IDCM
 SG_ SWS_L_TwofingerDownSlip_Cmd : 109|3@1+ (1,0) [0|7] ""  IDCM
 SG_ SWS_L_TwofingerLeftSlip_Cmd : 112|3@1+ (1,0) [0|7] ""  IDCM
 SG_ SWS_L_TwofingerRightSlip_Cmd : 115|3@1+ (1,0) [0|7] ""  IDCM
 SG_ BDCM_SWS_L_ProtocolVersion : 118|2@1+ (1,0) [0|3] ""  IDCM
 SG_ BDCM_SWS_R_Upslip_Cmd : 120|3@1+ (1,0) [0|7] ""  IDCM
 SG_ BDCM_SWS_R_UpslipFast_Cmd : 123|3@1+ (1,0) [0|7] ""  IDCM
 SG_ BDCM_SWS_R_Dwnslip_Cmd : 128|3@1+ (1,0) [0|7] ""  IDCM
 SG_ BDCM_SWS_R_DownslipFast_Cmd : 131|3@1+ (1,0) [0|7] ""  IDCM
 SG_ BDCM_SWS_R_Leftslip_Cmd : 136|3@1+ (1,0) [0|7] ""  IDCM
 SG_ BDCM_SWS_R_LeftslipFast_Cmd : 139|3@1+ (1,0) [0|7] ""  IDCM
 SG_ BDCM_SWS_R_RightSlip_Cmd : 144|3@1+ (1,0) [0|7] ""  IDCM
 SG_ BDCM_SWS_R_RightslipFast_Cmd : 147|3@1+ (1,0) [0|7] ""  IDCM
 SG_ BDCM_SWS_R_Doubleclick_Cmd : 150|2@1+ (1,0) [0|3] ""  IDCM
 SG_ BDCM_SWS_R_zoomin_Cmd : 152|2@1+ (1,0) [0|3] ""  IDCM
 SG_ BDCM_SWS_R_zoomout_Cmd : 154|2@1+ (1,0) [0|3] ""  IDCM
 SG_ BDCM_SWS_R_Button_St : 156|2@1+ (1,0) [0|3] ""  IDCM
 SG_ BDCM_SWS_R_Voice : 158|2@1+ (1,0) [0|3] ""  IDCM
 SG_ BDCM_SWS_R_PickSwitch : 160|2@1+ (1,0) [0|3] ""  IDCM
 SG_ SWS_R_TwofingerUpSlip_Cmd : 162|3@1+ (1,0) [0|7] ""  IDCM
 SG_ SWS_R_TwofingerDownSlip_Cmd : 165|3@1+ (1,0) [0|7] ""  IDCM
 SG_ SWS_R_TwofingerLeftSlip_Cmd : 168|3@1+ (1,0) [0|7] ""  IDCM
 SG_ SWS_R_TwofingerRightSlip_Cmd : 171|3@1+ (1,0) [0|7] ""  IDCM
 SG_ BDCM_SWHM_DrvSteeringWheelHeatTemp_Rsp : 200|6@1+ (0.5,20) [20|50] "℃"  IDCM
 SG_ BDCM_SWHM_DrvSteeringWheelHeatLevel_Rsp : 208|3@1+ (1,0) [0|7] ""  IDCM
 SG_ BDCM_SCAM_Err1 : 211|3@1+ (1,0) [0|7] ""  IDCM
 SG_ BDCM_SCAM_Err2 : 216|3@1+ (1,0) [0|7] ""  IDCM

BO_ 743 BDCM_FD_RT_1: 32 CGW
 SG_ DCM_FL_WindowPosition_Rsp : 0|8@1+ (0.5,0) [0|100] "%"  IDCM
 SG_ DCM_FL_WindowAntiClamp_St : 19|2@1+ (1,0) [0|3] ""  IDCM
 SG_ DCM_FL_TurnLampErr_St : 21|3@1+ (1,0) [0|7] ""  IDCM
 SG_ DCM_FL_TurnLamp_St : 24|2@1+ (1,0) [0|3] ""  IDCM
 SG_ DCM_FL_WindowMoveStatus : 29|2@1+ (1,0) [0|3] ""  IDCM
 SG_ DCM_FL_BackMir_UpDwn_Position_Rsp : 32|8@1+ (0.5,0) [0|100] "%"  IDCM
 SG_ DCM_FL_BackMir_LR_Position_Rsp : 40|8@1+ (0.5,0) [0|100] "%"  IDCM
 SG_ BDCM_FD_RT_1_DCM_FL_Available_St : 48|2@1+ (1,0) [0|3] ""  IDCM
 SG_ BDCM_FD_RT_1_DCM_FR_Available_St : 54|2@1+ (1,0) [0|3] ""  IDCM
 SG_ DCM_FR_WindowPosition_Rsp : 56|8@1+ (0.5,0) [0|100] "%"  IDCM
 SG_ DCM_FR_WindowAntiClamp_St : 75|2@1+ (1,0) [0|3] ""  IDCM
 SG_ DCM_FR_TurnLampErr_St : 77|3@1+ (1,0) [0|7] ""  IDCM
 SG_ DCM_FR_TurnLamp_St : 80|2@1+ (1,0) [0|3] ""  IDCM
 SG_ DCM_FR_WindowMoveStatus : 85|2@1+ (1,0) [0|3] ""  IDCM
 SG_ DCM_FR_BackMir_UpDwn_Position_Rsp : 88|8@1+ (0.5,0) [0|100] "%"  IDCM
 SG_ DCM_FR_BackMir_LR_Position_Rsp : 96|8@1+ (0.5,0) [0|100] "%"  IDCM
 SG_ BDCM_FD_RT_1_DCM_RL_Available_St : 108|2@1+ (1,0) [0|3] ""  IDCM
 SG_ BDCM_FD_RT_1_DCM_RR_Available_St : 110|2@1+ (1,0) [0|3] ""  IDCM
 SG_ DCM_RL_WindowPosition_Rsp : 112|8@1+ (0.5,0) [0|100] "%"  IDCM
 SG_ DCM_RL_WindowAntiClamp_St : 131|2@1+ (1,0) [0|3] ""  IDCM
 SG_ DCM_RL_WindowMoveStatus : 133|2@1+ (1,0) [0|3] ""  IDCM
 SG_ DCM_RR_WindowPosition_Rsp : 136|8@1+ (0.5,0) [0|100] "%"  IDCM
 SG_ DCM_RR_WindowAntiClamp_St : 155|2@1+ (1,0) [0|3] ""  IDCM
 SG_ PDM_FL_DoorOpenDegree_Rsp : 160|8@1+ (0.5,0) [0|100] "%"  IDCM
 SG_ PDM_FL_DoorAntiClamp_St : 168|2@1+ (1,0) [0|3] ""  IDCM
 SG_ PDM_FL_DoorStopReazon : 170|4@1+ (1,0) [0|15] ""  IDCM
 SG_ PDM_FL_DoorObstacleAvoid_St : 174|2@1+ (1,0) [0|3] ""  IDCM
 SG_ PDM_FL_DoorobstacleDistance_Rsp : 176|8@1+ (1,20) [20|120] "cm"  IDCM
 SG_ PDM_FL_DoorWork_St : 184|2@1+ (1,0) [0|3] ""  IDCM
 SG_ BDCM_FD_RT_1_PDM_FL_Available_St : 187|2@1+ (1,0) [0|3] ""  IDCM
 SG_ BDCM_FD_RT_1_PDM_FR_Available_St : 190|2@1+ (1,0) [0|3] ""  IDCM
 SG_ PDM_FR_DoorOpenDegree_Rsp : 192|8@1+ (0.5,0) [0|100] "%"  IDCM
 SG_ PDM_FR_DoorAntiClamp_St : 200|2@1+ (1,0) [0|3] ""  IDCM
 SG_ PDM_FR_DoorStopReazon : 202|4@1+ (1,0) [0|15] ""  IDCM
 SG_ PDM_FR_DoorObstacleAvoid_St : 206|2@1+ (1,0) [0|3] ""  IDCM
 SG_ PDM_FR_DoorobstacleDistance_Rsp : 208|8@1+ (1,20) [20|120] "cm"  IDCM
 SG_ PDM_FR_DoorWork_St : 216|2@1+ (1,0) [0|3] ""  IDCM

CM_ BO_ 568 "APA设置";
CM_ BO_ 766 "ACM设置";
CM_ BO_ 382 "DSM设置";
CM_ BO_ 1011 "HUD显示信息";
CM_ BO_ 383 "人脸特征值数据";
CM_ BO_ 1019 "氛围灯状态&故障状态";
CM_ BO_ 752 "VSP占位信号";
CM_ BO_ 554 "BDCM直发1-车身基本状态、控制指令及RLS状态";
CM_ BO_ 713 "BDCM直发2-设置反馈，判断后座椅状态";
CM_ BO_ 698 "BDCM直发3，胎压相关及功能状态";
CM_ BO_ 564 "转发HOD、SWS、SRSM及SCAM故障";
CM_ BO_ 743 "门模块信号路由信息";
CM_ SG_ 568 IDCM_FD_20_Checksum1 "E2E Signal Group Checksum
Checksum is the actual value after calculation. See the 'ChecksumAlgorithm' sheet for the specific algorithm.
E2E信号组校验和
Checksum为计算后实际值，具体算法参见“ChecksumAlgorithm”页";
CM_ SG_ 568 IDCM_FD_20_RollingCounter1 "E2E Signal Group Counter
Counter value is automatically accumulated, added from 0 to 14 and then looped to the initial value of 0. Every time a message is sent, counter adds 1.
E2E信号组计数器
Counter值为自动累加，从0加到14，然后循环至初始值0，每次报文发送，Counter加1";
CM_ SG_ 568 IDCM_FD_20_Reserved1 "Reserved for future extensions
信号扩展预留位";
CM_ SG_ 568 IDCM_APAPASVirtualSwitch_St "Parking assist function virtual switch action
泊车辅助功能虚拟开关动作";
CM_ SG_ 568 IDCM_APAPIPOSelect "PIC or POC function choose
泊入泊出功能选择";
CM_ SG_ 568 IDCM_APAFunctionSelectResult "Auto_Parking Function selection Feedback
自动泊车功能选择反馈";
CM_ SG_ 568 IDCM_APACancel "Function cancel button
APA功能取消按钮";
CM_ SG_ 568 IDCM_SVSShow_Req "Surround view function status
环视功能状态";
CM_ SG_ 568 IDCM_SVSBootAnimation_Req "Surround view animation request
环视开机动画请求";
CM_ SG_ 568 IDCM_SVSMode_Req "View mode request
环视模式请求";
CM_ SG_ 568 IDCM_BasePlateTex_Req "Transparent chassis open request
车辆基底（透明底盘）开启请求";
CM_ SG_ 568 IDCM_ObjectOverlay_Req "Object overlay  open request
泊车障碍物辅助线开启请求";
CM_ SG_ 568 IDCM_TrajectoryOverlay_Req "Vehicle trajectoy  open request
泊车行进轨迹线开启请求";
CM_ SG_ 568 IDCM_PASAcousticWarning_Req "Radar sound alarm switch
泊车雷达声音报警开关";
CM_ SG_ 568 IDCM_IntelligentViewChangeSwitch "Intelligent switch
智能开关";
CM_ SG_ 568 IDCM_APAParkslotSelection "Auto_Parking Parkslot Selection
自动泊车类型及方向的选择";
CM_ SG_ 568 IDCM_SVSView_Req "环视视角请求状态 
 Surround view request status";
CM_ SG_ 568 IDCM_DefaultTopview_Req "Select the SVS switch by default
默认选择全景";
CM_ SG_ 568 IDCM_DefaultNormalview_Req "Select the normal view (wide Angle off) switch by default
默认选择正常视角（广角关闭）开关";
CM_ SG_ 568 IDCM_SVSBootAnimationSwitch_Req "Surround view animation request switch
环视开机动画开关";
CM_ SG_ 568 IDCM_SVSActiveShowOpen_St "Surround view function on and off feedback
环视功能打开反馈";
CM_ SG_ 568 IDCM_SVSTopview_Req "SVS Topview Request
全景开关";
CM_ SG_ 568 IDCM_PMAEBSwitch "PM-AEB Switch
PM-AEB功能开关";
CM_ SG_ 568 IDCM_FD_20_Reserved2 "Reserved for future extensions
信号扩展预留位";
CM_ SG_ 568 IDCM_FD_20_Reserved3 "Reserved for future extensions
信号扩展预留位";
CM_ SG_ 568 IDCM_FD_20_Reserved4 "Reserved for future extensions
信号扩展预留位";
CM_ SG_ 568 IDCM_FD_20_Reserved5 "Reserved for future extensions
信号扩展预留位";
CM_ SG_ 766 IDCM_FrontACSwitch_Cmd "Front AC Switch Command
前空调开关机";
CM_ SG_ 766 IDCM_FrontDeFrostFog_Cmd "Front Defrost Defog Command
前除霜除雾";
CM_ SG_ 766 IDCM_FrontAutoAC_Cmd "Front Auto AC Command
前空调自动";
CM_ SG_ 766 IDCM_ACCompressorSwitch_Cmd "AC Compressor Switch Command
A/C压缩机的开关命令";
CM_ SG_ 766 IDCM_FrontACAirFlowLevel_Cmd "Front AC Air Flow Level Command
前空调风量";
CM_ SG_ 766 IDCM_TempAreaSynchronization_Cmd "Temperature Area Synchronization Command
温区同步";
CM_ SG_ 766 IDCM_AQSSet_Cmd "AQS Set Command
AQS车外空气质量传感器开关信号";
CM_ SG_ 766 IDCM_FD_21_Reserved4 "Reserved for future extensions
信号扩展预留位";
CM_ SG_ 766 IDCM_FrontACMode_Cmd "Front AC Mode Command
前空调模式";
CM_ SG_ 766 IDCM_InOutLoopMode_Cmd "In Out Loop Mode Command
内外循环";
CM_ SG_ 766 IDCM_DriverTempSet_Cmd "Driver Temp Set Command
主驾温度设置";
CM_ SG_ 766 IDCM_PM25Set_Cmd "PM2.5 Set Command
PM2.5开关";
CM_ SG_ 766 IDCM_PassengerTempSet_Cmd "Passenger Temperature Set Command
副驾温度设置";
CM_ SG_ 766 IDCM_IONSet_Cmd "ION Set Command
负离子发生器的开关";
CM_ SG_ 766 IDCM_ACOperationMode_Cmd "AC Operation Mode Command
空调运行模式";
CM_ SG_ 766 IDCM_FD_21_Reserved5 "Reserved for future extensions
信号扩展预留位";
CM_ SG_ 766 IDCM_RearACAuto_Cmd "Rear AC Auto Command
后空调自动";
CM_ SG_ 766 IDCM_RearACSwitch_Cmd "Rear AC Switch Command
后空调开关机";
CM_ SG_ 766 IDCM_RearRowTempSet_Cmd "Rear Row Temperature Set Command
后空调温度调节";
CM_ SG_ 766 IDCM_AutoDefrostSet_Cmd "Auto Defrost Set Command
自动除雾";
CM_ SG_ 766 IDCM_FD_21_Reserved6 "Reserved for future extensions
信号扩展预留位";
CM_ SG_ 766 IDCM_RearACMode_Cmd "Rear AC Mode Command
后空调模式";
CM_ SG_ 766 IDCM_InsideFilterReset "Inside Filter Reset
车内滤芯重置清零，计时重新开始（事件型信号）";
CM_ SG_ 766 IDCM_RearACAirFlowLevel_Cmd "Rear AC Air Flow Level Command
后空调风量";
CM_ SG_ 766 IDCM_InsideFilterLifeRemind "Inside Filter Life Remind
车内滤芯是否关闭后续提醒关闭提醒（事件型信号）";
CM_ SG_ 766 IDCM_AirFragranceSwitchEnable "Air Fragrance Switch Enable
香氛开关使能请求";
CM_ SG_ 766 IDCM_AirFragranceChannel1 "Air Fragrance Channel1
1通道请求开启";
CM_ SG_ 766 IDCM_AirFragranceChannel2 "Air Fragrance Channel2
2通道请求开启";
CM_ SG_ 766 IDCM_AirFragranceChannel3 "Air Fragrance Channel3
3通道请求开启";
CM_ SG_ 766 IDCM_OutsideFilterReset "Outside Filter Reset
车外滤芯重置清零，计时重新开始（事件型信号）";
CM_ SG_ 766 IDCM_FragranceConcentration_Req "Fragrance Concentration Request
浓度选择";
CM_ SG_ 766 IDCM_OutsideFilterLifeRemind "Outside Filter Life Remind
车外滤芯是否关闭后续提醒关闭提醒（事件型信号）";
CM_ SG_ 766 IDCM_DSMremindwayset "DSM Remind Way Set
DSM提醒方式";
CM_ SG_ 766 IDCM_FD_21_Reserved1 "Reserved for future extensions
信号扩展预留位";
CM_ SG_ 766 IDCM_FD_21_Reserved2 "Reserved for future extensions
信号扩展预留位";
CM_ SG_ 766 IDCM_FD_21_Reserved3 "Reserved for future extensions
信号扩展预留位";
CM_ SG_ 382 IDCM_FaceRegister_Req "Request face registration
人脸注册请求";
CM_ SG_ 382 IDCM_FaceRegisterResponse_St "Status whether registration is finished
最终人脸注册结果";
CM_ SG_ 382 IDCM_DeleteFaceID_Req "Request Delete FaceID 
人脸删除请求";
CM_ SG_ 382 IDCM_FaceRecognition_Req "Request Face Recognition
人脸对比请求";
CM_ SG_ 382 IDCM_DSMUserID "User ID
用户ID";
CM_ SG_ 382 IDCM_DSMSwitch "DSM ON/OFF switch
驾驶员疲劳报警功能开关输入";
CM_ SG_ 382 IDCM_FD_22_Reserved1 "Reserved for future extensions
信号扩展预留位";
CM_ SG_ 382 IDCM_FD_22_Reserved2 "Reserved for future extensions
信号扩展预留位";
CM_ SG_ 382 IDCM_FD_22_Reserved3 "Reserved for future extensions
信号扩展预留位";
CM_ SG_ 382 IDCM_FD_22_Reserved4 "Reserved for future extensions
信号扩展预留位";
CM_ SG_ 1011 IDCM_DestinationDistance "Destination Distance
目的地剩余距离";
CM_ SG_ 1011 IDCM_FrontCrossDistance "Front Cross Distance
前方路口距离";
CM_ SG_ 1011 IDCM_FrontCrossName "Front Cross Name
前方路口名称";
CM_ SG_ 1011 IDCM_DestinationRemainTime "Destination Remain time
目的地剩余时间";
CM_ SG_ 1011 IDCM_CameraInformation "Camera Information
摄像头信息";
CM_ SG_ 1011 IDCM_NextCrossDirection "Next Cross Direction
下一个路口的导向";
CM_ SG_ 1011 IDCM_TrafficInformation "Traffic Information
路况信息（畅通/较拥堵/拥堵）";
CM_ SG_ 1011 IDCM_CurrentSpeedLimit "Current Road Speed Limit Information
当前道路限速信息";
CM_ SG_ 1011 IDCM_SpecialRoad "Special Road / Warning Point Information
特殊道路/警示点信息";
CM_ SG_ 1011 IDCM_FrontCrossNameLength "Front Cross Name Length
前方路口名称长度";
CM_ SG_ 1011 IDCM_FrontRoadBacklane "IDCM_Front Road backlane
前方道路背景车道";
CM_ SG_ 1011 IDCM_FrontRoadFrontlane "IDCM_Front Road frontlane
前方道路前景车道";
CM_ SG_ 1011 IDCM_DestinationReachFlag "Destination Reach Flag
到终点标识";
CM_ SG_ 1011 IDCM_FrontCrossNameFrameIndex "Front Cross Name Frame Index
前方路口名称帧序号";
CM_ SG_ 1011 IDCM_FD_2_Reserved1 "Reserved for future extensions
信号扩展预留位";
CM_ SG_ 1011 IDCM_FD_2_Reserved2 "Reserved for future extensions
信号扩展预留位";
CM_ SG_ 383 IDCM_FaceEigenvalueData_Length "Face Eigenvalue Data Length
人脸特征值数据长度（数据长度最大值65534Byte）";
CM_ SG_ 383 IDCM_FaceEigenvalueData_Index "Face Eigenvalue Data Length
人脸特征值数据包号（包号最大为2341）";
CM_ SG_ 383 IDCM_FaceEigenvalueData_Byte1 "Face Eigenvalue Data_Indev_Byte1
人脸特征值数据-包号-Byte1";
CM_ SG_ 383 IDCM_FaceEigenvalueData_Byte2 "Face Eigenvalue Data_Indev_Byte2
人脸特征值数据-包号-Byte2";
CM_ SG_ 383 IDCM_FaceEigenvalueData_Byte3 "Face Eigenvalue Data_Indev_Byte3
人脸特征值数据-包号-Byte3";
CM_ SG_ 383 IDCM_FaceEigenvalueData_Byte4 "Face Eigenvalue Data_Indev_Byte4
人脸特征值数据-包号-Byte4";
CM_ SG_ 383 IDCM_FaceEigenvalueData_Byte5 "Face Eigenvalue Data_Indev_Byte5
人脸特征值数据-包号-Byte5";
CM_ SG_ 383 IDCM_FaceEigenvalueData_Byte6 "Face Eigenvalue Data_Indev_Byte6
人脸特征值数据-包号-Byte6";
CM_ SG_ 383 IDCM_FaceEigenvalueData_Byte7 "Face Eigenvalue Data_Indev_Byte7
人脸特征值数据-包号-Byte7";
CM_ SG_ 383 IDCM_FaceEigenvalueData_Byte8 "Face Eigenvalue Data_Indev_Byte8
人脸特征值数据-包号-Byte8";
CM_ SG_ 383 IDCM_FaceEigenvalueData_Byte9 "Face Eigenvalue Data_Indev_Byte9
人脸特征值数据-包号-Byte9";
CM_ SG_ 383 IDCM_FaceEigenvalueData_Byte10 "Face Eigenvalue Data_Indev_Byte10
人脸特征值数据-包号-Byte10";
CM_ SG_ 383 IDCM_FaceEigenvalueData_Byte11 "Face Eigenvalue Data_Indev_Byte11
人脸特征值数据-包号-Byte11";
CM_ SG_ 383 IDCM_FaceEigenvalueData_Byte12 "Face Eigenvalue Data_Indev_Byte12
人脸特征值数据-包号-Byte12";
CM_ SG_ 383 IDCM_FaceEigenvalueData_Byte13 "Face Eigenvalue Data_Indev_Byte13
人脸特征值数据-包号-Byte13";
CM_ SG_ 383 IDCM_FaceEigenvalueData_Byte14 "Face Eigenvalue Data_Indev_Byte14
人脸特征值数据-包号-Byte14";
CM_ SG_ 383 IDCM_FaceEigenvalueData_Byte15 "Face Eigenvalue Data_Indev_Byte15
人脸特征值数据-包号-Byte15";
CM_ SG_ 383 IDCM_FaceEigenvalueData_Byte16 "Face Eigenvalue Data_Indev_Byte16
人脸特征值数据-包号-Byte16";
CM_ SG_ 383 IDCM_FaceEigenvalueData_Byte17 "Face Eigenvalue Data_Indev_Byte17
人脸特征值数据-包号-Byte17";
CM_ SG_ 383 IDCM_FaceEigenvalueData_Byte18 "Face Eigenvalue Data_Indev_Byte18
人脸特征值数据-包号-Byte18";
CM_ SG_ 383 IDCM_FaceEigenvalueData_Byte19 "Face Eigenvalue Data_Indev_Byte19
人脸特征值数据-包号-Byte19";
CM_ SG_ 383 IDCM_FaceEigenvalueData_Byte20 "Face Eigenvalue Data_Indev_Byte20
人脸特征值数据-包号-Byte20";
CM_ SG_ 383 IDCM_FaceEigenvalueData_Byte21 "Face Eigenvalue Data_Indev_Byte21
人脸特征值数据-包号-Byte21";
CM_ SG_ 383 IDCM_FaceEigenvalueData_Byte22 "Face Eigenvalue Data_Indev_Byte22
人脸特征值数据-包号-Byte22";
CM_ SG_ 383 IDCM_FaceEigenvalueData_Byte23 "Face Eigenvalue Data_Indev_Byte23
人脸特征值数据-包号-Byte23";
CM_ SG_ 383 IDCM_FaceEigenvalueData_Byte24 "Face Eigenvalue Data_Indev_Byte24
人脸特征值数据-包号-Byte24";
CM_ SG_ 383 IDCM_FaceEigenvalueData_Byte25 "Face Eigenvalue Data_Indev_Byte25
人脸特征值数据-包号-Byte25";
CM_ SG_ 383 IDCM_FaceEigenvalueData_Byte26 "Face Eigenvalue Data_Indev_Byte26
人脸特征值数据-包号-Byte26";
CM_ SG_ 383 IDCM_FaceEigenvalueData_Byte27 "Face Eigenvalue Data_Indev_Byte27
人脸特征值数据-包号-Byte27";
CM_ SG_ 383 IDCM_FaceEigenvalueData_Byte28 "Face Eigenvalue Data_Indev_Byte28
人脸特征值数据-包号-Byte28";
CM_ SG_ 1019 ALMIP_CustomColorSet_St "Instrument Panel ALM Custom Color Status
氛围灯自定义颜色设置状态";
CM_ SG_ 1019 ALMIP_CustomLuminanceSet_St "Instrument Panel ALM Custom Luminance Set Status
氛围灯自定义亮度设置状态";
CM_ SG_ 1019 ALMIP_ThemeMode_St "Instrument Panel ALM Theme Mode Status
氛围灯主题模式设置状态";
CM_ SG_ 1019 ALMIP_ONOFF_St "Instrument Panel ALM ON/OFF Status
氛围灯开关状态";
CM_ SG_ 1019 WPC_ControllerFaultStatus "Controller Fault Status
描述ECU当前故障状态";
CM_ SG_ 1019 AMP_ControllerFaultStatus "Controller Fault Status
描述ECU当前故障状态";
CM_ SG_ 1019 ALM_IP_ControllerFaultStatus "Controller Fault Status
描述ECU当前故障状态";
CM_ SG_ 1019 ALM_IPR_ControllerFaultStatus "Controller Fault Status
描述ECU当前故障状态";
CM_ SG_ 1019 ALM_FL_ControllerFaultStatus "Controller Fault Status
描述ECU当前故障状态";
CM_ SG_ 1019 ALM_FR_ControllerFaultStatus "Controller Fault Status
描述ECU当前故障状态";
CM_ SG_ 1019 IDCM_FD_RT_1_Reserved5 "Reserved for future extensions
信号扩展预留位";
CM_ SG_ 1019 IDCM_FD_RT_1_WPC_Available_St "If signals which route from WPC in message IDCM_FD_RT_1 are available
报文IDCM_FD_RT_1中路由的WPC节点的信号是否可信";
CM_ SG_ 1019 IDCM_FD_RT_1_AMP_Available_St "If signals which route from AMP in message IDCM_FD_RT_1 are available
报文IDCM_FD_RT_1中路由的AMP节点的信号是否可信";
CM_ SG_ 1019 IDCM_FD_RT_1_ALMIP_Available_St "If signals which route from ALM_IP in message IDCM_FD_RT_1 are available
报文IDCM_FD_RT_1中路由的ALM_IP节点的信号是否可信";
CM_ SG_ 1019 IDCM_FD_RT_1_ALMIPR_Available_St "If signals which route from ALM_IPR in message IDCM_FD_RT_1 are available
报文IDCM_FD_RT_1中路由的ALM_IPR节点的信号是否可信";
CM_ SG_ 1019 IDCM_FD_RT_1_ALMFL_Available_St "If signals which route from ALM_FL in message IDCM_FD_RT_1 are available
报文IDCM_FD_RT_1中路由的ALM_FL节点的信号是否可信";
CM_ SG_ 1019 IDCM_FD_RT_1_ALMFR_Available_St "If signals which route from ALM_FR in message IDCM_FD_RT_1 are available
报文IDCM_FD_RT_1中路由的ALM_FR节点的信号是否可信";
CM_ SG_ 1019 IDCM_FD_RT_1_Reserved1 "Reserved for future extensions
信号扩展预留位";
CM_ SG_ 1019 IDCM_FD_RT_1_Reserved2 "Reserved for future extensions
信号扩展预留位";
CM_ SG_ 1019 IDCM_FD_RT_1_Reserved3 "Reserved for future extensions
信号扩展预留位";
CM_ SG_ 1019 IDCM_FD_RT_1_Reserved4 "Reserved for future extensions
信号扩展预留位";
CM_ SG_ 1104 IDCM_NodeAddress "Node source address
节点源地址";
CM_ SG_ 1104 IDCM_RepeatMsgReq "Repeat Message Request Bit
重复报文请求位";
CM_ SG_ 1104 IDCM_ActiveWakeup "Active Wakeup Bit
主动唤醒指示位";
CM_ SG_ 1104 IDCM_RepeatMsgSt "Repeat Message State indication
节点处在重复报文状态指示位";
CM_ SG_ 1104 IDCM_WakeupCGW_TBOX_CANFD "Wakeup  TBOX_CANFD network requirement flag
唤醒TBOX_CANFD网段需求标志";
CM_ SG_ 1104 IDCM_WakeupCGW_IOV_Backbone "Wakeup IOV_Backbone network requirement flag
唤醒IOV_Backbone网段需求标志";
CM_ SG_ 1104 IDCM_WakeupCGW_ADAS_Backbone "Wakeup ADAS_Backbone  network requirement flag
唤醒ADAS_Backbone网段需求标志";
CM_ SG_ 1104 IDCM_WakeupCGW_Chassis_Backbone "Wakeup  Chassis_Backbone network requirement flag
唤醒Chassis_Backbone网段需求标志";
CM_ SG_ 1104 IDCM_WakeupCGW_PT_Backbone "Wakeup PT_Backbone network requirement flag
唤醒PT_Backbone网段需求标志";
CM_ SG_ 1104 IDCM_WakeupCGW_BD_Backbone "Wakeup BD_Backbone  network requirement flag
唤醒BD_Backbone网段需求标志";
CM_ SG_ 1104 IDCM_WakeupCGW_Diagnostic_CANFD "Wakeup Diagnostic_CANFD  network requirement flag
唤醒Diagnostic_CANFD网段需求标志";
CM_ SG_ 1104 IDCM_WakeupCGW_CGW_LIN1 "Wakeup CGW_LIN1 network requirement flag
唤醒CGW_LIN1网段需求标志";
CM_ SG_ 1104 IDCM_WakeupBDCM_Body_CAN1 "Wakeup Body_CAN1  network requirement flag
唤醒Body_CAN1网段需求标志";
CM_ SG_ 1104 IDCM_WakeupBDCM_Body_CAN2 "Wakeup Body_CAN2 network requirement flag
唤醒Body_CAN2网段需求标志";
CM_ SG_ 1104 IDCM_WakeupBDCM_Body_LIN1 "Wakeup  Body_LIN1 network requirement flag
唤醒Body_LIN1网段需求标志";
CM_ SG_ 1104 IDCM_WakeupBDCM_Body_LIN2 "Wakeup Body_LIN2 network requirement flag
唤醒Body_LIN2网段需求标志";
CM_ SG_ 1104 IDCM_WakeupBDCM_Body_LIN3 "Wakeup Body_LIN3 network requirement flag
唤醒Body_LIN3网段需求标志";
CM_ SG_ 1104 IDCM_WakeupBDCM_SCM_LIN "Wakeup SCM_LIN  network requirement flag
唤醒SCM_LIN网段需求标志";
CM_ SG_ 1104 IDCM_WakeupIDCM_IOV_CAN "Wakeup IOV_CAN network requirement flag
唤醒IOV_CAN网段需求标志";
CM_ SG_ 1104 IDCM_WakeupVDCM_PT_CANFD1 "Wakeup PT_CANFD1  network requirement flag
唤醒PT_CANFD1网段需求标志";
CM_ SG_ 1104 IDCM_WakeupVDCM_PT_CANFD2 "Wakeup PT_CANFD2  network requirement flag
唤醒PT_CANFD2网段需求标志";
CM_ SG_ 1104 IDCM_WakeupVDCM_PT_CAN1 "Wakeup PT_CAN1  network requirement flag
唤醒PT_CAN1网段需求标志";
CM_ SG_ 1104 IDCM_WakeupVDCM_PT_LIN2 "Wakeup PT_LIN2 network requirement flag
唤醒PT_LIN2网段需求标志";
CM_ SG_ 1104 IDCM_WakeupVDCM_Chassis_Backup "Wakeup Chassis_Backup network requirement flag
唤醒Chassis_Backup网段需求标志";
CM_ SG_ 1104 IDCM_KeepAwakeReason_KL15 "the reason of node Keep awake and send Network Message is KL15
节点因KL15保持唤醒并发送网管报文";
CM_ SG_ 1104 IDCM_KeepAwakeReason_Local "the reason of node Keep awake and send Network Message is Local condition except KL15
节点因本地条件（除KL15）保持唤醒并发送网管报文";
CM_ SG_ 1104 IDCM_KeepAwakeReason_Diagnostic "the reason of node Keep awake and send Network Message is Node in diagnostic session
节点因处在诊断会话而保持唤醒并发送网管报文";
CM_ SG_ 1104 IDCM_KeepAwakeReason_Network "the reason of node Keep awake and send Network Message is the requirement from network which node direct-connect
节点因直连的网络需求保持唤醒并发送网管报文";
CM_ SG_ 752 VSP_WakeupUserID_OnlyForIV2 "Wakeup of UserID
FaceID检测成功后唤醒的User ID";
CM_ SG_ 752 VSP_WakeupSuperID "Wakeup of SuperID
检测成功后唤醒的SuperID";
CM_ SG_ 1106 ARC_NodeAddress "Node source address
节点源地址";
CM_ SG_ 1106 ARC_RepeatMsgReq "Repeat Message Request Bit
重复报文请求位";
CM_ SG_ 1106 ARC_ActiveWakeup "Active Wakeup Bit
主动唤醒指示位";
CM_ SG_ 1106 ARC_RepeatMsgSt "Repeat Message State indication
节点处在重复报文状态指示位";
CM_ SG_ 1106 ARC_WakeupCGW_TBOX_CANFD "Wakeup  TBOX_CANFD network requirement flag
唤醒TBOX_CANFD网段需求标志";
CM_ SG_ 1106 ARC_WakeupCGW_IOV_Backbone "Wakeup IOV_Backbone network requirement flag
唤醒IOV_Backbone网段需求标志";
CM_ SG_ 1106 ARC_WakeupCGW_ADAS_Backbone "Wakeup ADAS_Backbone  network requirement flag
唤醒ADAS_Backbone网段需求标志";
CM_ SG_ 1106 ARC_WakeupCGW_Chassis_Backbone "Wakeup  Chassis_Backbone network requirement flag
唤醒Chassis_Backbone网段需求标志";
CM_ SG_ 1106 ARC_WakeupCGW_PT_Backbone "Wakeup PT_Backbone network requirement flag
唤醒PT_Backbone网段需求标志";
CM_ SG_ 1106 ARC_WakeupCGW_BD_Backbone "Wakeup BD_Backbone  network requirement flag
唤醒BD_Backbone网段需求标志";
CM_ SG_ 1106 ARC_WakeupCGW_Diagnostic_CANFD "Wakeup Diagnostic_CANFD  network requirement flag
唤醒Diagnostic_CANFD网段需求标志";
CM_ SG_ 1106 ARC_WakeupCGW_CGW_LIN1 "Wakeup CGW_LIN1 network requirement flag
唤醒CGW_LIN1网段需求标志";
CM_ SG_ 1106 ARC_WakeupBDCM_Body_CAN1 "Wakeup Body_CAN1  network requirement flag
唤醒Body_CAN1网段需求标志";
CM_ SG_ 1106 ARC_WakeupBDCM_Body_CAN2 "Wakeup Body_CAN2 network requirement flag
唤醒Body_CAN2网段需求标志";
CM_ SG_ 1106 ARC_WakeupBDCM_Body_LIN1 "Wakeup  Body_LIN1 network requirement flag
唤醒Body_LIN1网段需求标志";
CM_ SG_ 1106 ARC_WakeupBDCM_Body_LIN2 "Wakeup Body_LIN2 network requirement flag
唤醒Body_LIN2网段需求标志";
CM_ SG_ 1106 ARC_WakeupBDCM_Body_LIN3 "Wakeup Body_LIN3 network requirement flag
唤醒Body_LIN3网段需求标志";
CM_ SG_ 1106 ARC_WakeupBDCM_SCM_LIN "Wakeup SCM_LIN  network requirement flag
唤醒SCM_LIN网段需求标志";
CM_ SG_ 1106 ARC_WakeupIDCM_IOV_CAN "Wakeup IOV_CAN network requirement flag
唤醒IOV_CAN网段需求标志";
CM_ SG_ 1106 ARC_WakeupVDCM_PT_CANFD1 "Wakeup PT_CANFD1  network requirement flag
唤醒PT_CANFD1网段需求标志";
CM_ SG_ 1106 ARC_WakeupVDCM_PT_CANFD2 "Wakeup PT_CANFD2  network requirement flag
唤醒PT_CANFD2网段需求标志";
CM_ SG_ 1106 ARC_WakeupVDCM_PT_CAN1 "Wakeup PT_CAN1  network requirement flag
唤醒PT_CAN1网段需求标志";
CM_ SG_ 1106 ARC_WakeupVDCM_PT_LIN2 "Wakeup PT_LIN2 network requirement flag
唤醒PT_LIN2网段需求标志";
CM_ SG_ 1106 ARC_WakeupVDCM_Chassis_Backup "Wakeup Chassis_Backup network requirement flag
唤醒Chassis_Backup网段需求标志";
CM_ SG_ 1106 ARC_KeepAwakeReason_KL15 "the reason of node Keep awake and send Network Message is KL15
节点因KL15保持唤醒并发送网管报文";
CM_ SG_ 1106 ARC_KeepAwakeReason_Local "the reason of node Keep awake and send Network Message is Local condition except KL15
节点因本地条件（除KL15）保持唤醒并发送网管报文";
CM_ SG_ 1106 ARC_KeepAwakeReason_Diagnostic "the reason of node Keep awake and send Network Message is Node in diagnostic session
节点因处在诊断会话而保持唤醒并发送网管报文";
CM_ SG_ 1106 ARC_KeepAwakeReason_Network "the reason of node Keep awake and send Network Message is the requirement from network which node direct-connect
节点因直连的网络需求保持唤醒并发送网管报文";
CM_ SG_ 1107 ARHUD_NodeAddress "Node source address
节点源地址";
CM_ SG_ 1107 ARHUD_RepeatMsgReq "Repeat Message Request Bit
重复报文请求位";
CM_ SG_ 1107 ARHUD_ActiveWakeup "Active Wakeup Bit
主动唤醒指示位";
CM_ SG_ 1107 ARHUD_RepeatMsgSt "Repeat Message State indication
节点处在重复报文状态指示位";
CM_ SG_ 1107 ARHUD_WakeupCGW_TBOX_CANFD "Wakeup  TBOX_CANFD network requirement flag
唤醒TBOX_CANFD网段需求标志";
CM_ SG_ 1107 ARHUD_WakeupCGW_IOV_Backbone "Wakeup IOV_Backbone network requirement flag
唤醒IOV_Backbone网段需求标志";
CM_ SG_ 1107 ARHUD_WakeupCGW_ADAS_Backbone "Wakeup ADAS_Backbone  network requirement flag
唤醒ADAS_Backbone网段需求标志";
CM_ SG_ 1107 ARHUD_WakeupCGW_Chassis_Backbone "Wakeup  Chassis_Backbone network requirement flag
唤醒Chassis_Backbone网段需求标志";
CM_ SG_ 1107 ARHUD_WakeupCGW_PT_Backbone "Wakeup PT_Backbone network requirement flag
唤醒PT_Backbone网段需求标志";
CM_ SG_ 1107 ARHUD_WakeupCGW_BD_Backbone "Wakeup BD_Backbone  network requirement flag
唤醒BD_Backbone网段需求标志";
CM_ SG_ 1107 ARHUD_WakeupCGW_Diagnostic_CANFD "Wakeup Diagnostic_CANFD  network requirement flag
唤醒Diagnostic_CANFD网段需求标志";
CM_ SG_ 1107 ARHUD_WakeupCGW_CGW_LIN1 "Wakeup CGW_LIN1 network requirement flag
唤醒CGW_LIN1网段需求标志";
CM_ SG_ 1107 ARHUD_WakeupBDCM_Body_CAN1 "Wakeup Body_CAN1  network requirement flag
唤醒Body_CAN1网段需求标志";
CM_ SG_ 1107 ARHUD_WakeupBDCM_Body_CAN2 "Wakeup Body_CAN2 network requirement flag
唤醒Body_CAN2网段需求标志";
CM_ SG_ 1107 ARHUD_WakeupBDCM_Body_LIN1 "Wakeup  Body_LIN1 network requirement flag
唤醒Body_LIN1网段需求标志";
CM_ SG_ 1107 ARHUD_WakeupBDCM_Body_LIN2 "Wakeup Body_LIN2 network requirement flag
唤醒Body_LIN2网段需求标志";
CM_ SG_ 1107 ARHUD_WakeupBDCM_Body_LIN3 "Wakeup Body_LIN3 network requirement flag
唤醒Body_LIN3网段需求标志";
CM_ SG_ 1107 ARHUD_WakeupBDCM_SCM_LIN "Wakeup SCM_LIN  network requirement flag
唤醒SCM_LIN网段需求标志";
CM_ SG_ 1107 ARHUD_WakeupIDCM_IOV_CAN "Wakeup IOV_CAN network requirement flag
唤醒IOV_CAN网段需求标志";
CM_ SG_ 1107 ARHUD_WakeupVDCM_PT_CANFD1 "Wakeup PT_CANFD1  network requirement flag
唤醒PT_CANFD1网段需求标志";
CM_ SG_ 1107 ARHUD_WakeupVDCM_PT_CANFD2 "Wakeup PT_CANFD2  network requirement flag
唤醒PT_CANFD2网段需求标志";
CM_ SG_ 1107 ARHUD_WakeupVDCM_PT_CAN1 "Wakeup PT_CAN1  network requirement flag
唤醒PT_CAN1网段需求标志";
CM_ SG_ 1107 ARHUD_WakeupVDCM_PT_LIN2 "Wakeup PT_LIN2 network requirement flag
唤醒PT_LIN2网段需求标志";
CM_ SG_ 1107 ARHUD_WakeupVDCM_Chassis_Backup "Wakeup Chassis_Backup network requirement flag
唤醒Chassis_Backup网段需求标志";
CM_ SG_ 1107 ARHUD_KeepAwakeReason_KL15 "the reason of node Keep awake and send Network Message is KL15
节点因KL15保持唤醒并发送网管报文";
CM_ SG_ 1107 ARHUD_KeepAwakeReason_Local "the reason of node Keep awake and send Network Message is Local condition except KL15
节点因本地条件（除KL15）保持唤醒并发送网管报文";
CM_ SG_ 1107 ARHUD_KeepAwakeReason_Diagnostic "the reason of node Keep awake and send Network Message is Node in diagnostic session
节点因处在诊断会话而保持唤醒并发送网管报文";
CM_ SG_ 1107 ARHUD_KeepAwakeReason_Network "the reason of node Keep awake and send Network Message is the requirement from network which node direct-connect
节点因直连的网络需求保持唤醒并发送网管报文";
CM_ SG_ 1108 WHUD_NodeAddress "Node source address
节点源地址";
CM_ SG_ 1108 WHUD_RepeatMsgReq "Repeat Message Request Bit
重复报文请求位";
CM_ SG_ 1108 WHUD_ActiveWakeup "Active Wakeup Bit
主动唤醒指示位";
CM_ SG_ 1108 WHUD_RepeatMsgSt "Repeat Message State indication
节点处在重复报文状态指示位";
CM_ SG_ 1108 WHUD_WakeupCGW_TBOX_CANFD "Wakeup  TBOX_CANFD network requirement flag
唤醒TBOX_CANFD网段需求标志";
CM_ SG_ 1108 WHUD_WakeupCGW_IOV_Backbone "Wakeup IOV_Backbone network requirement flag
唤醒IOV_Backbone网段需求标志";
CM_ SG_ 1108 WHUD_WakeupCGW_ADAS_Backbone "Wakeup ADAS_Backbone  network requirement flag
唤醒ADAS_Backbone网段需求标志";
CM_ SG_ 1108 WHUD_WakeupCGW_Chassis_Backbone "Wakeup  Chassis_Backbone network requirement flag
唤醒Chassis_Backbone网段需求标志";
CM_ SG_ 1108 WHUD_WakeupCGW_PT_Backbone "Wakeup PT_Backbone network requirement flag
唤醒PT_Backbone网段需求标志";
CM_ SG_ 1108 WHUD_WakeupCGW_BD_Backbone "Wakeup BD_Backbone  network requirement flag
唤醒BD_Backbone网段需求标志";
CM_ SG_ 1108 WHUD_WakeupCGW_Diagnostic_CANFD "Wakeup Diagnostic_CANFD  network requirement flag
唤醒Diagnostic_CANFD网段需求标志";
CM_ SG_ 1108 WHUD_WakeupCGW_CGW_LIN1 "Wakeup CGW_LIN1 network requirement flag
唤醒CGW_LIN1网段需求标志";
CM_ SG_ 1108 WHUD_WakeupBDCM_Body_CAN1 "Wakeup Body_CAN1  network requirement flag
唤醒Body_CAN1网段需求标志";
CM_ SG_ 1108 WHUD_WakeupBDCM_Body_CAN2 "Wakeup Body_CAN2 network requirement flag
唤醒Body_CAN2网段需求标志";
CM_ SG_ 1108 WHUD_WakeupBDCM_Body_LIN1 "Wakeup  Body_LIN1 network requirement flag
唤醒Body_LIN1网段需求标志";
CM_ SG_ 1108 WHUD_WakeupBDCM_Body_LIN2 "Wakeup Body_LIN2 network requirement flag
唤醒Body_LIN2网段需求标志";
CM_ SG_ 1108 WHUD_WakeupBDCM_Body_LIN3 "Wakeup Body_LIN3 network requirement flag
唤醒Body_LIN3网段需求标志";
CM_ SG_ 1108 WHUD_WakeupBDCM_SCM_LIN "Wakeup SCM_LIN  network requirement flag
唤醒SCM_LIN网段需求标志";
CM_ SG_ 1108 WHUD_WakeupIDCM_IOV_CAN "Wakeup IOV_CAN network requirement flag
唤醒IOV_CAN网段需求标志";
CM_ SG_ 1108 WHUD_WakeupVDCM_PT_CANFD1 "Wakeup PT_CANFD1  network requirement flag
唤醒PT_CANFD1网段需求标志";
CM_ SG_ 1108 WHUD_WakeupVDCM_PT_CANFD2 "Wakeup PT_CANFD2  network requirement flag
唤醒PT_CANFD2网段需求标志";
CM_ SG_ 1108 WHUD_WakeupVDCM_PT_CAN1 "Wakeup PT_CAN1  network requirement flag
唤醒PT_CAN1网段需求标志";
CM_ SG_ 1108 WHUD_WakeupVDCM_PT_LIN2 "Wakeup PT_LIN2 network requirement flag
唤醒PT_LIN2网段需求标志";
CM_ SG_ 1108 WHUD_WakeupVDCM_Chassis_Backup "Wakeup Chassis_Backup network requirement flag
唤醒Chassis_Backup网段需求标志";
CM_ SG_ 1108 WHUD_KeepAwakeReason_KL15 "the reason of node Keep awake and send Network Message is KL15
节点因KL15保持唤醒并发送网管报文";
CM_ SG_ 1108 WHUD_KeepAwakeReason_Local "the reason of node Keep awake and send Network Message is Local condition except KL15
节点因本地条件（除KL15）保持唤醒并发送网管报文";
CM_ SG_ 1108 WHUD_KeepAwakeReason_Diagnostic "the reason of node Keep awake and send Network Message is Node in diagnostic session
节点因处在诊断会话而保持唤醒并发送网管报文";
CM_ SG_ 1108 WHUD_KeepAwakeReason_Network "the reason of node Keep awake and send Network Message is the requirement from network which node direct-connect
节点因直连的网络需求保持唤醒并发送网管报文";
CM_ SG_ 1109 VSP_NodeAddress "Node source address
节点源地址";
CM_ SG_ 1109 VSP_RepeatMsgReq "Repeat Message Request Bit
重复报文请求位";
CM_ SG_ 1109 VSP_ActiveWakeup "Active Wakeup Bit
主动唤醒指示位";
CM_ SG_ 1109 VSP_RepeatMsgSt "Repeat Message State indication
节点处在重复报文状态指示位";
CM_ SG_ 1109 VSP_WakeupCGW_TBOX_CANFD "Wakeup  TBOX_CANFD network requirement flag
唤醒TBOX_CANFD网段需求标志";
CM_ SG_ 1109 VSP_WakeupCGW_IOV_Backbone "Wakeup IOV_Backbone network requirement flag
唤醒IOV_Backbone网段需求标志";
CM_ SG_ 1109 VSP_WakeupCGW_ADAS_Backbone "Wakeup ADAS_Backbone  network requirement flag
唤醒ADAS_Backbone网段需求标志";
CM_ SG_ 1109 VSP_WakeupCGW_Chassis_Backbone "Wakeup  Chassis_Backbone network requirement flag
唤醒Chassis_Backbone网段需求标志";
CM_ SG_ 1109 VSP_WakeupCGW_PT_Backbone "Wakeup PT_Backbone network requirement flag
唤醒PT_Backbone网段需求标志";
CM_ SG_ 1109 VSP_WakeupCGW_BD_Backbone "Wakeup BD_Backbone  network requirement flag
唤醒BD_Backbone网段需求标志";
CM_ SG_ 1109 VSP_WakeupCGW_Diagnostic_CANFD "Wakeup Diagnostic_CANFD  network requirement flag
唤醒Diagnostic_CANFD网段需求标志";
CM_ SG_ 1109 VSP_WakeupCGW_CGW_LIN1 "Wakeup CGW_LIN1 network requirement flag
唤醒CGW_LIN1网段需求标志";
CM_ SG_ 1109 VSP_WakeupBDCM_Body_CAN1 "Wakeup Body_CAN1  network requirement flag
唤醒Body_CAN1网段需求标志";
CM_ SG_ 1109 VSP_WakeupBDCM_Body_CAN2 "Wakeup Body_CAN2 network requirement flag
唤醒Body_CAN2网段需求标志";
CM_ SG_ 1109 VSP_WakeupBDCM_Body_LIN1 "Wakeup  Body_LIN1 network requirement flag
唤醒Body_LIN1网段需求标志";
CM_ SG_ 1109 VSP_WakeupBDCM_Body_LIN2 "Wakeup Body_LIN2 network requirement flag
唤醒Body_LIN2网段需求标志";
CM_ SG_ 1109 VSP_WakeupBDCM_Body_LIN3 "Wakeup Body_LIN3 network requirement flag
唤醒Body_LIN3网段需求标志";
CM_ SG_ 1109 VSP_WakeupBDCM_SCM_LIN "Wakeup SCM_LIN  network requirement flag
唤醒SCM_LIN网段需求标志";
CM_ SG_ 1109 VSP_WakeupIDCM_IOV_CAN "Wakeup IOV_CAN network requirement flag
唤醒IOV_CAN网段需求标志";
CM_ SG_ 1109 VSP_WakeupVDCM_PT_CANFD1 "Wakeup PT_CANFD1  network requirement flag
唤醒PT_CANFD1网段需求标志";
CM_ SG_ 1109 VSP_WakeupVDCM_PT_CANFD2 "Wakeup PT_CANFD2  network requirement flag
唤醒PT_CANFD2网段需求标志";
CM_ SG_ 1109 VSP_WakeupVDCM_PT_CAN1 "Wakeup PT_CAN1  network requirement flag
唤醒PT_CAN1网段需求标志";
CM_ SG_ 1109 VSP_WakeupVDCM_PT_LIN2 "Wakeup PT_LIN2 network requirement flag
唤醒PT_LIN2网段需求标志";
CM_ SG_ 1109 VSP_WakeupVDCM_Chassis_Backup "Wakeup Chassis_Backup network requirement flag
唤醒Chassis_Backup网段需求标志";
CM_ SG_ 1109 VSP_KeepAwakeReason_KL15 "the reason of node Keep awake and send Network Message is KL15
节点因KL15保持唤醒并发送网管报文";
CM_ SG_ 1109 VSP_KeepAwakeReason_Local "the reason of node Keep awake and send Network Message is Local condition except KL15
节点因本地条件（除KL15）保持唤醒并发送网管报文";
CM_ SG_ 1109 VSP_KeepAwakeReason_Diagnostic "the reason of node Keep awake and send Network Message is Node in diagnostic session
节点因处在诊断会话而保持唤醒并发送网管报文";
CM_ SG_ 1109 VSP_KeepAwakeReason_Network "the reason of node Keep awake and send Network Message is the requirement from network which node direct-connect
节点因直连的网络需求保持唤醒并发送网管报文";
CM_ SG_ 1025 CGW_NodeAddress "Node source address
节点源地址";
CM_ SG_ 1025 CGW_RepeatMsgReq "Repeat Message Request Bit
重复报文请求位";
CM_ SG_ 1025 CGW_ActiveWakeup "Active Wakeup Bit
主动唤醒指示位";
CM_ SG_ 1025 CGW_RepeatMsgSt "Repeat Message State indication
节点处在重复报文状态指示位";
CM_ SG_ 1025 CGW_WakeupCGW_TBOX_CANFD "Wakeup  TBOX_CANFD network requirement flag
唤醒TBOX_CANFD网段需求标志";
CM_ SG_ 1025 CGW_WakeupCGW_IOV_Backbone "Wakeup IOV_Backbone network requirement flag
唤醒IOV_Backbone网段需求标志";
CM_ SG_ 1025 CGW_WakeupCGW_ADAS_Backbone "Wakeup ADAS_Backbone  network requirement flag
唤醒ADAS_Backbone网段需求标志";
CM_ SG_ 1025 CGW_WakeupCGW_Chassis_Backbone "Wakeup  Chassis_Backbone network requirement flag
唤醒Chassis_Backbone网段需求标志";
CM_ SG_ 1025 CGW_WakeupCGW_PT_Backbone "Wakeup PT_Backbone network requirement flag
唤醒PT_Backbone网段需求标志";
CM_ SG_ 1025 CGW_WakeupCGW_BD_Backbone "Wakeup BD_Backbone  network requirement flag
唤醒BD_Backbone网段需求标志";
CM_ SG_ 1025 CGW_WakeupCGW_Diagnostic_CANFD "Wakeup Diagnostic_CANFD  network requirement flag
唤醒Diagnostic_CANFD网段需求标志";
CM_ SG_ 1025 CGW_WakeupCGW_CGW_LIN1 "Wakeup CGW_LIN1 network requirement flag
唤醒CGW_LIN1网段需求标志";
CM_ SG_ 1025 CGW_WakeupBDCM_Body_CAN1 "Wakeup Body_CAN1  network requirement flag
唤醒Body_CAN1网段需求标志";
CM_ SG_ 1025 CGW_WakeupBDCM_Body_CAN2 "Wakeup Body_CAN2 network requirement flag
唤醒Body_CAN2网段需求标志";
CM_ SG_ 1025 CGW_WakeupBDCM_Body_LIN1 "Wakeup  Body_LIN1 network requirement flag
唤醒Body_LIN1网段需求标志";
CM_ SG_ 1025 CGW_WakeupBDCM_Body_LIN2 "Wakeup Body_LIN2 network requirement flag
唤醒Body_LIN2网段需求标志";
CM_ SG_ 1025 CGW_WakeupBDCM_Body_LIN3 "Wakeup Body_LIN3 network requirement flag
唤醒Body_LIN3网段需求标志";
CM_ SG_ 1025 CGW_WakeupBDCM_SCM_LIN "Wakeup SCM_LIN  network requirement flag
唤醒SCM_LIN网段需求标志";
CM_ SG_ 1025 CGW_WakeupIDCM_IOV_CAN "Wakeup IOV_CAN network requirement flag
唤醒IOV_CAN网段需求标志";
CM_ SG_ 1025 CGW_WakeupVDCM_PT_CANFD1 "Wakeup PT_CANFD1  network requirement flag
唤醒PT_CANFD1网段需求标志";
CM_ SG_ 1025 CGW_WakeupVDCM_PT_CANFD2 "Wakeup PT_CANFD2  network requirement flag
唤醒PT_CANFD2网段需求标志";
CM_ SG_ 1025 CGW_WakeupVDCM_PT_CAN1 "Wakeup PT_CAN1  network requirement flag
唤醒PT_CAN1网段需求标志";
CM_ SG_ 1025 CGW_WakeupVDCM_PT_LIN2 "Wakeup PT_LIN2 network requirement flag
唤醒PT_LIN2网段需求标志";
CM_ SG_ 1025 CGW_WakeupVDCM_Chassis_Backup "Wakeup Chassis_Backup network requirement flag
唤醒Chassis_Backup网段需求标志";
CM_ SG_ 1025 CGW_KeepAwakeReason_KL15 "the reason of node Keep awake and send Network Message is KL15
节点因KL15保持唤醒并发送网管报文";
CM_ SG_ 1025 CGW_KeepAwakeReason_Local "the reason of node Keep awake and send Network Message is Local condition except KL15
节点因本地条件（除KL15）保持唤醒并发送网管报文";
CM_ SG_ 1025 CGW_KeepAwakeReason_Diagnostic "the reason of node Keep awake and send Network Message is Node in diagnostic session
节点因处在诊断会话而保持唤醒并发送网管报文";
CM_ SG_ 1025 CGW_KeepAwakeReason_Network "the reason of node Keep awake and send Network Message is the requirement from network which node direct-connect
节点因直连的网络需求保持唤醒并发送网管报文";
CM_ SG_ 1110 FSE_M_NodeAddress "Node source address
节点源地址";
CM_ SG_ 1110 FSE_M_RepeatMsgReq "Repeat Message Request Bit
重复报文请求位";
CM_ SG_ 1110 FSE_M_ActiveWakeup "Active Wakeup Bit
主动唤醒指示位";
CM_ SG_ 1110 FSE_M_RepeatMsgSt "Repeat Message State indication
节点处在重复报文状态指示位";
CM_ SG_ 1110 FSE_M_WakeupCGW_TBOX_CANFD "Wakeup  TBOX_CANFD network requirement flag
唤醒TBOX_CANFD网段需求标志";
CM_ SG_ 1110 FSE_M_WakeupCGW_IOV_Backbone "Wakeup IOV_Backbone network requirement flag
唤醒IOV_Backbone网段需求标志";
CM_ SG_ 1110 FSE_M_WakeupCGW_ADAS_Backbone "Wakeup ADAS_Backbone  network requirement flag
唤醒ADAS_Backbone网段需求标志";
CM_ SG_ 1110 FSE_M_WakeupCGW_Chassis_Backbone "Wakeup  Chassis_Backbone network requirement flag
唤醒Chassis_Backbone网段需求标志";
CM_ SG_ 1110 FSE_M_WakeupCGW_PT_Backbone "Wakeup PT_Backbone network requirement flag
唤醒PT_Backbone网段需求标志";
CM_ SG_ 1110 FSE_M_WakeupCGW_BD_Backbone "Wakeup BD_Backbone  network requirement flag
唤醒BD_Backbone网段需求标志";
CM_ SG_ 1110 FSE_M_WakeupCGW_Diagnostic_CANFD "Wakeup Diagnostic_CANFD  network requirement flag
唤醒Diagnostic_CANFD网段需求标志";
CM_ SG_ 1110 FSE_M_WakeupCGW_CGW_LIN1 "Wakeup CGW_LIN1 network requirement flag
唤醒CGW_LIN1网段需求标志";
CM_ SG_ 1110 FSE_M_WakeupBDCM_Body_CAN1 "Wakeup Body_CAN1  network requirement flag
唤醒Body_CAN1网段需求标志";
CM_ SG_ 1110 FSE_M_WakeupBDCM_Body_CAN2 "Wakeup Body_CAN2 network requirement flag
唤醒Body_CAN2网段需求标志";
CM_ SG_ 1110 FSE_M_WakeupBDCM_Body_LIN1 "Wakeup  Body_LIN1 network requirement flag
唤醒Body_LIN1网段需求标志";
CM_ SG_ 1110 FSE_M_WakeupBDCM_Body_LIN2 "Wakeup Body_LIN2 network requirement flag
唤醒Body_LIN2网段需求标志";
CM_ SG_ 1110 FSE_M_WakeupBDCM_Body_LIN3 "Wakeup Body_LIN3 network requirement flag
唤醒Body_LIN3网段需求标志";
CM_ SG_ 1110 FSE_M_WakeupBDCM_SCM_LIN "Wakeup SCM_LIN  network requirement flag
唤醒SCM_LIN网段需求标志";
CM_ SG_ 1110 FSE_M_WakeupFSE_M_IOV_CAN "Wakeup IOV_CAN network requirement flag
唤醒IOV_CAN网段需求标志";
CM_ SG_ 1110 FSE_M_WakeupVDCM_PT_CANFD1 "Wakeup PT_CANFD1  network requirement flag
唤醒PT_CANFD1网段需求标志";
CM_ SG_ 1110 FSE_M_WakeupVDCM_PT_CANFD2 "Wakeup PT_CANFD2  network requirement flag
唤醒PT_CANFD2网段需求标志";
CM_ SG_ 1110 FSE_M_WakeupVDCM_PT_CAN1 "Wakeup PT_CAN1  network requirement flag
唤醒PT_CAN1网段需求标志";
CM_ SG_ 1110 FSE_M_WakeupVDCM_PT_LIN2 "Wakeup PT_LIN2 network requirement flag
唤醒PT_LIN2网段需求标志";
CM_ SG_ 1110 FSE_M_WakeupVDCM_Chassis_Backup "Wakeup Chassis_Backup network requirement flag
唤醒Chassis_Backup网段需求标志";
CM_ SG_ 1110 FSE_M_KeepAwakeReason_KL15 "the reason of node Keep awake and send Network Message is KL15
节点因KL15保持唤醒并发送网管报文";
CM_ SG_ 1110 FSE_M_KeepAwakeReason_Local "the reason of node Keep awake and send Network Message is Local condition except KL15
节点因本地条件（除KL15）保持唤醒并发送网管报文";
CM_ SG_ 1110 FSE_M_KeepAwakeReason_Diagnostic "the reason of node Keep awake and send Network Message is Node in diagnostic session
节点因处在诊断会话而保持唤醒并发送网管报文";
CM_ SG_ 1110 FSE_M_KeepAwakeReason_Network "the reason of node Keep awake and send Network Message is the requirement from network which node direct-connect
节点因直连的网络需求保持唤醒并发送网管报文";
CM_ SG_ 554 BDCM_Checksum_1 "E2E Signal Group Checksum
Checksum is the actual value after calculation. See the 'ChecksumAlgorithm' sheet for the specific algorithm.
E2E信号组校验和
Checksum为计算后实际值，具体算法参见“ChecksumAlgorithm”页";
CM_ SG_ 554 BDCM_RollingCounter_1 "E2E Signal Group Counter
Counter value is automatically accumulated, added from 0 to 14 and then looped to the initial value of 0. Every time a message is sent, counter adds 1.
E2E信号组计数器
Counter值为自动累加，从0加到14，然后循环至初始值0，每次报文发送，Counter加1";
CM_ SG_ 554 BDCM_LockUnlock "Lock/Unlock outside( Lock/Unlock with Key /Bluetooth/ wristband/ TBOX/ B column/ Leave away/ Approach )
外部解闭锁信号（钥匙，蓝牙，手环,TBOX，B柱、远离、靠近统一的解闭锁信号）";
CM_ SG_ 554 BDCM_LogicLock_St "VehicleLogicLockState
整车逻辑锁状态";
CM_ SG_ 554 BDCM_HoodLock_St "HoodLockState
前备箱锁状态信号";
CM_ SG_ 554 BDCM_FLDoorLock_St "Front Left Door Lock State
BDCM判断过后的左前门锁状态";
CM_ SG_ 554 BDCM_FRDoorLock_St "Front Right Door Lock State
BDCM判断过后的右前门锁状态";
CM_ SG_ 554 BDCM_RLDoorLock_St "Rear Left Door Lock State
BDCM判断过后的左后门锁状态";
CM_ SG_ 554 BDCM_PowerMode "PowerMode
电源状态";
CM_ SG_ 554 BDCM_RRDoorLock_St "Rear Right Door Lock State
BDCM判断过后的右后门锁状态";
CM_ SG_ 554 BDCM_RLNTDoorLock_St "Rear Left NT Door Lock State
BDCM判断过后的左NT门锁状态";
CM_ SG_ 554 BDCM_RRNTDoorLock_St "Rear Right NT Door Lock State
BDCM判断过后的右NT门锁状态";
CM_ SG_ 554 BDCM_HazardWarnLamp_St "Hazard Warnning Lamp
危险警报灯点亮状态信号";
CM_ SG_ 554 BDCM_WarnLampSwitch_St "Warn Lamp Switch State
危险警报灯开关状态（是否被按下）";
CM_ SG_ 554 BDCM_WarnLampSwitch_Valid "Warn Lamp Switch State Validity
危险报警灯开关有效";
CM_ SG_ 554 BDCM_LeftTurnLamp_Cmd "Left Turn Lamp Command
左转向灯控制命令";
CM_ SG_ 554 BDCM_RightTurnLamp_Cmd "Right Turn Lamp Command
右转向灯控制命令";
CM_ SG_ 554 BDCM_FLSeatOccupied_St "Front Left Seat Occupied State
主驾座椅占位";
CM_ SG_ 554 BDCM_FRDoor_St "BDCM Sent Front Right Door State
BDCM判断过后的右前门状态";
CM_ SG_ 554 BDCM_RRDoor_St "BDCM Sent Rear Right Door State
BDCM判断过后的右后门状态";
CM_ SG_ 554 BDCM_FLDoor_St "BDCM Sent Front Left Door State
BDCM判断过后的左前门状态";
CM_ SG_ 554 BDCM_RLDoor_St "BDCM Sent Rear Left Door State
BDCM判断过后的左后门状态";
CM_ SG_ 554 BDCM_RLNTDoor_St "BDCM Sent Left NT Door State
BDCM判断过后的左NT门状态";
CM_ SG_ 554 BDCM_RRNTDoor_St "BDCM Sent Right NT Door State
BDCM判断过后的右NT门状态";
CM_ SG_ 554 BDCM_BurglarAlarmWarn "Burglar Alarm Warn
BDCM防盗报警信号";
CM_ SG_ 554 BDCM_SteeringWheelHeating_St "SteeringWheelHeatingState
方向盘加热状态";
CM_ SG_ 554 BDCM_BackMirrorHeat_St "RearviewMirrorHeatingState
后视镜加热状态反馈信号";
CM_ SG_ 554 BDCM_RearDefrost_St "RearDefogState
后窗除霜状态反馈信号";
CM_ SG_ 554 BDCM_BackLight_St "BacklightStatus
背光灯状态";
CM_ SG_ 554 BDCM_TopLightLF_St "LeftFrontTopLightStatus
左前顶灯状态";
CM_ SG_ 554 BDCM_TopLightRF_St "RightFrontTopLightStatus
右前顶灯状态";
CM_ SG_ 554 BDCM_TopLightLM_St "LeftMiddleTopLightStatus
左中顶灯状态";
CM_ SG_ 554 BDCM_TopLightRM_St "RightMiddleTopLightStatus
右中顶灯状态";
CM_ SG_ 554 BDCM_TopLightLR_St "LeftRearTopLightStatus
左后顶灯状态";
CM_ SG_ 554 BDCM_TopLightRR_St "RightRearTopLightStatus
右后顶灯状态";
CM_ SG_ 554 BDCM_BackLightIntensityAdjust_Rsp "BacklightIntensityAdjustResponse
背光灯亮度调节反馈信号";
CM_ SG_ 554 BDCM_ChargeCapErr_St "Charge Cap Error State
充电口故障状态";
CM_ SG_ 554 BDCM_ChargeCap_St "ChargeCapStatus
充电口状态";
CM_ SG_ 554 BDCM_FLBColumnSwitch "B Column Front Left Switch
B柱左前按钮开关";
CM_ SG_ 554 BDCM_RLBColumnSwitch "B Column Rear Left Switch
B柱左后按钮开关";
CM_ SG_ 554 BDCM_FRBColumnSwitch "B Column Front Right Switch
B柱右前按钮开关";
CM_ SG_ 554 BDCM_RRBColumnSwitch "B Column Rear Right Switch
B柱右后按钮开关";
CM_ SG_ 554 BDCM_FLDoorWorkSound_Req "Front Left Door Work Sound Request
左前门动作提示音请求";
CM_ SG_ 554 BDCM_FRDoorWorkSound_Req "Front Right Door Work Sound Request
右前门动作提示音请求";
CM_ SG_ 554 BDCM_RLDoorWorkSound_Req "Rear Left Door Work Sound Request
左后门动作提示音请求";
CM_ SG_ 554 BDCM_RRDoorWorkSound_Req "Rear Right Door Work Sound Request
右后门动作提示音请求";
CM_ SG_ 554 BDCM_RLNTDoorWorkSound_Req "Rear Left NT Door Work Sound Request
左NT门动作提示音请求";
CM_ SG_ 554 BDCM_RRNTDoorWorkSound_Req "Rear Right NT Door Work Sound Request
右NT门动作提示音请求";
CM_ SG_ 554 BDCM_FLDoorUssSelfCheck_Rsp "Front Left Door USS Selfcheck Response
左前门超声波传感器自检";
CM_ SG_ 554 BDCM_FRDoorUssSelfCheck_Rsp "Front Right Door USS Selfcheck Response
右前门超声波传感器自检";
CM_ SG_ 554 BDCM_RLDoorUssSelfCheck_Rsp "Rear Left Door USS Selfcheck Response
左后门超声波传感器自检";
CM_ SG_ 554 BDCM_RRDoorUssSelfCheck_Rsp "Rear Right Door USS Selfcheck Response
右后门超声波传感器自检";
CM_ SG_ 554 BDCM_RLNTDoorUssSelfCheck_Rsp "Rear Left NT Door USS Selfcheck Response
左NT门超声波传感器自检";
CM_ SG_ 554 BDCM_RRNTDoorUssSelfCheck_Rsp "Rear Right NT Door USS Selfcheck Response
右NT门超声波传感器自检";
CM_ SG_ 554 BDCM_FLObstacleAvoidSt_Rsp "Front Left Obstacle Avoid State Response
左前方接近物避障状态";
CM_ SG_ 554 BDCM_FRObstacleAvoidSt_Rsp "Front Right Obstacle Avoid State Response
右前方接近物避障状态";
CM_ SG_ 554 BDCM_RLObstacleAvoidSt_Rsp "Rear Left Obstacle Avoid State Response
左后方接近物避障状态";
CM_ SG_ 554 BDCM_RRObstacleAvoidSt_Rsp "Rear Right Obstacle Avoid State Response
右后方接近物避障状态";
CM_ SG_ 554 BDCM_FaceIDRecognition_Req "Face ID Recogning Request
面部识别请求信号（唤醒VSP）";
CM_ SG_ 554 BDCM_WpcCtl_Req "WPC Control Request
WPC请求信号";
CM_ SG_ 554 BDCM_FrontWiperService_St "Front Wiper Service State
前雨刮维修状态";
CM_ SG_ 554 BDCM_WiperMotorErr "ThesignalindicatesifWWMisinerrorstatusornot.
雨刮电机故障";
CM_ SG_ 554 BDCM_WashLiquidHght "Wash Liquid Height
洗涤液液位高度";
CM_ SG_ 554 BDCM_RLS_LightSwitchRequest "Light Switch Request From RLS
近光灯/位置灯 请求";
CM_ SG_ 554 BDCM_RainAutoCloseWndwFinish "Rain Auto Close Window Finish
下雨关窗完成提醒信号";
CM_ SG_ 554 BDCM_UndetectkeyReminder "Undetec Key Reminder
未检测到钥匙提示";
CM_ SG_ 554 BDCM_KeyLocation_St "KeyLocation
钥匙位置状态信号";
CM_ SG_ 554 BDCM_KeyBatterySOC_St "KeyBattery
钥匙电量状态提醒";
CM_ SG_ 554 BDCM_KeyInCarWarn_Req "Key In Car Warn Request
钥匙在车内报警信号";
CM_ SG_ 554 BDCM_KeyNotInCarWarn_Req "Key Not In Car Warn Request
钥匙不在车内报警信号";
CM_ SG_ 554 BDCM_SysError_Rsp "Body System Error Response
Body域存在故障";
CM_ SG_ 554 BDCM_IGRelayErr "IG Relay Error
IG继电器故障";
CM_ SG_ 554 BDCM_DriverSWSAdjust_St "Driver SWS adjust state
驾驶员操作方向盘触摸板状态反馈";
CM_ SG_ 554 BDCM_WashLiquidHeightWarn_St "Wash Liquid Height Warn
洗涤液报警信号";
CM_ SG_ 554 BDCM_VMVehicleModeInfo "Vehicle Mode Information
整车模式";
CM_ SG_ 554 BDCM_RKE_Detect "RKE key detect
物理钥匙检测信号";
CM_ SG_ 554 BDCM_DriverPositionMemoryWindow_Req "Driver Position Adjust Memory Pop-up Window Request
主驾驶调节记忆弹窗信号";
CM_ SG_ 554 BDCM_PassengerPositionMemoryWindow_Req "Passenger Position Adjust Memory Pop-up Window Request
副驾驶调节记忆弹窗信号";
CM_ SG_ 554 BDCM_ReverseBackMirTurndown_St "Back Mirror Reverse Turn Down State
后视镜倒车下翻状态";
CM_ SG_ 554 BDCM_FogLampSt_Rsp "Fog Lamp State Response
后雾灯点亮状态反馈";
CM_ SG_ 554 BDCM_SCAMCalibration_St "SCAM Calibration state
SCAM标定状态";
CM_ SG_ 713 BDCM_RainAutoCloseWndwSet_Rsp "Rain Auto Close Windww Set Response
下雨自动关闭门窗设置反馈信号";
CM_ SG_ 713 BDCM_DriverSideApproachOpenDoorSet_Rsp "Driver Side Approach Open Door Set Response
主驾靠近开门设置反馈";
CM_ SG_ 713 BDCM_PassengerSideApproachOpenDoorSet_Rsp "Passenger Side Approach Open Door Set Response
副驾靠近开门设置反馈";
CM_ SG_ 713 BDCM_TopLightSwitch_Rsp "Top Light Switch Response
顶灯开关设置反馈";
CM_ SG_ 713 BDCM_FrontWiperMode_Rsp "Front Wiper Mode Response
雨刮运行模式设置命令反馈";
CM_ SG_ 713 BDCM_SafetyLockSet_Rsp "Safety Lock Set Response
儿童锁设置反馈信号";
CM_ SG_ 713 BDCM_ApproachUnlockConfig_Rsp "Approach Unlock Config Response
靠近解锁配置反馈";
CM_ SG_ 713 BDCM_CampingMode_Rsp "Camping Mode Response
露营模式反馈";
CM_ SG_ 713 BDCM_UnlockModeSet_Rsp "UnlockModeSetResponse
解锁模式配置反馈信号";
CM_ SG_ 713 BDCM_RemoteLowPressureWarnSet_Rsp "RemoteLowPressureWarnSetResponse
远程低压报警功能设置反馈";
CM_ SG_ 713 BDCM_HornModeSet_Rsp_OnlyForIV2 "HornModeSetResponse
喇叭模式设置反馈信号";
CM_ SG_ 713 BDCM_BackMirrorAutoFoldSet_Rsp_OnlyForIV2 "RearviewMirrorAutomaticallyFoldSetResponse
车外后视镜自动折叠设置反馈信号";
CM_ SG_ 713 BDCM_BackMirrorAutoTurnOverSet_Rsp_OnlyForIV2 "RearviewMirrorAutomaticallyTurnOverSetResponse
后视镜自动下翻设置反馈信号";
CM_ SG_ 713 BDCM_BackMirrorAutoUnfoldSet_Rsp_OnlyForIV2 "RearviewMirrorAutomaticallyunfoldingSetResponse
后视镜自动展开设置反馈信号";
CM_ SG_ 713 BDCM_ApproachUnlockSet_Rsp_OnlyForIV2 "ApproachUnlockSetResponse
靠近解锁设置反馈信号";
CM_ SG_ 713 BDCM_WalkAwayLockSet_Rsp "WalkAwayLockSetResponse
远离闭锁关门设置反馈信号";
CM_ SG_ 713 BDCM_ValetModeHoodForbid_Rsp "Valet Mode Hood Forbid Response
代客模式前舱盖禁用反馈";
CM_ SG_ 713 BDCM_TailFootOpenSet_Rsp "Tail Foot Open Set Response
尾门脚踏开启设置反馈信号";
CM_ SG_ 713 BDCM_TailOpenModeSet_Rsp "TailgateOpenModeSetResponse
尾门开启模式反馈信号";
CM_ SG_ 713 BDCM_TailNormallyOpenAngleSet_Rsp "TailgateNormallyOpenAngleSetResponse
尾门正常开启角度设置反馈信号";
CM_ SG_ 713 BDCM_TailGarageOpenAngleSet_Rsp "TailgateGarageModeOpenAngleSetResponse
尾门车库模式开启角度设置反馈信号";
CM_ SG_ 713 BDCM_LightSet_Rsp "Light Set Response
灯光设置信号反馈";
CM_ SG_ 713 BDCM_NTModeSet_Rsp "NT Door Mode Set Response
NT门模式设置反馈信号";
CM_ SG_ 713 BDCM_LNTTourismMode_Rsp "Left NT Door Tourism Mode Response
左NT门观光模式反馈信号";
CM_ SG_ 713 BDCM_RNTTourismMode_Rsp "Left NT Door Tourism Mode Response
右NT门观光模式反馈信号";
CM_ SG_ 713 BDCM_NTVariableRateSet_Rsp "NT Door Variable Rate Set Response
NT门可变速率设置反馈信号";
CM_ SG_ 713 BDCM_NTOpenAngelSet_Rsp "NT Door Open Angel Set Response
NT门门开角度设置反馈信号";
CM_ SG_ 713 BDCM_PassengerSeatSoftPointposition_Rsp "Passenger Seat Soft Point position Response
副驾软止点位置反馈信号";
CM_ SG_ 713 BDCM_NTTourismModeOpenAngelSet_Rsp "NT Door Tourism Mode Open Angel Set Response
NT门观光模式开启角度设置反馈信号";
CM_ SG_ 713 BDCM_FDoorVariableRateSet_Rsp "Front Door Variable Rate Set Response
电吸门可变速率设置反馈信号";
CM_ SG_ 713 BDCM_RDoorVariableRateSet_Rsp "Rear Door Variable Rate Set Response
后门可变速率设置反馈信号";
CM_ SG_ 713 BDCM_FDoorOpenAngelSet_Rsp "Front Power Door Open Angle Set Response
前门开启角度设置反馈信号";
CM_ SG_ 713 BDCM_RDoorOpenAngelSet_Rsp "Rear Power Door Open Angle Set Response
后门开角度设置反馈信号";
CM_ SG_ 713 BDCN_RLWindowSwitchForbid_Rsp "Rear Left Window Switch Forbid Response
后排左车窗开关禁止命令反馈";
CM_ SG_ 713 BDCN_RRWindowSwitchForbid_Rsp "Rear Right Window Switch Forbid Response
后排右车窗开关禁止命令反馈";
CM_ SG_ 713 BDCM_AutoLightSet_Rsp_OnlyForIV2 "AutoLightSetResponse
自动灯光设置反馈信号";
CM_ SG_ 713 BDCM_AutoHighBeamLamp_Rsp "AutoHighBeamControlResponse
自动远光灯开启关闭设置反馈信号";
CM_ SG_ 713 BDCM_LightDelayCloseTimeSet_Rsp "LightDelayClosingTimeSetResponse
灯光延时关闭时间设置反馈信号";
CM_ SG_ 713 BDCM_WelcomeMode_Rsp "WelcomeModeResponse
迎宾模式设置反馈信号";
CM_ SG_ 713 BDCM_TopLightMode_Rsp "TopLightModeResponse
顶灯模式设置反馈信号";
CM_ SG_ 713 BDCM_SmartLightEN_Rsp "SmartLightModuleEnableResponse
智能灯光开启反馈信号";
CM_ SG_ 713 BDCM_DriverPositionMemorySave_St_OnlyForIV2 "DriverPositionMemorySavingStatus
主驾记忆保存状态信号";
CM_ SG_ 713 BDCM_DriverPositionMemoryExport_St_OnlyForIV2 "DriverPositionMemoryExportStatus
主驾记忆调出状态信号";
CM_ SG_ 713 BDCM_PassengerPositionMemoryMemSave_St_OnlyForIV2 "PassengerPositionMemorySavingStatus
副驾记忆保存状态信号";
CM_ SG_ 713 BDCM_PassengerPositionMemoryMemExport_OnlyForIV2 "PassengerPositionMemoryExportStatus
副驾记忆调出状态信号";
CM_ SG_ 713 BDCM_RearFogLightCmd_Rsp "Rear Fog Light Control Command Response
后雾灯控制命令信号反馈";
CM_ SG_ 713 BDCM_SCMSRLZeroGravitySt_Rsp "Second Row Left Seat Zero Gravity State Response
二排左零重力状态";
CM_ SG_ 713 BDCM_SCMSRRZeroGravitySt_Rsp "Second Row Right Seat Zero Gravity State Response
二排右零重力状态";
CM_ SG_ 713 BDCM_SCMSRLEasyEntrySt_Rsp "Second Row Left Seat Easy Entry State Response
二排左easyentry状态反馈";
CM_ SG_ 713 BDCM_SCMSRREasyEntrySt_Rsp "Second Row Right Seat Easy Entry State Response
二排右easyentry状态反馈";
CM_ SG_ 713 BDCM_FLMemorySelectErrReason "Front Left Position Memory Export Error Reason
主驾记忆调出停止原因";
CM_ SG_ 713 BDCM_FRMemorySelectErrReason "Front Right Position Memory Export Error Reason
副驾记忆调出停止原因";
CM_ SG_ 713 BDCM_SRLEasyEntryStopReason "Left Easy Entry Stop Reason
左Easy-Entry停止原因";
CM_ SG_ 713 BDCM_SRREasyEntryStopReason "Right Easy Entry Stop Reason
右Easy-Entry停止原因";
CM_ SG_ 713 BDCM_SRLZeroGravityStopReason "Second Row Left Zero Gravity Stop Reason
左零重力停止原因";
CM_ SG_ 713 BDCM_SRRZeroGravityStopReason "Second Row Right Zero Gravity Stop Reason
右零重力停止原因";
CM_ SG_ 713 BDCM_PassengerSeatSoftPointSet_Rsp "Passenger Seat Soft Point Set Response
副驾座椅软止点设置反馈信号";
CM_ SG_ 713 BDCM_SCMSRLZeroGravityMotionSt_Rsp "二排左零重力运动状态";
CM_ SG_ 713 BDCM_SCMSRRZeroGravityMotionSt_Rsp "二排右零重力运动状态";
CM_ SG_ 698 BDCM_FD_3_Checksum_1 "E2E Signal Group Checksum
Checksum is the actual value after calculation. See the 'ChecksumAlgorithm' sheet for the specific algorithm.
E2E信号组校验和
Checksum为计算后实际值，具体算法参见“ChecksumAlgorithm”页";
CM_ SG_ 698 BDCM_FD_3_RollingCounter_1 "E2E Signal Group Counter
Counter value is automatically accumulated, added from 0 to 14 and then looped to the initial value of 0. Every time a message is sent, counter adds 1.
E2E信号组计数器
Counter值为自动累加，从0加到14，然后循环至初始值0，每次报文发送，Counter加1";
CM_ SG_ 698 BDCM_FLTpmsWheellPressure "Front Left TPMS Wheell Pressure
左前轮胎压";
CM_ SG_ 698 BDCM_FRTpmsWheellPressure "Front Right TPMS Wheell Pressure
右前轮胎压";
CM_ SG_ 698 BDCM_RLTpmsWheellPressure "Rear Left TPMS Wheell Pressure
左后轮胎压";
CM_ SG_ 698 BDCM_RRTpmsWheellPressure "Rear Right TPMS Wheell Pressure
右后轮胎压";
CM_ SG_ 698 BDCM_FLTpmsWheellPressureWarn_St "Front Left TPMS Wheell Pressure Warn State
左前轮胎压报警状态";
CM_ SG_ 698 BDCM_FRTpmsWheellPressureWarn_St "Front Right TPMS Wheell Pressure Warn State
右前轮胎压报警状态";
CM_ SG_ 698 BDCM_RLTpmsWheellPressureWarn_St "Rear Left TPMS Wheell Pressure Warn State
左后轮胎压报警状态";
CM_ SG_ 698 BDCM_RRTpmsWheellPressureWarn_St "Rear Right TPMS Wheell Pressure Warn State
右后轮胎压报警状态";
CM_ SG_ 698 BDCM_FD_3_Checksum_2 "E2E Signal Group Checksum
Checksum is the actual value after calculation. See the 'ChecksumAlgorithm' sheet for the specific algorithm.
E2E信号组校验和
Checksum为计算后实际值，具体算法参见“ChecksumAlgorithm”页";
CM_ SG_ 698 BDCM_FD_3_RollingCounter_2 "E2E Signal Group Counter
Counter value is automatically accumulated, added from 0 to 14 and then looped to the initial value of 0. Every time a message is sent, counter adds 1.
E2E信号组计数器
Counter值为自动累加，从0加到14，然后循环至初始值0，每次报文发送，Counter加1";
CM_ SG_ 698 BDCM_FLTpmsWheelTemp "Front Left TPMS Wheel Temperature
左前轮胎温";
CM_ SG_ 698 BDCM_FRTpmsWheelTemp "Front Right TPMS Wheel Temperature
右前轮胎温";
CM_ SG_ 698 BDCM_RLTpmsWheelTemp "Rear Left TPMS Wheel Temperature
左后轮胎温";
CM_ SG_ 698 BDCM_RRTpmsWheelTemp "Rear Right TPMS Wheel Temperature
右后轮胎温";
CM_ SG_ 698 BDCM_FLTpmsWheelTempWarn_St "Front Left TPMS Wheel Temperature Warn State
左前轮胎温报警状态";
CM_ SG_ 698 BDCM_FRTpmsWheelTempWarn_St "Front Right TPMS Wheel Temperature Warn State
右前轮胎温报警状态";
CM_ SG_ 698 BDCM_RLTpmsWheelTempWarn_St "Rear Left TPMS Wheel Temperature Warn State
左后轮胎温报警状态";
CM_ SG_ 698 BDCM_RRTpmsWheelTempWarn_St "Rear Right TPMS Wheel Temperature Warn State
右后轮胎温报警状态";
CM_ SG_ 698 BDCM_FLTpmsBattle_St "Front Left TPMS Battle State
左前轮胎压传感器电池状态";
CM_ SG_ 698 BDCM_FRTpmsBattle_St "Front Right TPMS Battle State
右前轮胎压传感器电池状态";
CM_ SG_ 698 BDCM_RLTpmsBattle_St "Rear Left TPMS Battle State
左后轮胎压传感器电池状态";
CM_ SG_ 698 BDCM_RRTpmsBattle_St "Rear Right TPMS Battle State
右后轮胎压传感器电池状态";
CM_ SG_ 698 BDCM_FLTpmsSensorFailure_St "Front Left TPMS Sensor Failure State
左前轮胎压传感器信号状态";
CM_ SG_ 698 BDCM_FRTpmsSensorFailure_St "Front Right TPMS Sensor Failure State
右前轮胎压传感器信号状态";
CM_ SG_ 698 BDCM_RLTpmsSensorFailure_St "Rear Left TPMS Sensor Failure State
左后轮胎压传感器信号状态";
CM_ SG_ 698 BDCM_RRTpmsSensorFailure_St "Rear Right TPMS Sensor Failure State
右后轮胎压传感器信号状态";
CM_ SG_ 698 BDCM_FLTpmsIDRegisterFailureWarn "Front Left Tire ID Register Failure Warn
左前轮胎ID注册失败报警";
CM_ SG_ 698 BDCM_FRTpmsIDRegisterFailureWarn "Front Right Tire ID Register Failure Warn
右前轮胎ID注册失败报警";
CM_ SG_ 698 BDCM_RLTpmsIDRegisterFailureWarn "Rear Left Tire ID Register Failure Warn
左后轮胎ID注册失败报警";
CM_ SG_ 698 BDCM_RRTpmsIDRegisterFailureWarn "Rear Right Tire ID Register Failure Warn
右后轮胎ID注册失败报警";
CM_ SG_ 698 BDCM_TpmsRFAntennaErr_Rsp "Tpms RF Antenna Error Response
RF天线故障信号";
CM_ SG_ 698 BDCM_FLTpmsRapidLeakWarn "Front Left Tpms Rapid Leak Warn
左前快速漏气报警信号";
CM_ SG_ 698 BDCM_FRTpmsRapidLeakWarn "Front Right Tpms Rapid Leak Warn
右前快速漏气报警信号";
CM_ SG_ 698 BDCM_RLTpmsRapidLeakWarn "Rear Left Tpms Rapid Leak Warn
左后快速漏气报警信号";
CM_ SG_ 698 BDCM_RRTpmsRapidLeakWarn "Rear Right Tpms Rapid Leak Warn
右后快速漏气报警信号";
CM_ SG_ 564 BDCM_DriverSetVehicleTimeGap "Driver Set Vehicle Time Gap
驾驶员设定车间时距";
CM_ SG_ 564 BDCM_SWS_L_HHPilot "Steering Wheel Left Switch, Pilot Funtion
方向盘左区按键实现HH-Pilot功能";
CM_ SG_ 564 BDCM_DriverSetVehicleSpeed "Driver Set Vehicle Speed
驾驶员设定车速";
CM_ SG_ 564 BDCM_SWS_L_Upslip_Cmd "Steering Wheel Left Switch, Up Slip Command
方向盘左区滑条向上滑动，";
CM_ SG_ 564 BDCM_SWS_L_UpslipFast_Cmd "Steering Wheel Left Switch, Up Slip Fast Command
方向盘左区滑条向上快速滑动";
CM_ SG_ 564 BDCM_SWS_L_Dwnslip_Cmd "Steering Wheel Left Switch, Down Slip Command
方向盘左区滑条向下滑动，";
CM_ SG_ 564 BDCM_SWS_L_DownslipFast_Cmd "Steering Wheel Left Switch, Down Slip Fast Command
方向盘左区滑条向下快速滑动";
CM_ SG_ 564 BDCM_SWS_L_Leftslip_Cmd "Steering Wheel Left Switch, Left Slip Command
方向盘左区滑条向左滑动，";
CM_ SG_ 564 BDCM_SWS_L_LeftslipFast_Cmd "Steering Wheel Left Switch, Left Fast Slip Command
方向盘左区滑条向左快速滑动";
CM_ SG_ 564 BDCM_SWS_L_RightSlip_Cmd "Steering Wheel Left Switch, Right Slip Command
方向盘左区滑条向右滑动，";
CM_ SG_ 564 BDCM_SWS_L_RightslipFast_Cmd "Steering Wheel Left Switch, Right Slip Fast Command
方向盘左区滑条向右快速滑动";
CM_ SG_ 564 BDCM_SWS_L_Doubleclick_Cmd "Steering Wheel Left Switch,  Double click Command
方向盘左区双击指令";
CM_ SG_ 564 BDCM_SWS_L_zoomin_Cmd "Steering Wheel Left Switch, zoom in Command
方向盘左区放大指令";
CM_ SG_ 564 BDCM_SWS_L_zoomout_Cmd "Steering Wheel Left Switch, zoom out Command
方向盘左区缩小指令";
CM_ SG_ 564 BDCM_SWS_L_Button_St "Steering Wheel Left Switch Button State
方向盘左滑动区按键状态";
CM_ SG_ 564 BDCM_SWS_L_HHPilot_OnlyForIV2 "Steering Wheel Left Switch, Pilot Funtion
方向盘左区按键实现HH-Pilot功能";
CM_ SG_ 564 BDCM_SWS_L_PickSwitch "Steering Wheel Left Switch, Pick Switch
方向盘左区上拨片功能";
CM_ SG_ 564 SWS_L_TwofingerUpSlip_Cmd "Steering Wheel Left Switch, Two finger Up Slip Command
方向盘左区双指向上滑动信号";
CM_ SG_ 564 SWS_L_TwofingerDownSlip_Cmd "Steering Wheel Left Switch, Two finger Down Slip Command
方向盘左区双指向下滑动信号";
CM_ SG_ 564 SWS_L_TwofingerLeftSlip_Cmd "Steering Wheel Left Switch, Two finger Left Slip Command
方向盘左区双指向左滑动信号";
CM_ SG_ 564 SWS_L_TwofingerRightSlip_Cmd "Steering Wheel Left Switch, Two finger Right Slip Command
方向盘左区双指向右滑动信号";
CM_ SG_ 564 BDCM_SWS_L_ProtocolVersion "SWS_L Protocol Version
SWS_L 协议版本";
CM_ SG_ 564 BDCM_SWS_R_Upslip_Cmd "Steering Wheel Right Switch, Up Slip Command
方向盘右区滑条向上滑动，";
CM_ SG_ 564 BDCM_SWS_R_UpslipFast_Cmd "Steering Wheel Right Switch, Up Slip Fast Command
方向盘右区滑条向上快速滑动";
CM_ SG_ 564 BDCM_SWS_R_Dwnslip_Cmd "Steering Wheel Right Switch, Down Slip Command
方向盘右区滑条向下滑动，";
CM_ SG_ 564 BDCM_SWS_R_DownslipFast_Cmd "Steering Wheel Right Switch, Down Slip Fast Command
方向盘右区滑条向下快速滑动";
CM_ SG_ 564 BDCM_SWS_R_Leftslip_Cmd "Steering Wheel Right Switch, Left Slip Command
方向盘右区滑条向左滑动，";
CM_ SG_ 564 BDCM_SWS_R_LeftslipFast_Cmd "Steering Wheel Right Switch, Left Fast Slip Command
方向盘右区滑条向左快速滑动";
CM_ SG_ 564 BDCM_SWS_R_RightSlip_Cmd "Steering Wheel Right Switch, Right Slip Command
方向盘右区滑条向右滑动，";
CM_ SG_ 564 BDCM_SWS_R_RightslipFast_Cmd "Steering Wheel Right Switch, Right Slip Fast Command
方向盘右区滑条向右快速滑动";
CM_ SG_ 564 BDCM_SWS_R_Doubleclick_Cmd "Steering Wheel Right Switch,  Double click Command
方向盘右区双击指令";
CM_ SG_ 564 BDCM_SWS_R_zoomin_Cmd "Steering Wheel Right Switch, zoom in Command
方向盘右区放大指令";
CM_ SG_ 564 BDCM_SWS_R_zoomout_Cmd "Steering Wheel Right Switch, zoom out Command
方向盘右区缩小指令";
CM_ SG_ 564 BDCM_SWS_R_Button_St "Steering Wheel Right Switch Button State
方向盘右滑动区按键状态";
CM_ SG_ 564 BDCM_SWS_R_Voice "Steering Wheel Right Switch, Voice Funtion
方向盘右区按键实现语音切换功能";
CM_ SG_ 564 BDCM_SWS_R_PickSwitch "Steering Wheel Right Switch, Pick Switch
方向盘右区上拨片功能";
CM_ SG_ 564 SWS_R_TwofingerUpSlip_Cmd "Steering Wheel Right Switch, Two finger Up Slip Command
方向盘右区双指向上滑动信号";
CM_ SG_ 564 SWS_R_TwofingerDownSlip_Cmd "Steering Wheel Right Switch, Two finger Down Slip Command
方向盘右区双指向下滑动信号";
CM_ SG_ 564 SWS_R_TwofingerLeftSlip_Cmd "Steering Wheel Right Switch, Two finger Left Slip Command
方向盘右区双指向左滑动信号";
CM_ SG_ 564 SWS_R_TwofingerRightSlip_Cmd "Steering Wheel Right Switch, Two finger Right Slip Command
方向盘右区双指向右滑动信号";
CM_ SG_ 564 BDCM_SWHM_DrvSteeringWheelHeatTemp_Rsp "Drive Steering Wheel Heating Temperature response
方向盘加热温度命令反馈信号";
CM_ SG_ 564 BDCM_SWHM_DrvSteeringWheelHeatLevel_Rsp "Drive Steering Wheel Heating Level Comand Response
方向盘加热档位命令反馈信号";
CM_ SG_ 564 BDCM_SCAM_Err1 "异常状态响应1";
CM_ SG_ 564 BDCM_SCAM_Err2 "异常状态响应2";
CM_ SG_ 743 DCM_FL_WindowPosition_Rsp "Front Left Window Position Response
左前车窗位置反馈";
CM_ SG_ 743 DCM_FL_WindowAntiClamp_St "Front Left Window Anti Clamp State
左前车窗防夹状态反馈";
CM_ SG_ 743 DCM_FL_TurnLampErr_St "Front Left Turn Lamp Error State
左前侧转向灯故障状态信号";
CM_ SG_ 743 DCM_FL_TurnLamp_St "Front Left Turn Lamp State
左前侧转向灯状态信号";
CM_ SG_ 743 DCM_FL_WindowMoveStatus "Front Left Window Move Status
左前窗运行状态";
CM_ SG_ 743 DCM_FL_BackMir_UpDwn_Position_Rsp "Front Left Back Mirror Up Down Position Response
左前后视镜上下位置信息反馈信号";
CM_ SG_ 743 DCM_FL_BackMir_LR_Position_Rsp "Front Left Back Mirror Left Right Position Response
左前后视镜左右位置信息反馈信号";
CM_ SG_ 743 BDCM_FD_RT_1_DCM_FL_Available_St "If signals which route from DCM_FL in message BDCM_FD_RT_1 are available
报文BDCM_FD_RT_1中路由的DCM_FL节点的信号是否可信";
CM_ SG_ 743 BDCM_FD_RT_1_DCM_FR_Available_St "If signals which route from DCM_FR in message BDCM_FD_RT_1 are available
报文BDCM_FD_RT_1中路由的DCM_FR节点的信号是否可信";
CM_ SG_ 743 DCM_FR_WindowPosition_Rsp "Front Right Window Position Response
右前车窗位置反馈";
CM_ SG_ 743 DCM_FR_WindowAntiClamp_St "Front Right Window Anti Clamp State
右前车窗防夹状态反馈";
CM_ SG_ 743 DCM_FR_TurnLampErr_St "Front Right Turn Lamp Error State
右前侧转向灯故障状态信号";
CM_ SG_ 743 DCM_FR_TurnLamp_St "Front Right Turn Lamp State
右前侧转向灯状态信号";
CM_ SG_ 743 DCM_FR_WindowMoveStatus "Front Right Window Move Status
右前窗运行状态";
CM_ SG_ 743 DCM_FR_BackMir_UpDwn_Position_Rsp "Front Right Back Mirror Up Down Position Response
右前后视镜上下位置信息反馈信号";
CM_ SG_ 743 DCM_FR_BackMir_LR_Position_Rsp "Front Right Back Mirror Left Right Position Response
右前后视镜左右位置信息反馈信号";
CM_ SG_ 743 BDCM_FD_RT_1_DCM_RL_Available_St "If signals which route from DCM_RL in message BDCM_FD_RT_1 are available
报文BDCM_FD_RT_1中路由的DCM_RL节点的信号是否可信";
CM_ SG_ 743 BDCM_FD_RT_1_DCM_RR_Available_St "If signals which route from DCM_RR in message BDCM_FD_RT_1 are available
报文BDCM_FD_RT_1中路由的DCM_RR节点的信号是否可信";
CM_ SG_ 743 DCM_RL_WindowPosition_Rsp "Rear Left Window Position Response
左后车窗位置反馈";
CM_ SG_ 743 DCM_RL_WindowAntiClamp_St "Rear Left Window Anti Clamp State
左后车窗防夹状态反馈";
CM_ SG_ 743 DCM_RL_WindowMoveStatus "Rear Left Window Move Status
左后窗运行状态";
CM_ SG_ 743 DCM_RR_WindowPosition_Rsp "Rear Right Window Position Response
右后车窗位置反馈";
CM_ SG_ 743 DCM_RR_WindowAntiClamp_St "Rear Right Window Anti Clamp State
右后车窗防夹状态反馈";
CM_ SG_ 743 PDM_FL_DoorOpenDegree_Rsp "Front Left Door Open Degree Response
左前车门开启角度反馈";
CM_ SG_ 743 PDM_FL_DoorAntiClamp_St "Front Left Door Anti Clamp State
左前车门防夹状态";
CM_ SG_ 743 PDM_FL_DoorStopReazon "Front Left Door Stop Reazon
左前车门停止原因";
CM_ SG_ 743 PDM_FL_DoorObstacleAvoid_St "Front Left Door Obstacle Avoid State
左前车门避障状态反馈";
CM_ SG_ 743 PDM_FL_DoorobstacleDistance_Rsp "Front Left Door obstacle Distance Response
左前车门障碍物距离";
CM_ SG_ 743 PDM_FL_DoorWork_St "Front Left Door Work State
左前车门运行状态反馈";
CM_ SG_ 743 BDCM_FD_RT_1_PDM_FL_Available_St "If signals which route from PDM_FL in message BDCM_FD_RT_1 are available
报文BDCM_FD_RT_1中路由的PDM_FL节点的信号是否可信";
CM_ SG_ 743 BDCM_FD_RT_1_PDM_FR_Available_St "If signals which route from PDM_FR in message BDCM_FD_RT_1 are available
报文BDCM_FD_RT_1中路由的PDM_FR节点的信号是否可信";
CM_ SG_ 743 PDM_FR_DoorOpenDegree_Rsp "Front Right Door Open Degree Response
右前车门开启角度反馈";
CM_ SG_ 743 PDM_FR_DoorAntiClamp_St "Front Right Door Anti Clamp State
右前车门防夹状态";
CM_ SG_ 743 PDM_FR_DoorStopReazon "Front Right Door Stop Reazon
右前车门停止原因";
CM_ SG_ 743 PDM_FR_DoorObstacleAvoid_St "Front Right Door Obstacle Avoid State
右前车门避障状态反馈";
CM_ SG_ 743 PDM_FR_DoorobstacleDistance_Rsp "Front Right Door obstacle Distance Response
右前车门障碍物距离";
CM_ SG_ 743 PDM_FR_DoorWork_St "Front Right Door Work State
右前车门运行状态反馈";

BA_DEF_ BO_  "NmMessage" ENUM "No","Yes";
BA_DEF_ BO_  "GenMsgSendType" ENUM  "cyclic","Event","IfActive","CE","CA","NoMsgSendType";
BA_DEF_ BO_  "GenMsgCycleTime" INT 0 0;
BA_DEF_ SG_  "GenSigSendType" ENUM  "cyclic","OnChange","OnWrite","IfActive","OnChangeWithRepetition","OnWriteWithRepetition","IfActiveWithRepetition","NoSigSendType","OnChangeAndIfActive","OnChangeAndIfActiveWithRepetition","CA","CE","Event";
BA_DEF_ SG_  "GenSigStartValue" INT 0 0;
BA_DEF_ BO_  "GenMsgCycleTimeFast" INT 0 0;
BA_DEF_ BO_  "GenMsgNrOfRepetition" INT 0 0;
BA_DEF_ BO_  "CANFD_BRS" ENUM  "0","1";
BA_DEF_ BO_  "VFrameFormat" ENUM  "StandardCAN","ExtendedCAN","reserved","reserved","reserved","reserved","reserved","reserved","reserved","reserved","reserved","reserved","reserved","reserved","StandardCAN_FD","ExtendedCAN_FD";
BA_DEF_ BO_  "GenMsgILSupport" ENUM  "No","Yes";
BA_DEF_DEF_  "NmMessage" "No";
BA_DEF_DEF_  "GenMsgSendType" "cyclic";
BA_DEF_DEF_  "GenMsgCycleTime" 0;
BA_DEF_DEF_  "GenSigSendType" "cyclic";
BA_DEF_DEF_  "GenSigStartValue" 0;
BA_DEF_DEF_  "GenMsgCycleTimeFast" 0;
BA_DEF_DEF_  "GenMsgNrOfRepetition" 0;
BA_DEF_DEF_  "CANFD_BRS" "1";
BA_DEF_DEF_  "VFrameFormat" "StandardCAN_FD";
BA_DEF_DEF_  "GenMsgILSupport" "Yes";
BA_ "GenMsgCycleTime" BO_ 568 50;
BA_ "GenMsgSendType" BO_ 766 1;
BA_ "GenMsgCycleTimeFast" BO_ 766 50;
BA_ "GenMsgNrOfRepetition" BO_ 766 3;
BA_ "GenSigSendType" SG_ 766 IDCM_FrontACSwitch_Cmd 5;
BA_ "GenSigSendType" SG_ 766 IDCM_FrontDeFrostFog_Cmd 5;
BA_ "GenSigSendType" SG_ 766 IDCM_FrontAutoAC_Cmd 5;
BA_ "GenSigSendType" SG_ 766 IDCM_ACCompressorSwitch_Cmd 5;
BA_ "GenSigSendType" SG_ 766 IDCM_FrontACAirFlowLevel_Cmd 5;
BA_ "GenSigSendType" SG_ 766 IDCM_TempAreaSynchronization_Cmd 5;
BA_ "GenSigSendType" SG_ 766 IDCM_AQSSet_Cmd 5;
BA_ "GenSigSendType" SG_ 766 IDCM_FD_21_Reserved4 5;
BA_ "GenSigSendType" SG_ 766 IDCM_FrontACMode_Cmd 5;
BA_ "GenSigSendType" SG_ 766 IDCM_InOutLoopMode_Cmd 5;
BA_ "GenSigSendType" SG_ 766 IDCM_DriverTempSet_Cmd 5;
BA_ "GenSigStartValue" SG_ 766 IDCM_DriverTempSet_Cmd 14;
BA_ "GenSigSendType" SG_ 766 IDCM_PM25Set_Cmd 5;
BA_ "GenSigSendType" SG_ 766 IDCM_PassengerTempSet_Cmd 5;
BA_ "GenSigStartValue" SG_ 766 IDCM_PassengerTempSet_Cmd 14;
BA_ "GenSigSendType" SG_ 766 IDCM_IONSet_Cmd 5;
BA_ "GenSigSendType" SG_ 766 IDCM_ACOperationMode_Cmd 5;
BA_ "GenSigSendType" SG_ 766 IDCM_FD_21_Reserved5 5;
BA_ "GenSigSendType" SG_ 766 IDCM_RearACAuto_Cmd 5;
BA_ "GenSigSendType" SG_ 766 IDCM_RearACSwitch_Cmd 5;
BA_ "GenSigSendType" SG_ 766 IDCM_RearRowTempSet_Cmd 5;
BA_ "GenSigStartValue" SG_ 766 IDCM_RearRowTempSet_Cmd 14;
BA_ "GenSigSendType" SG_ 766 IDCM_AutoDefrostSet_Cmd 5;
BA_ "GenSigSendType" SG_ 766 IDCM_FD_21_Reserved6 5;
BA_ "GenSigSendType" SG_ 766 IDCM_RearACMode_Cmd 5;
BA_ "GenSigSendType" SG_ 766 IDCM_InsideFilterReset 5;
BA_ "GenSigSendType" SG_ 766 IDCM_RearACAirFlowLevel_Cmd 5;
BA_ "GenSigSendType" SG_ 766 IDCM_InsideFilterLifeRemind 5;
BA_ "GenSigSendType" SG_ 766 IDCM_AirFragranceSwitchEnable 5;
BA_ "GenSigSendType" SG_ 766 IDCM_AirFragranceChannel1 5;
BA_ "GenSigSendType" SG_ 766 IDCM_AirFragranceChannel2 5;
BA_ "GenSigSendType" SG_ 766 IDCM_AirFragranceChannel3 5;
BA_ "GenSigSendType" SG_ 766 IDCM_OutsideFilterReset 5;
BA_ "GenSigSendType" SG_ 766 IDCM_FragranceConcentration_Req 5;
BA_ "GenSigSendType" SG_ 766 IDCM_OutsideFilterLifeRemind 5;
BA_ "GenSigSendType" SG_ 766 IDCM_DSMremindwayset 5;
BA_ "GenSigSendType" SG_ 766 IDCM_FD_21_Reserved1 5;
BA_ "GenSigSendType" SG_ 766 IDCM_FD_21_Reserved2 5;
BA_ "GenSigSendType" SG_ 766 IDCM_FD_21_Reserved3 5;
BA_ "GenMsgSendType" BO_ 382 1;
BA_ "GenMsgCycleTimeFast" BO_ 382 20;
BA_ "GenMsgNrOfRepetition" BO_ 382 3;
BA_ "GenSigSendType" SG_ 382 IDCM_FaceRegister_Req 5;
BA_ "GenSigSendType" SG_ 382 IDCM_FaceRegisterResponse_St 5;
BA_ "GenSigSendType" SG_ 382 IDCM_DeleteFaceID_Req 5;
BA_ "GenSigSendType" SG_ 382 IDCM_FaceRecognition_Req 5;
BA_ "GenSigSendType" SG_ 382 IDCM_DSMUserID 5;
BA_ "GenSigSendType" SG_ 382 IDCM_DSMSwitch 5;
BA_ "GenSigSendType" SG_ 382 IDCM_FD_22_Reserved1 5;
BA_ "GenSigSendType" SG_ 382 IDCM_FD_22_Reserved2 5;
BA_ "GenSigSendType" SG_ 382 IDCM_FD_22_Reserved3 5;
BA_ "GenSigSendType" SG_ 382 IDCM_FD_22_Reserved4 5;
BA_ "GenMsgSendType" BO_ 1011 1;
BA_ "GenMsgCycleTimeFast" BO_ 1011 50;
BA_ "GenMsgNrOfRepetition" BO_ 1011 3;
BA_ "GenSigSendType" SG_ 1011 IDCM_DestinationDistance 5;
BA_ "GenSigSendType" SG_ 1011 IDCM_FrontCrossDistance 5;
BA_ "GenSigSendType" SG_ 1011 IDCM_FrontCrossName 5;
BA_ "GenSigSendType" SG_ 1011 IDCM_DestinationRemainTime 5;
BA_ "GenSigSendType" SG_ 1011 IDCM_CameraInformation 5;
BA_ "GenSigSendType" SG_ 1011 IDCM_NextCrossDirection 5;
BA_ "GenSigSendType" SG_ 1011 IDCM_TrafficInformation 5;
BA_ "GenSigSendType" SG_ 1011 IDCM_CurrentSpeedLimit 5;
BA_ "GenSigSendType" SG_ 1011 IDCM_SpecialRoad 5;
BA_ "GenSigSendType" SG_ 1011 IDCM_FrontCrossNameLength 5;
BA_ "GenSigStartValue" SG_ 1011 IDCM_FrontCrossNameLength 1023;
BA_ "GenSigSendType" SG_ 1011 IDCM_FrontRoadBacklane 5;
BA_ "GenSigSendType" SG_ 1011 IDCM_FrontRoadFrontlane 5;
BA_ "GenSigSendType" SG_ 1011 IDCM_DestinationReachFlag 5;
BA_ "GenSigSendType" SG_ 1011 IDCM_FrontCrossNameFrameIndex 5;
BA_ "GenSigStartValue" SG_ 1011 IDCM_FrontCrossNameFrameIndex 15;
BA_ "GenSigSendType" SG_ 1011 IDCM_FD_2_Reserved1 5;
BA_ "GenSigSendType" SG_ 1011 IDCM_FD_2_Reserved2 5;
BA_ "GenMsgSendType" BO_ 383 1;
BA_ "GenMsgCycleTimeFast" BO_ 383 50;
BA_ "GenMsgNrOfRepetition" BO_ 383 3;
BA_ "GenSigSendType" SG_ 383 IDCM_FaceEigenvalueData_Length 5;
BA_ "GenSigStartValue" SG_ 383 IDCM_FaceEigenvalueData_Length 65535;
BA_ "GenSigSendType" SG_ 383 IDCM_FaceEigenvalueData_Index 5;
BA_ "GenSigStartValue" SG_ 383 IDCM_FaceEigenvalueData_Index 65535;
BA_ "GenSigSendType" SG_ 383 IDCM_FaceEigenvalueData_Byte1 5;
BA_ "GenSigSendType" SG_ 383 IDCM_FaceEigenvalueData_Byte2 5;
BA_ "GenSigSendType" SG_ 383 IDCM_FaceEigenvalueData_Byte3 5;
BA_ "GenSigSendType" SG_ 383 IDCM_FaceEigenvalueData_Byte4 5;
BA_ "GenSigSendType" SG_ 383 IDCM_FaceEigenvalueData_Byte5 5;
BA_ "GenSigSendType" SG_ 383 IDCM_FaceEigenvalueData_Byte6 5;
BA_ "GenSigSendType" SG_ 383 IDCM_FaceEigenvalueData_Byte7 5;
BA_ "GenSigSendType" SG_ 383 IDCM_FaceEigenvalueData_Byte8 5;
BA_ "GenSigSendType" SG_ 383 IDCM_FaceEigenvalueData_Byte9 5;
BA_ "GenSigSendType" SG_ 383 IDCM_FaceEigenvalueData_Byte10 5;
BA_ "GenSigSendType" SG_ 383 IDCM_FaceEigenvalueData_Byte11 5;
BA_ "GenSigSendType" SG_ 383 IDCM_FaceEigenvalueData_Byte12 5;
BA_ "GenSigSendType" SG_ 383 IDCM_FaceEigenvalueData_Byte13 5;
BA_ "GenSigSendType" SG_ 383 IDCM_FaceEigenvalueData_Byte14 5;
BA_ "GenSigSendType" SG_ 383 IDCM_FaceEigenvalueData_Byte15 5;
BA_ "GenSigSendType" SG_ 383 IDCM_FaceEigenvalueData_Byte16 5;
BA_ "GenSigSendType" SG_ 383 IDCM_FaceEigenvalueData_Byte17 5;
BA_ "GenSigSendType" SG_ 383 IDCM_FaceEigenvalueData_Byte18 5;
BA_ "GenSigSendType" SG_ 383 IDCM_FaceEigenvalueData_Byte19 5;
BA_ "GenSigSendType" SG_ 383 IDCM_FaceEigenvalueData_Byte20 5;
BA_ "GenSigSendType" SG_ 383 IDCM_FaceEigenvalueData_Byte21 5;
BA_ "GenSigSendType" SG_ 383 IDCM_FaceEigenvalueData_Byte22 5;
BA_ "GenSigSendType" SG_ 383 IDCM_FaceEigenvalueData_Byte23 5;
BA_ "GenSigSendType" SG_ 383 IDCM_FaceEigenvalueData_Byte24 5;
BA_ "GenSigSendType" SG_ 383 IDCM_FaceEigenvalueData_Byte25 5;
BA_ "GenSigSendType" SG_ 383 IDCM_FaceEigenvalueData_Byte26 5;
BA_ "GenSigSendType" SG_ 383 IDCM_FaceEigenvalueData_Byte27 5;
BA_ "GenSigSendType" SG_ 383 IDCM_FaceEigenvalueData_Byte28 5;
BA_ "GenMsgCycleTime" BO_ 1019 1000;
BA_ "GenMsgCycleTimeFast" BO_ 1019 50;
BA_ "GenMsgNrOfRepetition" BO_ 1019 3;
BA_ "GenSigStartValue" SG_ 1019 ALMIP_CustomColorSet_St 255;
BA_ "GenSigStartValue" SG_ 1019 ALMIP_CustomLuminanceSet_St 255;
BA_ "GenSigStartValue" SG_ 1019 IDCM_FD_RT_1_WPC_Available_St 1;
BA_ "GenSigStartValue" SG_ 1019 IDCM_FD_RT_1_AMP_Available_St 1;
BA_ "GenSigStartValue" SG_ 1019 IDCM_FD_RT_1_ALMIP_Available_St 1;
BA_ "GenSigStartValue" SG_ 1019 IDCM_FD_RT_1_ALMIPR_Available_St 1;
BA_ "GenSigStartValue" SG_ 1019 IDCM_FD_RT_1_ALMFL_Available_St 1;
BA_ "GenSigStartValue" SG_ 1019 IDCM_FD_RT_1_ALMFR_Available_St 1;
BA_ "GenMsgSendType" BO_ 752 3;
BA_ "GenMsgCycleTime" BO_ 752 100;
BA_ "GenMsgCycleTimeFast" BO_ 752 50;
BA_ "GenMsgNrOfRepetition" BO_ 752 3;
BA_ "GenSigSendType" SG_ 752 VSP_WakeupUserID_OnlyForIV2 5;
BA_ "GenSigStartValue" SG_ 752 VSP_WakeupUserID_OnlyForIV2 65535;
BA_ "NmMessage" BO_ 1104 1;
BA_ "GenMsgCycleTime" BO_ 1104 500;
BA_ "NmMessage" BO_ 1106 1;
BA_ "GenMsgCycleTime" BO_ 1106 500;
BA_ "NmMessage" BO_ 1107 1;
BA_ "GenMsgCycleTime" BO_ 1107 500;
BA_ "NmMessage" BO_ 1108 1;
BA_ "GenMsgCycleTime" BO_ 1108 500;
BA_ "NmMessage" BO_ 1109 1;
BA_ "GenMsgCycleTime" BO_ 1109 500;
BA_ "NmMessage" BO_ 1025 1;
BA_ "GenMsgCycleTime" BO_ 1025 500;
BA_ "NmMessage" BO_ 1110 1;
BA_ "GenMsgCycleTime" BO_ 1110 500;
BA_ "GenMsgSendType" BO_ 554 3;
BA_ "GenMsgCycleTime" BO_ 554 50;
BA_ "GenMsgCycleTimeFast" BO_ 554 20;
BA_ "GenMsgNrOfRepetition" BO_ 554 3;
BA_ "GenSigSendType" SG_ 554 BDCM_LockUnlock 5;
BA_ "GenSigStartValue" SG_ 554 BDCM_HoodLock_St 3;
BA_ "GenSigSendType" SG_ 554 BDCM_FLDoorLock_St 5;
BA_ "GenSigSendType" SG_ 554 BDCM_FRDoorLock_St 5;
BA_ "GenSigSendType" SG_ 554 BDCM_RLDoorLock_St 5;
BA_ "GenSigSendType" SG_ 554 BDCM_RRDoorLock_St 5;
BA_ "GenSigSendType" SG_ 554 BDCM_RLNTDoorLock_St 5;
BA_ "GenSigSendType" SG_ 554 BDCM_RRNTDoorLock_St 5;
BA_ "GenSigSendType" SG_ 554 BDCM_HazardWarnLamp_St 5;
BA_ "GenSigSendType" SG_ 554 BDCM_WarnLampSwitch_St 5;
BA_ "GenSigSendType" SG_ 554 BDCM_WarnLampSwitch_Valid 5;
BA_ "GenSigSendType" SG_ 554 BDCM_LeftTurnLamp_Cmd 5;
BA_ "GenSigSendType" SG_ 554 BDCM_RightTurnLamp_Cmd 5;
BA_ "GenSigSendType" SG_ 554 BDCM_FRDoor_St 5;
BA_ "GenSigSendType" SG_ 554 BDCM_RRDoor_St 5;
BA_ "GenSigSendType" SG_ 554 BDCM_FLDoor_St 5;
BA_ "GenSigSendType" SG_ 554 BDCM_RLDoor_St 5;
BA_ "GenSigSendType" SG_ 554 BDCM_RLNTDoor_St 5;
BA_ "GenSigSendType" SG_ 554 BDCM_RRNTDoor_St 5;
BA_ "GenSigSendType" SG_ 554 BDCM_BurglarAlarmWarn 5;
BA_ "GenSigSendType" SG_ 554 BDCM_FLBColumnSwitch 5;
BA_ "GenSigSendType" SG_ 554 BDCM_RLBColumnSwitch 5;
BA_ "GenSigSendType" SG_ 554 BDCM_FRBColumnSwitch 5;
BA_ "GenSigSendType" SG_ 554 BDCM_RRBColumnSwitch 5;
BA_ "GenSigSendType" SG_ 554 BDCM_FLDoorWorkSound_Req 5;
BA_ "GenSigSendType" SG_ 554 BDCM_FRDoorWorkSound_Req 5;
BA_ "GenSigSendType" SG_ 554 BDCM_RLDoorWorkSound_Req 5;
BA_ "GenSigSendType" SG_ 554 BDCM_RRDoorWorkSound_Req 5;
BA_ "GenSigSendType" SG_ 554 BDCM_RLNTDoorWorkSound_Req 5;
BA_ "GenSigSendType" SG_ 554 BDCM_RRNTDoorWorkSound_Req 5;
BA_ "GenSigSendType" SG_ 554 BDCM_FLObstacleAvoidSt_Rsp 5;
BA_ "GenSigSendType" SG_ 554 BDCM_FRObstacleAvoidSt_Rsp 5;
BA_ "GenSigSendType" SG_ 554 BDCM_RLObstacleAvoidSt_Rsp 5;
BA_ "GenSigSendType" SG_ 554 BDCM_RRObstacleAvoidSt_Rsp 5;
BA_ "GenSigSendType" SG_ 554 BDCM_FaceIDRecognition_Req 5;
BA_ "GenSigSendType" SG_ 554 BDCM_WpcCtl_Req 5;
BA_ "GenSigStartValue" SG_ 554 BDCM_RLS_LightSwitchRequest 3;
BA_ "GenSigSendType" SG_ 554 BDCM_RainAutoCloseWndwFinish 5;
BA_ "GenSigSendType" SG_ 554 BDCM_UndetectkeyReminder 5;
BA_ "GenSigSendType" SG_ 554 BDCM_KeyLocation_St 5;
BA_ "GenSigSendType" SG_ 554 BDCM_KeyInCarWarn_Req 5;
BA_ "GenSigSendType" SG_ 554 BDCM_KeyNotInCarWarn_Req 5;
BA_ "GenSigSendType" SG_ 554 BDCM_SysError_Rsp 5;
BA_ "GenSigSendType" SG_ 554 BDCM_IGRelayErr 5;
BA_ "GenSigSendType" SG_ 554 BDCM_WashLiquidHeightWarn_St 5;
BA_ "GenMsgSendType" BO_ 713 3;
BA_ "GenMsgCycleTime" BO_ 713 100;
BA_ "GenMsgCycleTimeFast" BO_ 713 50;
BA_ "GenMsgNrOfRepetition" BO_ 713 5;
BA_ "GenSigStartValue" SG_ 713 BDCM_RemoteLowPressureWarnSet_Rsp 1;
BA_ "GenSigStartValue" SG_ 713 BDCM_BackMirrorAutoUnfoldSet_Rsp_OnlyForIV2 1;
BA_ "GenSigSendType" SG_ 713 BDCM_LNTTourismMode_Rsp 5;
BA_ "GenSigSendType" SG_ 713 BDCM_RNTTourismMode_Rsp 5;
BA_ "GenSigStartValue" SG_ 713 BDCM_PassengerSeatSoftPointposition_Rsp 255;
BA_ "GenSigStartValue" SG_ 713 BDCM_AutoHighBeamLamp_Rsp 1;
BA_ "GenSigSendType" SG_ 713 BDCM_SCMSRLZeroGravitySt_Rsp 5;
BA_ "GenSigSendType" SG_ 713 BDCM_SCMSRRZeroGravitySt_Rsp 5;
BA_ "GenSigSendType" SG_ 713 BDCM_SCMSRLEasyEntrySt_Rsp 5;
BA_ "GenSigSendType" SG_ 713 BDCM_SCMSRREasyEntrySt_Rsp 5;
BA_ "GenSigSendType" SG_ 713 BDCM_FLMemorySelectErrReason 5;
BA_ "GenSigSendType" SG_ 713 BDCM_FRMemorySelectErrReason 5;
BA_ "GenSigSendType" SG_ 713 BDCM_SRLEasyEntryStopReason 5;
BA_ "GenSigSendType" SG_ 713 BDCM_SRREasyEntryStopReason 5;
BA_ "GenSigSendType" SG_ 713 BDCM_SRLZeroGravityStopReason 5;
BA_ "GenSigSendType" SG_ 713 BDCM_SRRZeroGravityStopReason 5;
BA_ "GenSigSendType" SG_ 713 BDCM_SCMSRLZeroGravityMotionSt_Rsp 5;
BA_ "GenSigSendType" SG_ 713 BDCM_SCMSRRZeroGravityMotionSt_Rsp 5;
BA_ "GenMsgSendType" BO_ 698 3;
BA_ "GenMsgCycleTime" BO_ 698 100;
BA_ "GenMsgCycleTimeFast" BO_ 698 50;
BA_ "GenMsgNrOfRepetition" BO_ 698 5;
BA_ "GenSigSendType" SG_ 698 BDCM_FLTpmsWheellPressure 5;
BA_ "GenSigStartValue" SG_ 698 BDCM_FLTpmsWheellPressure 255;
BA_ "GenSigSendType" SG_ 698 BDCM_FRTpmsWheellPressure 5;
BA_ "GenSigStartValue" SG_ 698 BDCM_FRTpmsWheellPressure 255;
BA_ "GenSigSendType" SG_ 698 BDCM_RLTpmsWheellPressure 5;
BA_ "GenSigStartValue" SG_ 698 BDCM_RLTpmsWheellPressure 255;
BA_ "GenSigSendType" SG_ 698 BDCM_RRTpmsWheellPressure 5;
BA_ "GenSigStartValue" SG_ 698 BDCM_RRTpmsWheellPressure 255;
BA_ "GenSigSendType" SG_ 698 BDCM_FLTpmsWheellPressureWarn_St 5;
BA_ "GenSigSendType" SG_ 698 BDCM_FRTpmsWheellPressureWarn_St 5;
BA_ "GenSigSendType" SG_ 698 BDCM_RLTpmsWheellPressureWarn_St 5;
BA_ "GenSigSendType" SG_ 698 BDCM_RRTpmsWheellPressureWarn_St 5;
BA_ "GenSigSendType" SG_ 698 BDCM_FLTpmsWheelTemp 5;
BA_ "GenSigSendType" SG_ 698 BDCM_FRTpmsWheelTemp 5;
BA_ "GenSigSendType" SG_ 698 BDCM_RLTpmsWheelTemp 5;
BA_ "GenSigSendType" SG_ 698 BDCM_RRTpmsWheelTemp 5;
BA_ "GenSigSendType" SG_ 698 BDCM_FLTpmsWheelTempWarn_St 5;
BA_ "GenSigSendType" SG_ 698 BDCM_FRTpmsWheelTempWarn_St 5;
BA_ "GenSigSendType" SG_ 698 BDCM_RLTpmsWheelTempWarn_St 5;
BA_ "GenSigSendType" SG_ 698 BDCM_RRTpmsWheelTempWarn_St 5;
BA_ "GenSigSendType" SG_ 698 BDCM_FLTpmsBattle_St 5;
BA_ "GenSigSendType" SG_ 698 BDCM_FRTpmsBattle_St 5;
BA_ "GenSigSendType" SG_ 698 BDCM_RLTpmsBattle_St 5;
BA_ "GenSigSendType" SG_ 698 BDCM_RRTpmsBattle_St 5;
BA_ "GenSigSendType" SG_ 698 BDCM_FLTpmsSensorFailure_St 5;
BA_ "GenSigSendType" SG_ 698 BDCM_FRTpmsSensorFailure_St 5;
BA_ "GenSigSendType" SG_ 698 BDCM_RLTpmsSensorFailure_St 5;
BA_ "GenSigSendType" SG_ 698 BDCM_RRTpmsSensorFailure_St 5;
BA_ "GenSigSendType" SG_ 698 BDCM_FLTpmsIDRegisterFailureWarn 5;
BA_ "GenSigSendType" SG_ 698 BDCM_FRTpmsIDRegisterFailureWarn 5;
BA_ "GenSigSendType" SG_ 698 BDCM_RLTpmsIDRegisterFailureWarn 5;
BA_ "GenSigSendType" SG_ 698 BDCM_RRTpmsIDRegisterFailureWarn 5;
BA_ "GenSigSendType" SG_ 698 BDCM_TpmsRFAntennaErr_Rsp 5;
BA_ "GenSigSendType" SG_ 698 BDCM_FLTpmsRapidLeakWarn 5;
BA_ "GenSigSendType" SG_ 698 BDCM_FRTpmsRapidLeakWarn 5;
BA_ "GenSigSendType" SG_ 698 BDCM_RLTpmsRapidLeakWarn 5;
BA_ "GenSigSendType" SG_ 698 BDCM_RRTpmsRapidLeakWarn 5;
BA_ "GenMsgCycleTime" BO_ 564 50;
BA_ "GenSigStartValue" SG_ 564 BDCM_SWS_L_ProtocolVersion 1;
BA_ "GenSigStartValue" SG_ 564 BDCM_SCAM_Err1 7;
BA_ "GenSigStartValue" SG_ 564 BDCM_SCAM_Err2 7;
BA_ "GenMsgCycleTime" BO_ 743 100;
BA_ "GenSigStartValue" SG_ 743 DCM_FL_WindowPosition_Rsp 255;
BA_ "GenSigStartValue" SG_ 743 DCM_FL_BackMir_UpDwn_Position_Rsp 255;
BA_ "GenSigStartValue" SG_ 743 DCM_FL_BackMir_LR_Position_Rsp 255;
BA_ "GenSigStartValue" SG_ 743 BDCM_FD_RT_1_DCM_FL_Available_St 1;
BA_ "GenSigStartValue" SG_ 743 BDCM_FD_RT_1_DCM_FR_Available_St 1;
BA_ "GenSigStartValue" SG_ 743 DCM_FR_WindowPosition_Rsp 255;
BA_ "GenSigStartValue" SG_ 743 DCM_FR_BackMir_UpDwn_Position_Rsp 255;
BA_ "GenSigStartValue" SG_ 743 DCM_FR_BackMir_LR_Position_Rsp 255;
BA_ "GenSigStartValue" SG_ 743 BDCM_FD_RT_1_DCM_RL_Available_St 1;
BA_ "GenSigStartValue" SG_ 743 BDCM_FD_RT_1_DCM_RR_Available_St 1;
BA_ "GenSigStartValue" SG_ 743 DCM_RL_WindowPosition_Rsp 255;
BA_ "GenSigStartValue" SG_ 743 DCM_RR_WindowPosition_Rsp 255;
BA_ "GenSigStartValue" SG_ 743 PDM_FL_DoorOpenDegree_Rsp 255;
BA_ "GenSigStartValue" SG_ 743 PDM_FL_DoorObstacleAvoid_St 3;
BA_ "GenSigStartValue" SG_ 743 PDM_FL_DoorobstacleDistance_Rsp 255;
BA_ "GenSigStartValue" SG_ 743 BDCM_FD_RT_1_PDM_FL_Available_St 1;
BA_ "GenSigStartValue" SG_ 743 BDCM_FD_RT_1_PDM_FR_Available_St 1;
BA_ "GenSigStartValue" SG_ 743 PDM_FR_DoorOpenDegree_Rsp 255;
BA_ "GenSigStartValue" SG_ 743 PDM_FR_DoorObstacleAvoid_St 3;
BA_ "GenSigStartValue" SG_ 743 PDM_FR_DoorobstacleDistance_Rsp 255;
VAL_ 568 IDCM_APAPASVirtualSwitch_St 3 "Reserved" 2 "Pressed" 1 "No pressed" 0 "None" ;
VAL_ 568 IDCM_APAPIPOSelect 3 "Reserved" 2 "POC（parking out control）" 1 "PIC（parking in control）" 0 "No Selection" ;
VAL_ 568 IDCM_APAFunctionSelectResult 3 "Reserved" 2 "RPA" 1 "APA" 0 "None" ;
VAL_ 568 IDCM_APACancel 3 "Reserved" 2 "Terminated Button Press" 1 "No Button Press" 0 "None" ;
VAL_ 568 IDCM_SVSShow_Req 3 "Reserved" 2 "SVS not show request" 1 "SVS show request" 0 "No request" ;
VAL_ 568 IDCM_SVSBootAnimation_Req 3 "Reserved" 2 "SReserved" 1 "Animation Request" 0 "No request" ;
VAL_ 568 IDCM_SVSMode_Req 3 "Reserved" 2 "3D mode" 1 "Standard mode" 0 "No request" ;
VAL_ 568 IDCM_BasePlateTex_Req 3 "Reserved" 2 "OFF" 1 "ON" 0 "no request" ;
VAL_ 568 IDCM_ObjectOverlay_Req 3 "Reserved" 2 "OFF" 1 "ON" 0 "no request" ;
VAL_ 568 IDCM_TrajectoryOverlay_Req 3 "Reserved" 2 "OFF" 1 "ON" 0 "no request" ;
VAL_ 568 IDCM_PASAcousticWarning_Req 3 "Reserved" 2 "OFF" 1 "ON" 0 "no request" ;
VAL_ 568 IDCM_IntelligentViewChangeSwitch 3 "Reserved" 2 "OFF" 1 "ON" 0 "no request" ;
VAL_ 568 IDCM_APAParkslotSelection 7 "Reserved" 6 "Right ID3" 5 "Right ID2" 4 "Right ID1" 3 "Left ID3" 2 "Left ID2" 1 "Left ID1" 0 "No Slot" ;
VAL_ 568 IDCM_SVSView_Req 19 "Top View" 18 "3D_Rear right view" 17 "3D_Rear left view" 16 "3D_Rear view" 15 ": 3D_Right view" 14 "3D_Left view" 13 "3D_Front right view" 12 "3D_Front left view" 11 "3D_Front View" 10 "2D_Right view" 9 "2D_Left view" 8 "2D_Rear wheel view" 7 "2D_Rear bumper view" 6 "2D_Rear junction view" 5 "2D_Rear view" 4 "2D_Front wheel view" 3 "2D_Front bumper view" 2 "2D_Front junction view" 1 "2D_Front view" 0 "None" ;
VAL_ 568 IDCM_DefaultTopview_Req 3 "Reserved" 2 "OFF" 1 "ON" 0 "No Request" ;
VAL_ 568 IDCM_DefaultNormalview_Req 3 "Reserved" 2 "OFF" 1 "ON" 0 "No Request" ;
VAL_ 568 IDCM_SVSBootAnimationSwitch_Req 3 "Reserved" 2 "OFF" 1 "ON" 0 "No Request" ;
VAL_ 568 IDCM_SVSActiveShowOpen_St 3 "Reserved" 2 "OFF" 1 "ON" 0 "No Request" ;
VAL_ 568 IDCM_SVSTopview_Req 3 "Reserved" 2 "Single view" 1 "TOP view" 0 "No Request" ;
VAL_ 568 IDCM_PMAEBSwitch 3 "Reserved" 2 "OFF" 1 "ON" 0 "No Request" ;
VAL_ 766 IDCM_FrontACSwitch_Cmd 3 "Reserved" 2 "Open" 1 "Close" 0 "Default" ;
VAL_ 766 IDCM_FrontDeFrostFog_Cmd 3 "Reserved" 2 "Active" 1 "Deactive" 0 "Default" ;
VAL_ 766 IDCM_FrontAutoAC_Cmd 3 "Reserved" 2 "Active" 1 "Deactive" 0 "Default" ;
VAL_ 766 IDCM_ACCompressorSwitch_Cmd 3 "Reserved" 2 "Active" 1 "Deactive" 0 "Default" ;
VAL_ 766 IDCM_FrontACAirFlowLevel_Cmd 15 "Reserved" 14 "Reserved" 13 "Reserved" 12 "Reserved" 11 "Reserved" 10 "Level_10" 9 "Level_9" 8 "Level_8" 7 "Level_7" 6 "Level_6" 5 "Level_5" 4 "Level_4" 3 "Level_3" 2 "Level_2" 1 "Level_1" 0 "Default" ;
VAL_ 766 IDCM_TempAreaSynchronization_Cmd 3 "Reserved" 2 "Active" 1 "Deactive" 0 "Default" ;
VAL_ 766 IDCM_AQSSet_Cmd 3 "Reserved" 2 "Active" 1 "Deactive" 0 "Default" ;
VAL_ 766 IDCM_FrontACMode_Cmd 7 "Reserved" 6 "Reserved" 5 "Defrost" 4 "FootDefrost" 3 "Foot" 2 "FaceFoot" 1 "Face" 0 "Default" ;
VAL_ 766 IDCM_InOutLoopMode_Cmd 3 "Auto Inside and outside Loop" 2 "Outside Loop" 1 "Inside Loop" 0 "Default" ;
VAL_ 766 IDCM_DriverTempSet_Cmd 33 "High" 32 "31℃" 31 "30.5℃" 30 "30℃" 29 "29.5℃" 28 "29℃" 27 "28.5℃" 26 "28℃" 25 "27.5℃" 24 "27℃" 23 "26.5℃" 22 "26℃" 21 "25.5℃" 20 "25℃" 19 "24.5℃" 18 "24℃" 17 "23.5℃" 16 "23℃" 15 "22.5℃" 14 "22℃" 13 "21.5℃" 12 "21℃" 11 "20.5℃" 10 "20℃" 9 "19.5℃" 8 "19℃" 7 "18.5℃" 6 "18℃" 5 "17.5℃" 4 "17℃" 3 "16.5℃" 2 "16℃" 1 "Low" 0 "Deafult" ;
VAL_ 766 IDCM_PM25Set_Cmd 3 "Reserved" 2 "Active" 1 "Deactive" 0 "Default" ;
VAL_ 766 IDCM_PassengerTempSet_Cmd 33 "High" 32 "31℃" 31 "30.5℃" 30 "30℃" 29 "29.5℃" 28 "29℃" 27 "28.5℃" 26 "28℃" 25 "27.5℃" 24 "27℃" 23 "26.5℃" 22 "26℃" 21 "25.5℃" 20 "25℃" 19 "24.5℃" 18 "24℃" 17 "23.5℃" 16 "23℃" 15 "22.5℃" 14 "22℃" 13 "21.5℃" 12 "21℃" 11 "20.5℃" 10 "20℃" 9 "19.5℃" 8 "19℃" 7 "18.5℃" 6 "18℃" 5 "17.5℃" 4 "17℃" 3 "16.5℃" 2 "16℃" 1 "Low" 0 "Deafult" ;
VAL_ 766 IDCM_IONSet_Cmd 3 "Reserved" 2 "Active" 1 "Deactive" 0 "Default" ;
VAL_ 766 IDCM_ACOperationMode_Cmd 3 "Reserved" 2 "Economy" 1 "Comfort" 0 "Default" ;
VAL_ 766 IDCM_RearACAuto_Cmd 3 "Reserved" 2 "Active" 1 "Deactive" 0 "Default" ;
VAL_ 766 IDCM_RearACSwitch_Cmd 3 "Reserved" 2 "Open" 1 "Close" 0 "Default" ;
VAL_ 766 IDCM_RearRowTempSet_Cmd 33 "High" 32 "31℃" 31 "30.5℃" 30 "30℃" 29 "29.5℃" 28 "29℃" 27 "28.5℃" 26 "28℃" 25 "27.5℃" 24 "27℃" 23 "26.5℃" 22 "26℃" 21 "25.5℃" 20 "25℃" 19 "24.5℃" 18 "24℃" 17 "23.5℃" 16 "23℃" 15 "22.5℃" 14 "22℃" 13 "21.5℃" 12 "21℃" 11 "20.5℃" 10 "20℃" 9 "19.5℃" 8 "19℃" 7 "18.5℃" 6 "18℃" 5 "17.5℃" 4 "17℃" 3 "16.5℃" 2 "16℃" 1 "Low" 0 "Deafult" ;
VAL_ 766 IDCM_AutoDefrostSet_Cmd 3 "Reserved" 2 "Active" 1 "Deactive" 0 "Default" ;
VAL_ 766 IDCM_RearACMode_Cmd 7 "Reserved" 6 "Reserved" 5 "Reserved" 4 "Reserved" 3 "Foot" 2 "FaceFoot" 1 "Face" 0 "Default" ;
VAL_ 766 IDCM_InsideFilterReset 3 "Reserved" 2 "Active" 1 "Deactive" 0 "Default" ;
VAL_ 766 IDCM_RearACAirFlowLevel_Cmd 15 "Reserved" 14 "Reserved" 13 "Reserved" 12 "Reserved" 11 "Reserved" 10 "Reserved" 9 "Reserved" 8 "Level_8" 7 "Level_7" 6 "Level_6" 5 "Level_5" 4 "Level_4" 3 "Level_3" 2 "Level_2" 1 "Level_1" 0 "Default" ;
VAL_ 766 IDCM_InsideFilterLifeRemind 3 "Reserved" 2 "Active" 1 "Deactive" 0 "Default" ;
VAL_ 766 IDCM_AirFragranceSwitchEnable 3 "Reserved" 2 "Enable" 1 "Disable" 0 "Default" ;
VAL_ 766 IDCM_AirFragranceChannel1 3 "Reserved" 2 "Open" 1 "Close" 0 "Default" ;
VAL_ 766 IDCM_AirFragranceChannel2 3 "Reserved" 2 "Open" 1 "Close" 0 "Default" ;
VAL_ 766 IDCM_AirFragranceChannel3 3 "Reserved" 2 "Open" 1 "Close" 0 "Default" ;
VAL_ 766 IDCM_OutsideFilterReset 3 "Reserved" 2 "Active" 1 "Deactive" 0 "Default" ;
VAL_ 766 IDCM_FragranceConcentration_Req 7 "Reserved" 6 "Reserved" 5 "Reserved" 4 "Reserved" 3 "Density3" 2 "Density2" 1 "Density1" 0 "Default" ;
VAL_ 766 IDCM_OutsideFilterLifeRemind 3 "Reserved" 2 "Active" 1 "Deactive" 0 "Default" ;
VAL_ 766 IDCM_DSMremindwayset 3 "Reserved" 2 "Heighten" 1 "Basic" 0 "No Request" ;
VAL_ 382 IDCM_FaceRegister_Req 3 "Reserved" 2 "Request" 1 "No Request" 0 "No Command" ;
VAL_ 382 IDCM_FaceRegisterResponse_St 3 "Reserved" 2 "Cancel" 1 "Finish" 0 "No Command" ;
VAL_ 382 IDCM_DeleteFaceID_Req 3 "Reserved" 2 "Request" 1 "No Request" 0 "No Command" ;
VAL_ 382 IDCM_FaceRecognition_Req 3 "Reserved" 2 "Request" 1 "No Request" 0 "No Command" ;
VAL_ 382 IDCM_DSMUserID 11 "UserID 10" 10 "UserID 9" 9 "UserID 8" 8 "UserID 7" 7 "UserID 6" 6 "UserID 5" 5 "UserID 4" 4 "UserID 3" 3 "UserID 2" 2 "UserID 1" 1 "Unavailable" 0 "No Command" ;
VAL_ 382 IDCM_DSMSwitch 3 "Reserved" 2 "ON" 1 "OFF" 0 "No Command" ;
VAL_ 1011 IDCM_DestinationDistance 4294967295 "Invalid" ;
VAL_ 1011 IDCM_FrontCrossDistance 4294967295 "Invalid" ;
VAL_ 1011 IDCM_FrontCrossName 281474976710655 "Invalid" ;
VAL_ 1011 IDCM_DestinationRemainTime 4194303 "Invalid" ;
VAL_ 1011 IDCM_CameraInformation 3 "Reserved" 2 "Front camera warning" 1 "No camera" 0 "Default" ;
VAL_ 1011 IDCM_NextCrossDirection 15 "Reserved" 14 "Reserved" 13 "Slow" 12 "Leave Ring" 11 "Entry Ring" 10 "Merge Right" 9 "Merge Left" 8 "Go Straight" 7 "U TurnLeft" 6 "Right Back" 5 "Left Back" 4 "Right Front" 3 "Left Front" 2 "Turn Right" 1 "Turn Left" 0 "Unkown" ;
VAL_ 1011 IDCM_TrafficInformation 15 "Invalid" 14 "Reserved" 13 "Reserved" 12 "Reserved" 11 "Reserved" 10 "Reserved" 9 "Reserved" 8 "Reserved" 7 "Reserved" 6 "Reserved" 5 "Reserved" 4 "Severe congestion" 3 "Congestion" 2 "Amble" 1 "Unblocked" 0 "No jam" ;
VAL_ 1011 IDCM_CurrentSpeedLimit 255 "Invalid" ;
VAL_ 1011 IDCM_SpecialRoad 255 "Invalid" 91 "货车检查站" 83 "货车限重" 82 "货车限宽" 81 "货车限高" 52 "无人看管的铁道路口" 51 "有人看管的铁道路口" 50 "铁道路口" 49 "注意右侧落石" 48 "注意左侧落石" 47 "右急转弯" 46 "左急转弯" 31 "人行横道" 30 "注意危险" 29 "慢行" 28 "路面不平" 27 "过水路面" 26 "下坡路" 25 "上坡路" 24 "右侧傍山险路" 23 "左侧傍山险路" 22 "右侧绕行" 21 "左侧绕行" 20 "左右绕行" 19 "窄桥" 18 "禁止超车" 17 "前方学校" 16 "横风区" 15 "两侧变窄" 14 "右侧变窄" 13 "左侧变窄" 12 "村庄" 11 "最小限速标志" 10 "最大限速标志" 9 "易滑" 8 "铁路道口" 7 "注意落石" 6 "事故多发地" 5 "连续转弯" 4 "反向转弯" 3 "急转弯" 2 "右侧合流" 1 "左侧合流" ;
VAL_ 1011 IDCM_FrontCrossNameLength 1023 "Invalid" ;
VAL_ 1011 IDCM_FrontRoadBacklane 63 "Invalid" ;
VAL_ 1011 IDCM_FrontRoadFrontlane 63 "Invalid" ;
VAL_ 1011 IDCM_DestinationReachFlag 3 "Invalid" 2 "Reserved" 1 "Arrived" 0 "Not arrived" ;
VAL_ 1011 IDCM_FrontCrossNameFrameIndex 15 "Invalid" ;
VAL_ 383 IDCM_FaceEigenvalueData_Length 65535 "Invalid" ;
VAL_ 383 IDCM_FaceEigenvalueData_Index 65535 "Invalid" ;
VAL_ 1019 ALMIP_CustomColorSet_St 255 "Invalid" ;
VAL_ 1019 ALMIP_CustomLuminanceSet_St 255 "Invalid" ;
VAL_ 1019 ALMIP_ThemeMode_St 15 "Invalid" 14 "Edit Mode" 13 "Reserved" 12 "Reserved" 11 "Eleven_Theme" 10 "Tenth_Theme" 9 "Ninth_Theme" 8 "Eighth_Theme" 7 "Seventh_Theme" 6 "Sixth_Theme" 5 "Fifth_Theme" 4 "Fourth_Theme" 3 "Third_Theme" 2 "Second_Theme" 1 "First_Theme" 0 "Default" ;
VAL_ 1019 ALMIP_ONOFF_St 1 "ON" 0 "OFF" ;
VAL_ 1019 WPC_ControllerFaultStatus 1 "Fault" 0 "No Fault" ;
VAL_ 1019 AMP_ControllerFaultStatus 1 "Fault" 0 "No Fault" ;
VAL_ 1019 ALM_IP_ControllerFaultStatus 1 "Fault" 0 "No Fault" ;
VAL_ 1019 ALM_IPR_ControllerFaultStatus 1 "Fault" 0 "No Fault" ;
VAL_ 1019 ALM_FL_ControllerFaultStatus 1 "Fault" 0 "No Fault" ;
VAL_ 1019 ALM_FR_ControllerFaultStatus 1 "Fault" 0 "No Fault" ;
VAL_ 1019 IDCM_FD_RT_1_WPC_Available_St 3 "Reserved" 2 "Reserved" 1 "Not available" 0 "Available" ;
VAL_ 1019 IDCM_FD_RT_1_AMP_Available_St 3 "Reserved" 2 "Reserved" 1 "Not available" 0 "Available" ;
VAL_ 1019 IDCM_FD_RT_1_ALMIP_Available_St 3 "Reserved" 2 "Reserved" 1 "Not available" 0 "Available" ;
VAL_ 1019 IDCM_FD_RT_1_ALMIPR_Available_St 3 "Reserved" 2 "Reserved" 1 "Not available" 0 "Available" ;
VAL_ 1019 IDCM_FD_RT_1_ALMFL_Available_St 3 "Reserved" 2 "Reserved" 1 "Not available" 0 "Available" ;
VAL_ 1019 IDCM_FD_RT_1_ALMFR_Available_St 3 "Reserved" 2 "Reserved" 1 "Not available" 0 "Available" ;
VAL_ 1104 IDCM_RepeatMsgReq 1 "Repeat Message State requested" 0 "Repeat Message State not requested" ;
VAL_ 1104 IDCM_ActiveWakeup 1 "active Wakeup" 0 "passive wakeup" ;
VAL_ 1104 IDCM_RepeatMsgSt 1 "In Repeat Message State" 0 "Not in Repeat Message State；" ;
VAL_ 1104 IDCM_WakeupCGW_TBOX_CANFD 1 "Request" 0 "No Request" ;
VAL_ 1104 IDCM_WakeupCGW_IOV_Backbone 1 "Request" 0 "No Request" ;
VAL_ 1104 IDCM_WakeupCGW_ADAS_Backbone 1 "Request" 0 "No Request" ;
VAL_ 1104 IDCM_WakeupCGW_Chassis_Backbone 1 "Request" 0 "No Request" ;
VAL_ 1104 IDCM_WakeupCGW_PT_Backbone 1 "Request" 0 "No Request" ;
VAL_ 1104 IDCM_WakeupCGW_BD_Backbone 1 "Request" 0 "No Request" ;
VAL_ 1104 IDCM_WakeupCGW_Diagnostic_CANFD 1 "Request" 0 "No Request" ;
VAL_ 1104 IDCM_WakeupCGW_CGW_LIN1 1 "Request" 0 "No Request" ;
VAL_ 1104 IDCM_WakeupBDCM_Body_CAN1 1 "Request" 0 "No Request" ;
VAL_ 1104 IDCM_WakeupBDCM_Body_CAN2 1 "Request" 0 "No Request" ;
VAL_ 1104 IDCM_WakeupBDCM_Body_LIN1 1 "Request" 0 "No Request" ;
VAL_ 1104 IDCM_WakeupBDCM_Body_LIN2 1 "Request" 0 "No Request" ;
VAL_ 1104 IDCM_WakeupBDCM_Body_LIN3 1 "Request" 0 "No Request" ;
VAL_ 1104 IDCM_WakeupBDCM_SCM_LIN 1 "Request" 0 "No Request" ;
VAL_ 1104 IDCM_WakeupIDCM_IOV_CAN 1 "Request" 0 "No Request" ;
VAL_ 1104 IDCM_WakeupVDCM_PT_CANFD1 1 "Request" 0 "No Request" ;
VAL_ 1104 IDCM_WakeupVDCM_PT_CANFD2 1 "Request" 0 "No Request" ;
VAL_ 1104 IDCM_WakeupVDCM_PT_CAN1 1 "Request" 0 "No Request" ;
VAL_ 1104 IDCM_WakeupVDCM_PT_LIN2 1 "Request" 0 "No Request" ;
VAL_ 1104 IDCM_WakeupVDCM_Chassis_Backup 1 "Request" 0 "No Request" ;
VAL_ 1104 IDCM_KeepAwakeReason_KL15 1 "Request" 0 "No Request" ;
VAL_ 1104 IDCM_KeepAwakeReason_Local 1 "Request" 0 "No Request" ;
VAL_ 1104 IDCM_KeepAwakeReason_Diagnostic 1 "Request" 0 "No Request" ;
VAL_ 1104 IDCM_KeepAwakeReason_Network 1 "Request" 0 "No Request" ;
VAL_ 752 VSP_WakeupUserID_OnlyForIV2 65535 "Invalid" ;
VAL_ 752 VSP_WakeupSuperID 4294967295 "Invalid" ;
VAL_ 1106 ARC_RepeatMsgReq 1 "Repeat Message State requested" 0 "Repeat Message State not requested" ;
VAL_ 1106 ARC_ActiveWakeup 1 "active Wakeup" 0 "passive wakeup" ;
VAL_ 1106 ARC_RepeatMsgSt 1 "In Repeat Message State" 0 "Not in Repeat Message State；" ;
VAL_ 1106 ARC_WakeupCGW_TBOX_CANFD 1 "Request" 0 "No Request" ;
VAL_ 1106 ARC_WakeupCGW_IOV_Backbone 1 "Request" 0 "No Request" ;
VAL_ 1106 ARC_WakeupCGW_ADAS_Backbone 1 "Request" 0 "No Request" ;
VAL_ 1106 ARC_WakeupCGW_Chassis_Backbone 1 "Request" 0 "No Request" ;
VAL_ 1106 ARC_WakeupCGW_PT_Backbone 1 "Request" 0 "No Request" ;
VAL_ 1106 ARC_WakeupCGW_BD_Backbone 1 "Request" 0 "No Request" ;
VAL_ 1106 ARC_WakeupCGW_Diagnostic_CANFD 1 "Request" 0 "No Request" ;
VAL_ 1106 ARC_WakeupCGW_CGW_LIN1 1 "Request" 0 "No Request" ;
VAL_ 1106 ARC_WakeupBDCM_Body_CAN1 1 "Request" 0 "No Request" ;
VAL_ 1106 ARC_WakeupBDCM_Body_CAN2 1 "Request" 0 "No Request" ;
VAL_ 1106 ARC_WakeupBDCM_Body_LIN1 1 "Request" 0 "No Request" ;
VAL_ 1106 ARC_WakeupBDCM_Body_LIN2 1 "Request" 0 "No Request" ;
VAL_ 1106 ARC_WakeupBDCM_Body_LIN3 1 "Request" 0 "No Request" ;
VAL_ 1106 ARC_WakeupBDCM_SCM_LIN 1 "Request" 0 "No Request" ;
VAL_ 1106 ARC_WakeupIDCM_IOV_CAN 1 "Request" 0 "No Request" ;
VAL_ 1106 ARC_WakeupVDCM_PT_CANFD1 1 "Request" 0 "No Request" ;
VAL_ 1106 ARC_WakeupVDCM_PT_CANFD2 1 "Request" 0 "No Request" ;
VAL_ 1106 ARC_WakeupVDCM_PT_CAN1 1 "Request" 0 "No Request" ;
VAL_ 1106 ARC_WakeupVDCM_PT_LIN2 1 "Request" 0 "No Request" ;
VAL_ 1106 ARC_WakeupVDCM_Chassis_Backup 1 "Request" 0 "No Request" ;
VAL_ 1106 ARC_KeepAwakeReason_KL15 1 "Request" 0 "No Request" ;
VAL_ 1106 ARC_KeepAwakeReason_Local 1 "Request" 0 "No Request" ;
VAL_ 1106 ARC_KeepAwakeReason_Diagnostic 1 "Request" 0 "No Request" ;
VAL_ 1106 ARC_KeepAwakeReason_Network 1 "Request" 0 "No Request" ;
VAL_ 1107 ARHUD_RepeatMsgReq 1 "Repeat Message State requested" 0 "Repeat Message State not requested" ;
VAL_ 1107 ARHUD_ActiveWakeup 1 "active Wakeup" 0 "passive wakeup" ;
VAL_ 1107 ARHUD_RepeatMsgSt 1 "In Repeat Message State" 0 "Not in Repeat Message State；" ;
VAL_ 1107 ARHUD_WakeupCGW_TBOX_CANFD 1 "Request" 0 "No Request" ;
VAL_ 1107 ARHUD_WakeupCGW_IOV_Backbone 1 "Request" 0 "No Request" ;
VAL_ 1107 ARHUD_WakeupCGW_ADAS_Backbone 1 "Request" 0 "No Request" ;
VAL_ 1107 ARHUD_WakeupCGW_Chassis_Backbone 1 "Request" 0 "No Request" ;
VAL_ 1107 ARHUD_WakeupCGW_PT_Backbone 1 "Request" 0 "No Request" ;
VAL_ 1107 ARHUD_WakeupCGW_BD_Backbone 1 "Request" 0 "No Request" ;
VAL_ 1107 ARHUD_WakeupCGW_Diagnostic_CANFD 1 "Request" 0 "No Request" ;
VAL_ 1107 ARHUD_WakeupCGW_CGW_LIN1 1 "Request" 0 "No Request" ;
VAL_ 1107 ARHUD_WakeupBDCM_Body_CAN1 1 "Request" 0 "No Request" ;
VAL_ 1107 ARHUD_WakeupBDCM_Body_CAN2 1 "Request" 0 "No Request" ;
VAL_ 1107 ARHUD_WakeupBDCM_Body_LIN1 1 "Request" 0 "No Request" ;
VAL_ 1107 ARHUD_WakeupBDCM_Body_LIN2 1 "Request" 0 "No Request" ;
VAL_ 1107 ARHUD_WakeupBDCM_Body_LIN3 1 "Request" 0 "No Request" ;
VAL_ 1107 ARHUD_WakeupBDCM_SCM_LIN 1 "Request" 0 "No Request" ;
VAL_ 1107 ARHUD_WakeupIDCM_IOV_CAN 1 "Request" 0 "No Request" ;
VAL_ 1107 ARHUD_WakeupVDCM_PT_CANFD1 1 "Request" 0 "No Request" ;
VAL_ 1107 ARHUD_WakeupVDCM_PT_CANFD2 1 "Request" 0 "No Request" ;
VAL_ 1107 ARHUD_WakeupVDCM_PT_CAN1 1 "Request" 0 "No Request" ;
VAL_ 1107 ARHUD_WakeupVDCM_PT_LIN2 1 "Request" 0 "No Request" ;
VAL_ 1107 ARHUD_WakeupVDCM_Chassis_Backup 1 "Request" 0 "No Request" ;
VAL_ 1107 ARHUD_KeepAwakeReason_KL15 1 "Request" 0 "No Request" ;
VAL_ 1107 ARHUD_KeepAwakeReason_Local 1 "Request" 0 "No Request" ;
VAL_ 1107 ARHUD_KeepAwakeReason_Diagnostic 1 "Request" 0 "No Request" ;
VAL_ 1107 ARHUD_KeepAwakeReason_Network 1 "Request" 0 "No Request" ;
VAL_ 1108 WHUD_RepeatMsgReq 1 "Repeat Message State requested" 0 "Repeat Message State not requested" ;
VAL_ 1108 WHUD_ActiveWakeup 1 "active Wakeup" 0 "passive wakeup" ;
VAL_ 1108 WHUD_RepeatMsgSt 1 "In Repeat Message State" 0 "Not in Repeat Message State；" ;
VAL_ 1108 WHUD_WakeupCGW_TBOX_CANFD 1 "Request" 0 "No Request" ;
VAL_ 1108 WHUD_WakeupCGW_IOV_Backbone 1 "Request" 0 "No Request" ;
VAL_ 1108 WHUD_WakeupCGW_ADAS_Backbone 1 "Request" 0 "No Request" ;
VAL_ 1108 WHUD_WakeupCGW_Chassis_Backbone 1 "Request" 0 "No Request" ;
VAL_ 1108 WHUD_WakeupCGW_PT_Backbone 1 "Request" 0 "No Request" ;
VAL_ 1108 WHUD_WakeupCGW_BD_Backbone 1 "Request" 0 "No Request" ;
VAL_ 1108 WHUD_WakeupCGW_Diagnostic_CANFD 1 "Request" 0 "No Request" ;
VAL_ 1108 WHUD_WakeupCGW_CGW_LIN1 1 "Request" 0 "No Request" ;
VAL_ 1108 WHUD_WakeupBDCM_Body_CAN1 1 "Request" 0 "No Request" ;
VAL_ 1108 WHUD_WakeupBDCM_Body_CAN2 1 "Request" 0 "No Request" ;
VAL_ 1108 WHUD_WakeupBDCM_Body_LIN1 1 "Request" 0 "No Request" ;
VAL_ 1108 WHUD_WakeupBDCM_Body_LIN2 1 "Request" 0 "No Request" ;
VAL_ 1108 WHUD_WakeupBDCM_Body_LIN3 1 "Request" 0 "No Request" ;
VAL_ 1108 WHUD_WakeupBDCM_SCM_LIN 1 "Request" 0 "No Request" ;
VAL_ 1108 WHUD_WakeupIDCM_IOV_CAN 1 "Request" 0 "No Request" ;
VAL_ 1108 WHUD_WakeupVDCM_PT_CANFD1 1 "Request" 0 "No Request" ;
VAL_ 1108 WHUD_WakeupVDCM_PT_CANFD2 1 "Request" 0 "No Request" ;
VAL_ 1108 WHUD_WakeupVDCM_PT_CAN1 1 "Request" 0 "No Request" ;
VAL_ 1108 WHUD_WakeupVDCM_PT_LIN2 1 "Request" 0 "No Request" ;
VAL_ 1108 WHUD_WakeupVDCM_Chassis_Backup 1 "Request" 0 "No Request" ;
VAL_ 1108 WHUD_KeepAwakeReason_KL15 1 "Request" 0 "No Request" ;
VAL_ 1108 WHUD_KeepAwakeReason_Local 1 "Request" 0 "No Request" ;
VAL_ 1108 WHUD_KeepAwakeReason_Diagnostic 1 "Request" 0 "No Request" ;
VAL_ 1108 WHUD_KeepAwakeReason_Network 1 "Request" 0 "No Request" ;
VAL_ 1109 VSP_RepeatMsgReq 1 "Repeat Message State requested" 0 "Repeat Message State not requested" ;
VAL_ 1109 VSP_ActiveWakeup 1 "active Wakeup" 0 "passive wakeup" ;
VAL_ 1109 VSP_RepeatMsgSt 1 "In Repeat Message State" 0 "Not in Repeat Message State；" ;
VAL_ 1109 VSP_WakeupCGW_TBOX_CANFD 1 "Request" 0 "No Request" ;
VAL_ 1109 VSP_WakeupCGW_IOV_Backbone 1 "Request" 0 "No Request" ;
VAL_ 1109 VSP_WakeupCGW_ADAS_Backbone 1 "Request" 0 "No Request" ;
VAL_ 1109 VSP_WakeupCGW_Chassis_Backbone 1 "Request" 0 "No Request" ;
VAL_ 1109 VSP_WakeupCGW_PT_Backbone 1 "Request" 0 "No Request" ;
VAL_ 1109 VSP_WakeupCGW_BD_Backbone 1 "Request" 0 "No Request" ;
VAL_ 1109 VSP_WakeupCGW_Diagnostic_CANFD 1 "Request" 0 "No Request" ;
VAL_ 1109 VSP_WakeupCGW_CGW_LIN1 1 "Request" 0 "No Request" ;
VAL_ 1109 VSP_WakeupBDCM_Body_CAN1 1 "Request" 0 "No Request" ;
VAL_ 1109 VSP_WakeupBDCM_Body_CAN2 1 "Request" 0 "No Request" ;
VAL_ 1109 VSP_WakeupBDCM_Body_LIN1 1 "Request" 0 "No Request" ;
VAL_ 1109 VSP_WakeupBDCM_Body_LIN2 1 "Request" 0 "No Request" ;
VAL_ 1109 VSP_WakeupBDCM_Body_LIN3 1 "Request" 0 "No Request" ;
VAL_ 1109 VSP_WakeupBDCM_SCM_LIN 1 "Request" 0 "No Request" ;
VAL_ 1109 VSP_WakeupIDCM_IOV_CAN 1 "Request" 0 "No Request" ;
VAL_ 1109 VSP_WakeupVDCM_PT_CANFD1 1 "Request" 0 "No Request" ;
VAL_ 1109 VSP_WakeupVDCM_PT_CANFD2 1 "Request" 0 "No Request" ;
VAL_ 1109 VSP_WakeupVDCM_PT_CAN1 1 "Request" 0 "No Request" ;
VAL_ 1109 VSP_WakeupVDCM_PT_LIN2 1 "Request" 0 "No Request" ;
VAL_ 1109 VSP_WakeupVDCM_Chassis_Backup 1 "Request" 0 "No Request" ;
VAL_ 1109 VSP_KeepAwakeReason_KL15 1 "Request" 0 "No Request" ;
VAL_ 1109 VSP_KeepAwakeReason_Local 1 "Request" 0 "No Request" ;
VAL_ 1109 VSP_KeepAwakeReason_Diagnostic 1 "Request" 0 "No Request" ;
VAL_ 1109 VSP_KeepAwakeReason_Network 1 "Request" 0 "No Request" ;
VAL_ 1025 CGW_RepeatMsgReq 1 "Repeat Message State requested" 0 "Repeat Message State not requested" ;
VAL_ 1025 CGW_ActiveWakeup 1 "active Wakeup" 0 "passive wakeup" ;
VAL_ 1025 CGW_RepeatMsgSt 1 "In Repeat Message State" 0 "Not in Repeat Message State；" ;
VAL_ 1025 CGW_WakeupCGW_TBOX_CANFD 1 "Request" 0 "No Request" ;
VAL_ 1025 CGW_WakeupCGW_IOV_Backbone 1 "Request" 0 "No Request" ;
VAL_ 1025 CGW_WakeupCGW_ADAS_Backbone 1 "Request" 0 "No Request" ;
VAL_ 1025 CGW_WakeupCGW_Chassis_Backbone 1 "Request" 0 "No Request" ;
VAL_ 1025 CGW_WakeupCGW_PT_Backbone 1 "Request" 0 "No Request" ;
VAL_ 1025 CGW_WakeupCGW_BD_Backbone 1 "Request" 0 "No Request" ;
VAL_ 1025 CGW_WakeupCGW_Diagnostic_CANFD 1 "Request" 0 "No Request" ;
VAL_ 1025 CGW_WakeupCGW_CGW_LIN1 1 "Request" 0 "No Request" ;
VAL_ 1025 CGW_WakeupBDCM_Body_CAN1 1 "Request" 0 "No Request" ;
VAL_ 1025 CGW_WakeupBDCM_Body_CAN2 1 "Request" 0 "No Request" ;
VAL_ 1025 CGW_WakeupBDCM_Body_LIN1 1 "Request" 0 "No Request" ;
VAL_ 1025 CGW_WakeupBDCM_Body_LIN2 1 "Request" 0 "No Request" ;
VAL_ 1025 CGW_WakeupBDCM_Body_LIN3 1 "Request" 0 "No Request" ;
VAL_ 1025 CGW_WakeupBDCM_SCM_LIN 1 "Request" 0 "No Request" ;
VAL_ 1025 CGW_WakeupIDCM_IOV_CAN 1 "Request" 0 "No Request" ;
VAL_ 1025 CGW_WakeupVDCM_PT_CANFD1 1 "Request" 0 "No Request" ;
VAL_ 1025 CGW_WakeupVDCM_PT_CANFD2 1 "Request" 0 "No Request" ;
VAL_ 1025 CGW_WakeupVDCM_PT_CAN1 1 "Request" 0 "No Request" ;
VAL_ 1025 CGW_WakeupVDCM_PT_LIN2 1 "Request" 0 "No Request" ;
VAL_ 1025 CGW_WakeupVDCM_Chassis_Backup 1 "Request" 0 "No Request" ;
VAL_ 1025 CGW_KeepAwakeReason_KL15 1 "Request" 0 "No Request" ;
VAL_ 1025 CGW_KeepAwakeReason_Local 1 "Request" 0 "No Request" ;
VAL_ 1025 CGW_KeepAwakeReason_Diagnostic 1 "Request" 0 "No Request" ;
VAL_ 1025 CGW_KeepAwakeReason_Network 1 "Request" 0 "No Request" ;
VAL_ 1110 FSE_M_RepeatMsgReq 1 "Repeat Message State requested" 0 "Repeat Message State not requested" ;
VAL_ 1110 FSE_M_ActiveWakeup 1 "active Wakeup" 0 "passive wakeup" ;
VAL_ 1110 FSE_M_RepeatMsgSt 1 "In Repeat Message State" 0 "Not in Repeat Message State；" ;
VAL_ 1110 FSE_M_WakeupCGW_TBOX_CANFD 1 "Request" 0 "No Request" ;
VAL_ 1110 FSE_M_WakeupCGW_IOV_Backbone 1 "Request" 0 "No Request" ;
VAL_ 1110 FSE_M_WakeupCGW_ADAS_Backbone 1 "Request" 0 "No Request" ;
VAL_ 1110 FSE_M_WakeupCGW_Chassis_Backbone 1 "Request" 0 "No Request" ;
VAL_ 1110 FSE_M_WakeupCGW_PT_Backbone 1 "Request" 0 "No Request" ;
VAL_ 1110 FSE_M_WakeupCGW_BD_Backbone 1 "Request" 0 "No Request" ;
VAL_ 1110 FSE_M_WakeupCGW_Diagnostic_CANFD 1 "Request" 0 "No Request" ;
VAL_ 1110 FSE_M_WakeupCGW_CGW_LIN1 1 "Request" 0 "No Request" ;
VAL_ 1110 FSE_M_WakeupBDCM_Body_CAN1 1 "Request" 0 "No Request" ;
VAL_ 1110 FSE_M_WakeupBDCM_Body_CAN2 1 "Request" 0 "No Request" ;
VAL_ 1110 FSE_M_WakeupBDCM_Body_LIN1 1 "Request" 0 "No Request" ;
VAL_ 1110 FSE_M_WakeupBDCM_Body_LIN2 1 "Request" 0 "No Request" ;
VAL_ 1110 FSE_M_WakeupBDCM_Body_LIN3 1 "Request" 0 "No Request" ;
VAL_ 1110 FSE_M_WakeupBDCM_SCM_LIN 1 "Request" 0 "No Request" ;
VAL_ 1110 FSE_M_WakeupFSE_M_IOV_CAN 1 "Request" 0 "No Request" ;
VAL_ 1110 FSE_M_WakeupVDCM_PT_CANFD1 1 "Request" 0 "No Request" ;
VAL_ 1110 FSE_M_WakeupVDCM_PT_CANFD2 1 "Request" 0 "No Request" ;
VAL_ 1110 FSE_M_WakeupVDCM_PT_CAN1 1 "Request" 0 "No Request" ;
VAL_ 1110 FSE_M_WakeupVDCM_PT_LIN2 1 "Request" 0 "No Request" ;
VAL_ 1110 FSE_M_WakeupVDCM_Chassis_Backup 1 "Request" 0 "No Request" ;
VAL_ 1110 FSE_M_KeepAwakeReason_KL15 1 "Request" 0 "No Request" ;
VAL_ 1110 FSE_M_KeepAwakeReason_Local 1 "Request" 0 "No Request" ;
VAL_ 1110 FSE_M_KeepAwakeReason_Diagnostic 1 "Request" 0 "No Request" ;
VAL_ 1110 FSE_M_KeepAwakeReason_Network 1 "Request" 0 "No Request" ;
VAL_ 554 BDCM_LockUnlock 3 "invalid" 2 "Lock" 1 "Unlock" 0 "inactive" ;
VAL_ 554 BDCM_LogicLock_St 3 "reserved" 2 "lock" 1 "Unlock" 0 "Default" ;
VAL_ 554 BDCM_HoodLock_St 3 "Invalid" 2 "Reserved" 1 "Unlock" 0 "Lock" ;
VAL_ 554 BDCM_FLDoorLock_St 3 "invalid" 2 "Reserved" 1 "Lock" 0 "Unlock" ;
VAL_ 554 BDCM_FRDoorLock_St 3 "invalid" 2 "Reserved" 1 "Lock" 0 "Unlock" ;
VAL_ 554 BDCM_RLDoorLock_St 3 "invalid" 2 "Reserved" 1 "Lock" 0 "Unlock" ;
VAL_ 554 BDCM_PowerMode 3 "Reserved" 2 "Remote ON" 1 "Local ON" 0 "OFF" ;
VAL_ 554 BDCM_RRDoorLock_St 3 "invalid" 2 "Reserved" 1 "Lock" 0 "Unlock" ;
VAL_ 554 BDCM_RLNTDoorLock_St 3 "invalid" 2 "Reserved" 1 "Lock" 0 "Unlock" ;
VAL_ 554 BDCM_RRNTDoorLock_St 3 "invalid" 2 "Reserved" 1 "Lock" 0 "Unlock" ;
VAL_ 554 BDCM_HazardWarnLamp_St 3 "invalid" 2 "reserved" 1 "active" 0 "Inacitve" ;
VAL_ 554 BDCM_WarnLampSwitch_St 1 "Pressed" 0 "NoPressed" ;
VAL_ 554 BDCM_WarnLampSwitch_Valid 1 "valid" 0 "invalid" ;
VAL_ 554 BDCM_LeftTurnLamp_Cmd 1 "On" 0 "Off" ;
VAL_ 554 BDCM_RightTurnLamp_Cmd 1 "On" 0 "Off" ;
VAL_ 554 BDCM_FLSeatOccupied_St 3 "invalid" 2 "reserved" 1 "Active" 0 "No Request" ;
VAL_ 554 BDCM_FRDoor_St 3 "invalid" 2 "Reserved" 1 "Open" 0 "Close" ;
VAL_ 554 BDCM_RRDoor_St 3 "invalid" 2 "Reserved" 1 "Open" 0 "Close" ;
VAL_ 554 BDCM_FLDoor_St 3 "invalid" 2 "Reserved" 1 "Open" 0 "Close" ;
VAL_ 554 BDCM_RLDoor_St 3 "invalid" 2 "Reserved" 1 "Open" 0 "Close" ;
VAL_ 554 BDCM_RLNTDoor_St 3 "invalid" 2 "Reserved" 1 "Open" 0 "Close" ;
VAL_ 554 BDCM_RRNTDoor_St 3 "invalid" 2 "Reserved" 1 "Open" 0 "Close" ;
VAL_ 554 BDCM_BurglarAlarmWarn 1 "active" 0 "inactive" ;
VAL_ 554 BDCM_SteeringWheelHeating_St 3 "Reserved" 2 "Inactive" 1 "Active" 0 "None" ;
VAL_ 554 BDCM_BackMirrorHeat_St 3 "Invalid" 2 "HeatingStop" 1 "HeatingON" 0 "None" ;
VAL_ 554 BDCM_RearDefrost_St 3 "Invalid" 2 "DefogOFF" 1 "DefogON" 0 "None" ;
VAL_ 554 BDCM_BackLight_St 3 "Reserved" 2 "Reserved" 1 "ON" 0 "OFF" ;
VAL_ 554 BDCM_TopLightLF_St 1 "Active" 0 "NoRequest" ;
VAL_ 554 BDCM_TopLightRF_St 1 "Active" 0 "NoRequest" ;
VAL_ 554 BDCM_TopLightLM_St 1 "Active" 0 "NoRequest" ;
VAL_ 554 BDCM_TopLightRM_St 1 "Active" 0 "NoRequest" ;
VAL_ 554 BDCM_TopLightLR_St 1 "Active" 0 "NoRequest" ;
VAL_ 554 BDCM_TopLightRR_St 1 "Active" 0 "NoRequest" ;
VAL_ 554 BDCM_BackLightIntensityAdjust_Rsp 15 "Invalid" 14 "Reserved" 13 "Reserved" 12 "Reserved" 11 "Reserved" 10 "Lv10" 9 "Lv9" 8 "Lv8" 7 "Lv7" 6 "Lv6" 5 "Lv5" 4 "Lv4" 3 "Lv3" 2 "Lv2" 1 "Lv1" 0 "OFF" ;
VAL_ 554 BDCM_ChargeCapErr_St 1 "Error" 0 "No Error" ;
VAL_ 554 BDCM_ChargeCap_St 3 "Reserved" 2 "Close" 1 "Open" 0 "None" ;
VAL_ 554 BDCM_FLBColumnSwitch 1 "press" 0 "no press" ;
VAL_ 554 BDCM_RLBColumnSwitch 1 "press" 0 "no press" ;
VAL_ 554 BDCM_FRBColumnSwitch 1 "press" 0 "no press" ;
VAL_ 554 BDCM_RRBColumnSwitch 1 "press" 0 "no press" ;
VAL_ 554 BDCM_FLDoorWorkSound_Req 3 "Invalid" 1 "request" 0 "no request" ;
VAL_ 554 BDCM_FRDoorWorkSound_Req 3 "Invalid" 1 "request" 0 "no request" ;
VAL_ 554 BDCM_RLDoorWorkSound_Req 3 "Invalid" 1 "request" 0 "no request" ;
VAL_ 554 BDCM_RRDoorWorkSound_Req 3 "Invalid" 1 "request" 0 "no request" ;
VAL_ 554 BDCM_RLNTDoorWorkSound_Req 3 "Invalid" 1 "request" 0 "no request" ;
VAL_ 554 BDCM_RRNTDoorWorkSound_Req 3 "Invalid" 1 "request" 0 "no request" ;
VAL_ 554 BDCM_FLDoorUssSelfCheck_Rsp 3 "error" 2 "communication lost" 1 "too close warning" 0 "normal" ;
VAL_ 554 BDCM_FRDoorUssSelfCheck_Rsp 3 "error" 2 "communication lost" 1 "too close warning" 0 "normal" ;
VAL_ 554 BDCM_RLDoorUssSelfCheck_Rsp 3 "error" 2 "communication lost" 1 "too close warning" 0 "normal" ;
VAL_ 554 BDCM_RRDoorUssSelfCheck_Rsp 3 "error" 2 "communication lost" 1 "too close warning" 0 "normal" ;
VAL_ 554 BDCM_RLNTDoorUssSelfCheck_Rsp 3 "error" 2 "communication lost" 1 "too close warning" 0 "normal" ;
VAL_ 554 BDCM_RRNTDoorUssSelfCheck_Rsp 3 "error" 2 "communication lost" 1 "too close warning" 0 "normal" ;
VAL_ 554 BDCM_FLObstacleAvoidSt_Rsp 3 "reserved" 2 "not happen" 1 "happen" 0 "Invalid" ;
VAL_ 554 BDCM_FRObstacleAvoidSt_Rsp 3 "reserved" 2 "not happen" 1 "happen" 0 "Invalid" ;
VAL_ 554 BDCM_RLObstacleAvoidSt_Rsp 3 "reserved" 2 "not happen" 1 "happen" 0 "Invalid" ;
VAL_ 554 BDCM_RRObstacleAvoidSt_Rsp 3 "reserved" 2 "not happen" 1 "happen" 0 "Invalid" ;
VAL_ 554 BDCM_FaceIDRecognition_Req 3 "invalid" 2 "reserved" 1 "Request" 0 "No request" ;
VAL_ 554 BDCM_WpcCtl_Req 1 "Close" 0 "Open" ;
VAL_ 554 BDCM_FrontWiperService_St 3 "Reserved" 2 "Reserved" 1 "Active" 0 "NoRequest" ;
VAL_ 554 BDCM_WiperMotorErr 1 "Error" 0 "NoError" ;
VAL_ 554 BDCM_WashLiquidHght 255 "Invalid" ;
VAL_ 554 BDCM_RLS_LightSwitchRequest 3 "Invalid" 2 "Reserved" 1 "Switch light on" 0 "Switch light off" ;
VAL_ 554 BDCM_RainAutoCloseWndwFinish 1 "active" 0 "inactive" ;
VAL_ 554 BDCM_UndetectkeyReminder 15 "Reserved" 14 "Reserved" 13 "Reserved" 12 "Reserved" 11 "Reserved" 10 "Reserved" 9 "Reserved" 8 "Reserved" 7 "Reserved" 6 "Reserved" 5 "Reserved" 4 "Reserved" 3 "Reserved" 2 "Reserved" 1 "Active" 0 "Inactive" ;
VAL_ 554 BDCM_KeyLocation_St 4 "Key in vehicle" 3 "Lock area" 2 "Unlock area" 1 "Greeting area" 0 "undefind" ;
VAL_ 554 BDCM_KeyBatterySOC_St 15 "Reserved" 14 "Reserved" 13 "Reserved" 12 "Reserved" 11 "Reserved" 10 "Reserved" 9 "Reserved" 8 "Reserved" 7 "Reserved" 6 "Reserved" 5 "Reserved" 4 "Reserved" 3 "Reserved" 2 "Reserved" 1 "BatterySOCLow" 0 "BatterySOCNormal" ;
VAL_ 554 BDCM_KeyInCarWarn_Req 1 "active" 0 "inactive" ;
VAL_ 554 BDCM_KeyNotInCarWarn_Req 1 "active" 0 "inactive" ;
VAL_ 554 BDCM_SysError_Rsp 1 "error" 0 "no error" ;
VAL_ 554 BDCM_IGRelayErr 3 "Invalid" 2 "Reserved" 1 "Error" 0 "No Error" ;
VAL_ 554 BDCM_DriverSWSAdjust_St 3 "Invalid" 2 "Adjusting" 1 "No?adjust" 0 "Default" ;
VAL_ 554 BDCM_WashLiquidHeightWarn_St 3 "Reserved" 2 "active" 1 "Inactive" 0 "Invalid" ;
VAL_ 554 BDCM_VMVehicleModeInfo 7 "Invalid" 6 "Reserved" 5 "Reserved" 4 "Reserved" 3 "Dyno" 2 "Transport" 1 "Factory" 0 "Normal" ;
VAL_ 554 BDCM_RKE_Detect 3 "Invalid" 2 "Key2" 1 "Key1" 0 "Default" ;
VAL_ 554 BDCM_DriverPositionMemoryWindow_Req 1 "active" 0 "Inactive" ;
VAL_ 554 BDCM_PassengerPositionMemoryWindow_Req 1 "active" 0 "Inactive" ;
VAL_ 554 BDCM_ReverseBackMirTurndown_St 3 "Invalid" 2 "Left&Right Mirror Turn Down" 1 "Right Mirror Turn Down" 0 "Inactive" ;
VAL_ 554 BDCM_FogLampSt_Rsp 3 "invalid" 2 "reserved" 1 "active" 0 "Inactive" ;
VAL_ 554 BDCM_SCAMCalibration_St 3 "Invalid" 2 "Calibration" 1 "No Calibration" 0 "Inactive" ;
VAL_ 713 BDCM_RainAutoCloseWndwSet_Rsp 1 "Active" 0 "NoRequest" ;
VAL_ 713 BDCM_DriverSideApproachOpenDoorSet_Rsp 1 "Enable" 0 "Disable" ;
VAL_ 713 BDCM_PassengerSideApproachOpenDoorSet_Rsp 1 "Enable" 0 "Disable" ;
VAL_ 713 BDCM_TopLightSwitch_Rsp 1 "ON" 0 "OFF" ;
VAL_ 713 BDCM_FrontWiperMode_Rsp 3 "Invalid" 2 "Auto" 1 "Intermit" 0 "Initial" ;
VAL_ 713 BDCM_SafetyLockSet_Rsp 3 "Left and Right" 2 "Right side" 1 "Left side" 0 "No Request" ;
VAL_ 713 BDCM_ApproachUnlockConfig_Rsp 7 "Invalid" 6 "Reserved" 5 "Reserved" 4 "Auto Mode" 3 "Four doors" 2 "Driver side" 1 "OFF" 0 "No Request" ;
VAL_ 713 BDCM_CampingMode_Rsp 3 "Invalid" 2 "ON" 1 "OFF" 0 "No Request" ;
VAL_ 713 BDCM_UnlockModeSet_Rsp 3 "invalid" 2 "Reserved" 1 "unlockdriverdoor" 0 "unlockallDoor" ;
VAL_ 713 BDCM_RemoteLowPressureWarnSet_Rsp 1 "ON" 0 "OFF" ;
VAL_ 713 BDCM_HornModeSet_Rsp_OnlyForIV2 1 "MuteMode" 0 "NormalMode" ;
VAL_ 713 BDCM_BackMirrorAutoFoldSet_Rsp_OnlyForIV2 1 "Active" 0 "Inactive" ;
VAL_ 713 BDCM_BackMirrorAutoTurnOverSet_Rsp_OnlyForIV2 3 "Reserved" 2 "RightOnly" 1 "LeftandRight" 0 "OFF" ;
VAL_ 713 BDCM_BackMirrorAutoUnfoldSet_Rsp_OnlyForIV2 3 "Reserved" 2 "Reserved" 1 "ON" 0 "OFF" ;
VAL_ 713 BDCM_ApproachUnlockSet_Rsp_OnlyForIV2 1 "Enable" 0 "Disable" ;
VAL_ 713 BDCM_WalkAwayLockSet_Rsp 1 "ON" 0 "OFF" ;
VAL_ 713 BDCM_ValetModeHoodForbid_Rsp 3 "Invalid" 2 "ON" 1 "OFF" 0 "Inactive" ;
VAL_ 713 BDCM_TailFootOpenSet_Rsp 1 "Enable" 0 "Disable" ;
VAL_ 713 BDCM_TailOpenModeSet_Rsp 3 "Reserved" 2 "Reserved" 1 "Garge" 0 "Max" ;
VAL_ 713 BDCM_TailNormallyOpenAngleSet_Rsp 255 "Invalid" ;
VAL_ 713 BDCM_TailGarageOpenAngleSet_Rsp 255 "Invalid" ;
VAL_ 713 BDCM_LightSet_Rsp 7 "Invalid" 6 "reserved" 5 "reserved" 4 "OFF" 3 "Low beam" 2 "Position light" 1 "AUTO light" 0 "Inactive" ;
VAL_ 713 BDCM_NTModeSet_Rsp 3 "Invalid" 2 "Reserved" 1 "Linkage" 0 "Traditional" ;
VAL_ 713 BDCM_LNTTourismMode_Rsp 1 "Active" 0 "NoRequest" ;
VAL_ 713 BDCM_RNTTourismMode_Rsp 1 "Active" 0 "NoRequest" ;
VAL_ 713 BDCM_NTVariableRateSet_Rsp 7 "invalid" 6 "reserved" 5 "reserved" 4 "reserved" 3 "Low" 2 "Medium" 1 "High" 0 "inactive" ;
VAL_ 713 BDCM_NTOpenAngelSet_Rsp 255 "Invalid" ;
VAL_ 713 BDCM_PassengerSeatSoftPointposition_Rsp 255 "Invalid" ;
VAL_ 713 BDCM_NTTourismModeOpenAngelSet_Rsp 255 "Invalid" ;
VAL_ 713 BDCM_FDoorVariableRateSet_Rsp 7 "invalid" 6 "reserved" 5 "reserved" 4 "reserved" 3 "Low" 2 "Medium" 1 "High" 0 "inactive" ;
VAL_ 713 BDCM_RDoorVariableRateSet_Rsp 7 "invalid" 6 "reserved" 5 "reserved" 4 "reserved" 3 "Low" 2 "Medium" 1 "High" 0 "inactive" ;
VAL_ 713 BDCM_FDoorOpenAngelSet_Rsp 255 "Invalid" ;
VAL_ 713 BDCM_RDoorOpenAngelSet_Rsp 255 "Invalid" ;
VAL_ 713 BDCN_RLWindowSwitchForbid_Rsp 3 "Reserved" 2 "Reserved" 1 "Forbid" 0 "Not Forbid" ;
VAL_ 713 BDCN_RRWindowSwitchForbid_Rsp 3 "Reserved" 2 "Reserved" 1 "Forbid" 0 "Not Forbid" ;
VAL_ 713 BDCM_AutoLightSet_Rsp_OnlyForIV2 1 "Enable" 0 "Disable" ;
VAL_ 713 BDCM_AutoHighBeamLamp_Rsp 1 "Enable" 0 "Disable" ;
VAL_ 713 BDCM_LightDelayCloseTimeSet_Rsp 3 "60s" 2 "30s" 1 "15s" 0 "0s" ;
VAL_ 713 BDCM_WelcomeMode_Rsp 3 "Reserved" 2 "OFF" 1 "ON" 0 "Inactive" ;
VAL_ 713 BDCM_TopLightMode_Rsp 1 "AUTO" 0 "Manual" ;
VAL_ 713 BDCM_SmartLightEN_Rsp 3 "Invalid" 2 "Reserved" 1 "NotinAuto" 0 "Auto" ;
VAL_ 713 BDCM_DriverPositionMemorySave_St_OnlyForIV2 3 "Reserved" 2 "Reserved" 1 "Fail" 0 "Success" ;
VAL_ 713 BDCM_DriverPositionMemoryExport_St_OnlyForIV2 3 "Reserved" 2 "Reserved" 1 "Fail" 0 "Success" ;
VAL_ 713 BDCM_PassengerPositionMemoryMemSave_St_OnlyForIV2 3 "Reserved" 2 "Reserved" 1 "Fail" 0 "Success" ;
VAL_ 713 BDCM_PassengerPositionMemoryMemExport_OnlyForIV2 3 "Reserved" 2 "Moving" 1 "Fail" 0 "Success" ;
VAL_ 713 BDCM_RearFogLightCmd_Rsp 3 "Reserved" 2 "ON" 1 "OFF" 0 "Default" ;
VAL_ 713 BDCM_SCMSRLZeroGravitySt_Rsp 7 "Invalid" 6 "Reserved" 5 "Stop" 4 "Moving" 3 "Mode3(Only for IV2)" 2 "Mode2(Only for IV2)" 1 "Mode1" 0 "Off" ;
VAL_ 713 BDCM_SCMSRRZeroGravitySt_Rsp 7 "Invalid" 6 "Reserved" 5 "Stop" 4 "Moving" 3 "Mode3(Only for IV2)" 2 "Mode2(Only for IV2)" 1 "Mode1" 0 "Off" ;
VAL_ 713 BDCM_SCMSRLEasyEntrySt_Rsp 7 "Reserved" 6 "Moving to  initial position" 5 "Moving to  EasyEntry" 4 "RecoveryFailed" 3 "RecoverySuccess" 2 "EasyEntryFailed" 1 "EasyEntrySuccess" 0 "Off" ;
VAL_ 713 BDCM_SCMSRREasyEntrySt_Rsp 7 "Reserved" 6 "Moving to  initial position" 5 "Moving to  EasyEntry" 4 "RecoveryFailed" 3 "RecoverySuccess" 2 "EasyEntryFailed" 1 "EasyEntrySuccess" 0 "Off" ;
VAL_ 713 BDCM_FLMemorySelectErrReason 12 "put into gear and braking" 11 "Calibrationincomplete" 10 "vehicle security" 9 "Vehicle not stationary" 8 "Voltage abnormal" 7 "Fault" 6 "Communication error" 5 "Anti-pinch trigger" 4 "End(Only for IV2)" 3 "Instruction conflict" 2 "space not enough" 1 "Finish" 0 "invalid" ;
VAL_ 713 BDCM_FRMemorySelectErrReason 11 "Calibrationincomplete" 10 "vehicle security" 9 "Vehicle not stationary" 8 "Voltage abnormal" 7 "Fault" 6 "Communication error" 5 "Anti-pinch trigger" 4 "End(IV2)" 3 "Instruction conflict" 2 "space not enough" 1 "Finish" 0 "invalid" ;
VAL_ 713 BDCM_SRLEasyEntryStopReason 10 "Calibrationincomplete" 9 "Vehicle not stationary" 8 "Voltage abnormal" 7 "Fault" 6 "Communication error" 5 "Anti-pinch trigger" 4 "End(Only for IV2)" 3 "Instruction conflict" 2 "space not enough" 1 "Finish" 0 "invalid" ;
VAL_ 713 BDCM_SRREasyEntryStopReason 10 "Calibrationincomplete" 9 "Vehicle not stationary" 8 "Voltage abnormal" 7 "Fault" 6 "Communication error" 5 "Anti-pinch trigger" 4 "End(IV2)" 3 "Instruction conflict" 2 "space not enough" 1 "Finish" 0 "invalid" ;
VAL_ 713 BDCM_SRLZeroGravityStopReason 9 "Calibrationincomplete" 8 "Voltage abnormal" 7 "Fault" 6 "Communication error" 5 "Anti-pinch trigger" 4 "End" 3 "Instruction conflict" 2 "space not enough" 1 "Finish" 0 "invalid" ;
VAL_ 713 BDCM_SRRZeroGravityStopReason 9 "Calibrationincomplete" 8 "Voltage abnormal" 7 "Fault" 6 "Communication error" 5 "Anti-pinch trigger" 4 "End" 3 "Instruction conflict" 2 "space not enough" 1 "Finish" 0 "invalid" ;
VAL_ 713 BDCM_PassengerSeatSoftPointSet_Rsp 1 "active" 0 "inactive" ;
VAL_ 713 BDCM_SCMSRLZeroGravityMotionSt_Rsp 3 "Invalid" 2 "Returning to initial position" 1 "Moving to target position" 0 "Stop" ;
VAL_ 713 BDCM_SCMSRRZeroGravityMotionSt_Rsp 3 "Invalid" 2 "Returning to initial position" 1 "Moving to target position" 0 "Stop" ;
VAL_ 698 BDCM_FLTpmsWheellPressure 255 "Invalid" ;
VAL_ 698 BDCM_FRTpmsWheellPressure 255 "Invalid" ;
VAL_ 698 BDCM_RLTpmsWheellPressure 255 "Invalid" ;
VAL_ 698 BDCM_RRTpmsWheellPressure 255 "Invalid" ;
VAL_ 698 BDCM_FLTpmsWheellPressureWarn_St 3 "Reserved" 2 "High pressure" 1 "Low pressure" 0 "Normal pressure" ;
VAL_ 698 BDCM_FRTpmsWheellPressureWarn_St 3 "Reserved" 2 "High pressure" 1 "Low pressure" 0 "Normal pressure" ;
VAL_ 698 BDCM_RLTpmsWheellPressureWarn_St 3 "Reserved" 2 "High pressure" 1 "Low pressure" 0 "Normal pressure" ;
VAL_ 698 BDCM_RRTpmsWheellPressureWarn_St 3 "Reserved" 2 "High pressure" 1 "Low pressure" 0 "Normal pressure" ;
VAL_ 698 BDCM_FLTpmsWheelTemp 255 "Invalid" ;
VAL_ 698 BDCM_FRTpmsWheelTemp 255 "Invalid" ;
VAL_ 698 BDCM_RLTpmsWheelTemp 255 "Invalid" ;
VAL_ 698 BDCM_RRTpmsWheelTemp 255 "Invalid" ;
VAL_ 698 BDCM_FLTpmsWheelTempWarn_St 1 "hight temperature" 0 "normal temperature" ;
VAL_ 698 BDCM_FRTpmsWheelTempWarn_St 1 "hight temperature" 0 "normal temperature" ;
VAL_ 698 BDCM_RLTpmsWheelTempWarn_St 1 "hight temperature" 0 "normal temperature" ;
VAL_ 698 BDCM_RRTpmsWheelTempWarn_St 1 "hight temperature" 0 "normal temperature" ;
VAL_ 698 BDCM_FLTpmsBattle_St 1 "Low voltage" 0 "Normal voltage" ;
VAL_ 698 BDCM_FRTpmsBattle_St 1 "Low voltage" 0 "Normal voltage" ;
VAL_ 698 BDCM_RLTpmsBattle_St 1 "Low voltage" 0 "Normal voltage" ;
VAL_ 698 BDCM_RRTpmsBattle_St 1 "Low voltage" 0 "Normal voltage" ;
VAL_ 698 BDCM_FLTpmsSensorFailure_St 1 "Failure" 0 "No failure" ;
VAL_ 698 BDCM_FRTpmsSensorFailure_St 1 "Failure" 0 "No failure" ;
VAL_ 698 BDCM_RLTpmsSensorFailure_St 1 "Failure" 0 "No failure" ;
VAL_ 698 BDCM_RRTpmsSensorFailure_St 1 "Failure" 0 "No failure" ;
VAL_ 698 BDCM_FLTpmsIDRegisterFailureWarn 1 "Failure" 0 "No failure" ;
VAL_ 698 BDCM_FRTpmsIDRegisterFailureWarn 1 "Failure" 0 "No failure" ;
VAL_ 698 BDCM_RLTpmsIDRegisterFailureWarn 1 "Failure" 0 "No failure" ;
VAL_ 698 BDCM_RRTpmsIDRegisterFailureWarn 1 "Failure" 0 "No failure" ;
VAL_ 698 BDCM_TpmsRFAntennaErr_Rsp 1 "Warning" 0 "No warning" ;
VAL_ 698 BDCM_FLTpmsRapidLeakWarn 1 "Warning" 0 "No warning" ;
VAL_ 698 BDCM_FRTpmsRapidLeakWarn 1 "Warning" 0 "No warning" ;
VAL_ 698 BDCM_RLTpmsRapidLeakWarn 1 "Warning" 0 "No warning" ;
VAL_ 698 BDCM_RRTpmsRapidLeakWarn 1 "Warning" 0 "No warning" ;
VAL_ 564 BDCM_DriverSetVehicleTimeGap 3 "Reserve" 2 "TimeGap3" 1 "TimeGap2" 0 "TimeGap1" ;
VAL_ 564 BDCM_SWS_L_HHPilot 3 "Error" 2 "Reserved" 1 "Press" 0 "No Press" ;
VAL_ 564 BDCM_SWS_L_Upslip_Cmd 7 "Error" 6 "Reserved" 5 "Reserved" 4 "Reserved" 3 "Reserved" 2 "Reserved" 1 "Slip" 0 "No slip" ;
VAL_ 564 BDCM_SWS_L_UpslipFast_Cmd 7 "Error" 6 "Reserved" 5 "Reserved" 4 "Reserved" 3 "Reserved" 2 "Reserved" 1 "Slip" 0 "No slip" ;
VAL_ 564 BDCM_SWS_L_Dwnslip_Cmd 7 "Error" 6 "Reserved" 5 "Reserved" 4 "Reserved" 3 "Reserved" 2 "Reserved" 1 "Slip" 0 "No slip" ;
VAL_ 564 BDCM_SWS_L_DownslipFast_Cmd 7 "Error" 6 "Reserved" 5 "Reserved" 4 "Reserved" 3 "Reserved" 2 "Reserved" 1 "Slip" 0 "No slip" ;
VAL_ 564 BDCM_SWS_L_Leftslip_Cmd 7 "Error" 6 "Reserved" 5 "Reserved" 4 "Reserved" 3 "Reserved" 2 "Reserved" 1 "Slip" 0 "No slip" ;
VAL_ 564 BDCM_SWS_L_LeftslipFast_Cmd 7 "Error" 6 "Reserved" 5 "Reserved" 4 "Reserved" 3 "Reserved" 2 "Reserved" 1 "Slip" 0 "No slip" ;
VAL_ 564 BDCM_SWS_L_RightSlip_Cmd 7 "Error" 6 "Reserved" 5 "Reserved" 4 "Reserved" 3 "Reserved" 2 "Reserved" 1 "Slip" 0 "No slip" ;
VAL_ 564 BDCM_SWS_L_RightslipFast_Cmd 7 "Error" 6 "Reserved" 5 "Reserved" 4 "Reserved" 3 "Reserved" 2 "Reserved" 1 "Slip" 0 "No slip" ;
VAL_ 564 BDCM_SWS_L_Doubleclick_Cmd 3 "Error" 2 "Reserved" 1 "Double click" 0 "No double click" ;
VAL_ 564 BDCM_SWS_L_zoomin_Cmd 3 "Error" 2 "Reserved" 1 "Active" 0 "Inactive" ;
VAL_ 564 BDCM_SWS_L_zoomout_Cmd 3 "Error" 2 "Reserved" 1 "Active" 0 "Inactive" ;
VAL_ 564 BDCM_SWS_L_Button_St 3 "Error" 2 "Reserved" 1 "Press" 0 "No Press" ;
VAL_ 564 BDCM_SWS_L_HHPilot_OnlyForIV2 3 "Error" 2 "Reserved" 1 "Press" 0 "No Press" ;
VAL_ 564 BDCM_SWS_L_PickSwitch 3 "Error" 2 "Reserved" 1 "Press" 0 "No Press" ;
VAL_ 564 SWS_L_TwofingerUpSlip_Cmd 7 "Error" 6 "Reserved" 5 "Reserved" 4 "Reserved" 3 "Reserved" 2 "Reserved" 1 "Slip" 0 "No slip" ;
VAL_ 564 SWS_L_TwofingerDownSlip_Cmd 7 "Error" 6 "Reserved" 5 "Reserved" 4 "Reserved" 3 "Reserved" 2 "Reserved" 1 "Slip" 0 "No slip" ;
VAL_ 564 SWS_L_TwofingerLeftSlip_Cmd 7 "Error" 6 "Reserved" 5 "Reserved" 4 "Reserved" 3 "Reserved" 2 "Reserved" 1 "Slip" 0 "No slip" ;
VAL_ 564 SWS_L_TwofingerRightSlip_Cmd 7 "Error" 6 "Reserved" 5 "Reserved" 4 "Reserved" 3 "Reserved" 2 "Reserved" 1 "Slip" 0 "No slip" ;
VAL_ 564 BDCM_SWS_L_ProtocolVersion 3 "Reserved" 2 "PPV" 1 "NCT" 0 "IV2" ;
VAL_ 564 BDCM_SWS_R_Upslip_Cmd 7 "Error" 6 "Reserved" 5 "Reserved" 4 "Reserved" 3 "Reserved" 2 "Reserved" 1 "Slip" 0 "No slip" ;
VAL_ 564 BDCM_SWS_R_UpslipFast_Cmd 7 "Error" 6 "Reserved" 5 "Reserved" 4 "Reserved" 3 "Reserved" 2 "Reserved" 1 "Slip" 0 "No slip" ;
VAL_ 564 BDCM_SWS_R_Dwnslip_Cmd 7 "Error" 6 "Reserved" 5 "Reserved" 4 "Reserved" 3 "Reserved" 2 "Reserved" 1 "Slip" 0 "No slip" ;
VAL_ 564 BDCM_SWS_R_DownslipFast_Cmd 7 "Error" 6 "Reserved" 5 "Reserved" 4 "Reserved" 3 "Reserved" 2 "Reserved" 1 "Slip" 0 "No slip" ;
VAL_ 564 BDCM_SWS_R_Leftslip_Cmd 7 "Error" 6 "Reserved" 5 "Reserved" 4 "Reserved" 3 "Reserved" 2 "Reserved" 1 "Slip" 0 "No slip" ;
VAL_ 564 BDCM_SWS_R_LeftslipFast_Cmd 7 "Error" 6 "Reserved" 5 "Reserved" 4 "Reserved" 3 "Reserved" 2 "Reserved" 1 "Slip" 0 "No slip" ;
VAL_ 564 BDCM_SWS_R_RightSlip_Cmd 7 "Error" 6 "Reserved" 5 "Reserved" 4 "Reserved" 3 "Reserved" 2 "Reserved" 1 "Slip" 0 "No slip" ;
VAL_ 564 BDCM_SWS_R_RightslipFast_Cmd 7 "Error" 6 "Reserved" 5 "Reserved" 4 "Reserved" 3 "Reserved" 2 "Reserved" 1 "Slip" 0 "No slip" ;
VAL_ 564 BDCM_SWS_R_Doubleclick_Cmd 3 "Error" 2 "Reserved" 1 "Double click" 0 "No double click" ;
VAL_ 564 BDCM_SWS_R_zoomin_Cmd 3 "Error" 2 "Reserved" 1 "Active" 0 "Inactive" ;
VAL_ 564 BDCM_SWS_R_zoomout_Cmd 3 "Error" 2 "Reserved" 1 "Active" 0 "Inactive" ;
VAL_ 564 BDCM_SWS_R_Button_St 3 "Error" 2 "Reserved" 1 "Press" 0 "No Press" ;
VAL_ 564 BDCM_SWS_R_Voice 3 "Error" 2 "Reserved" 1 "Press" 0 "No Press" ;
VAL_ 564 BDCM_SWS_R_PickSwitch 3 "Error" 2 "Reserved" 1 "Press" 0 "No Press" ;
VAL_ 564 SWS_R_TwofingerUpSlip_Cmd 7 "Error" 6 "Reserved" 5 "Reserved" 4 "Reserved" 3 "Reserved" 2 "Reserved" 1 "Slip" 0 "No slip" ;
VAL_ 564 SWS_R_TwofingerDownSlip_Cmd 7 "Error" 6 "Reserved" 5 "Reserved" 4 "Reserved" 3 "Reserved" 2 "Reserved" 1 "Slip" 0 "No slip" ;
VAL_ 564 SWS_R_TwofingerLeftSlip_Cmd 7 "Error" 6 "Reserved" 5 "Reserved" 4 "Reserved" 3 "Reserved" 2 "Reserved" 1 "Slip" 0 "No slip" ;
VAL_ 564 SWS_R_TwofingerRightSlip_Cmd 7 "Error" 6 "Reserved" 5 "Reserved" 4 "Reserved" 3 "Reserved" 2 "Reserved" 1 "Slip" 0 "No slip" ;
VAL_ 564 BDCM_SWHM_DrvSteeringWheelHeatTemp_Rsp 63 "Invalid" ;
VAL_ 564 BDCM_SWHM_DrvSteeringWheelHeatLevel_Rsp 7 "Invalid" 6 "Reserved" 5 "Reserved" 4 "Level3" 3 "Level2" 2 "Level1" 1 "OFF" 0 "No Request" ;
VAL_ 564 BDCM_SCAM_Err1 7 "invalid" 6 "Reserved" 5 "Reserved" 4 "Reserved" 3 "Tilt motor and Telescope motor error" 2 "Telescope motor error" 1 "Tilt motor error" 0 "No Error" ;
VAL_ 564 BDCM_SCAM_Err2 7 "invalid" 6 "Reserved" 5 "Reserved" 4 "Reserved" 3 "Power vol down and AN communication break" 2 "CAN communication break" 1 "Power vol down" 0 "No error" ;
VAL_ 743 DCM_FL_WindowPosition_Rsp 255 "Invalid" ;
VAL_ 743 DCM_FL_WindowAntiClamp_St 3 "reserved" 2 "reserved" 1 "anti~pinch" 0 "normal" ;
VAL_ 743 DCM_FL_TurnLampErr_St 7 "invalid" 6 "reserved" 5 "reserved" 4 "reserved" 3 "Light Module Error" 2 "Short to Ground" 1 "short to Battery /OpenLoad" 0 "no error" ;
VAL_ 743 DCM_FL_TurnLamp_St 3 "invalid" 2 "reserved" 1 "ON" 0 "OFF" ;
VAL_ 743 DCM_FL_WindowMoveStatus 3 "invalid" 2 "opening" 1 "closing" 0 "stop" ;
VAL_ 743 DCM_FL_BackMir_UpDwn_Position_Rsp 255 "Invalid" ;
VAL_ 743 DCM_FL_BackMir_LR_Position_Rsp 255 "Invalid" ;
VAL_ 743 BDCM_FD_RT_1_DCM_FL_Available_St 3 "Reserved" 2 "Reserved" 1 "Not available" 0 "Available" ;
VAL_ 743 BDCM_FD_RT_1_DCM_FR_Available_St 3 "Reserved" 2 "Reserved" 1 "Not available" 0 "Available" ;
VAL_ 743 DCM_FR_WindowPosition_Rsp 255 "Invalid" ;
VAL_ 743 DCM_FR_WindowAntiClamp_St 3 "reserved" 2 "reserved" 1 "anti~pinch" 0 "normal" ;
VAL_ 743 DCM_FR_TurnLampErr_St 7 "invalid" 6 "reserved" 5 "reserved" 4 "reserved" 3 "Light Module Error" 2 "Short to Ground" 1 "short to Battery /OpenLoad" 0 "no error" ;
VAL_ 743 DCM_FR_TurnLamp_St 3 "invalid" 2 "reserved" 1 "ON" 0 "OFF" ;
VAL_ 743 DCM_FR_WindowMoveStatus 3 "invalid" 2 "opening" 1 "closing" 0 "stop" ;
VAL_ 743 DCM_FR_BackMir_UpDwn_Position_Rsp 255 "Invalid" ;
VAL_ 743 DCM_FR_BackMir_LR_Position_Rsp 255 "Invalid" ;
VAL_ 743 BDCM_FD_RT_1_DCM_RL_Available_St 3 "Reserved" 2 "Reserved" 1 "Not available" 0 "Available" ;
VAL_ 743 BDCM_FD_RT_1_DCM_RR_Available_St 3 "Reserved" 2 "Reserved" 1 "Not available" 0 "Available" ;
VAL_ 743 DCM_RL_WindowPosition_Rsp 255 "Invalid" ;
VAL_ 743 DCM_RL_WindowAntiClamp_St 3 "invalid" 2 "reserved" 1 "anti~pinch" 0 "normal" ;
VAL_ 743 DCM_RL_WindowMoveStatus 3 "invalid" 2 "opening" 1 "closing" 0 "stop" ;
VAL_ 743 DCM_RR_WindowPosition_Rsp 255 "Invalid" ;
VAL_ 743 DCM_RR_WindowAntiClamp_St 3 "invalid" 2 "reserved" 1 "anti~pinch" 0 "normal" ;
VAL_ 743 PDM_FL_DoorOpenDegree_Rsp 255 "Invalid" ;
VAL_ 743 PDM_FL_DoorAntiClamp_St 3 "invalid" 2 "reserved" 1 "anti~pinchhappend" 0 "anti~pinchnothappend" ;
VAL_ 743 PDM_FL_DoorStopReazon 15 "invalid" 14 "Reserved" 13 "Reserved" 12 "Reserved" 11 "Reserved" 10 "Reserved" 9 "Reserved" 8 "Reserved" 7 "Reserved" 6 "Abuse" 5 "USS no communication" 4 "Load failure" 3 "avoid Obstacle happened" 2 "anti~pinch happend" 1 "move to expected position" 0 "init value" ;
VAL_ 743 PDM_FL_DoorObstacleAvoid_St 3 "invalid" 2 "reserved" 1 "avoidObstaclehappend" 0 "avoidObstaclenothappend" ;
VAL_ 743 PDM_FL_DoorobstacleDistance_Rsp 255 "Invalid" ;
VAL_ 743 PDM_FL_DoorWork_St 3 "invalid" 2 "opening" 1 "closing" 0 "stop" ;
VAL_ 743 BDCM_FD_RT_1_PDM_FL_Available_St 3 "Reserved" 2 "Reserved" 1 "Not available" 0 "Available" ;
VAL_ 743 BDCM_FD_RT_1_PDM_FR_Available_St 3 "Reserved" 2 "Reserved" 1 "Not available" 0 "Available" ;
VAL_ 743 PDM_FR_DoorOpenDegree_Rsp 255 "Invalid" ;
VAL_ 743 PDM_FR_DoorAntiClamp_St 3 "invalid" 2 "reserved" 1 "anti~pinchhappend" 0 "anti~pinchnothappend" ;
VAL_ 743 PDM_FR_DoorStopReazon 15 "invalid" 14 "Reserved" 13 "Reserved" 12 "Reserved" 11 "Reserved" 10 "Reserved" 9 "Reserved" 8 "Reserved" 7 "Reserved" 6 "Abuse" 5 "USS no communication" 4 "Load failure" 3 "avoid Obstacle happened" 2 "anti~pinch happend" 1 "move to expected position" 0 "init value" ;
VAL_ 743 PDM_FR_DoorObstacleAvoid_St 3 "invalid" 2 "reserved" 1 "avoidObstaclehappend" 0 "avoidObstaclenothappend" ;
VAL_ 743 PDM_FR_DoorobstacleDistance_Rsp 255 "Invalid" ;
VAL_ 743 PDM_FR_DoorWork_St 3 "invalid" 2 "opening" 1 "closing" 0 "stop" ;
