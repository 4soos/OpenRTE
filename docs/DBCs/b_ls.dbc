VERSION ""

NS_ :

BS_:

BU_: IDCM ARC ARHUD WHUD VSP FSE_M CGW

BO_ 889 IDCM_FD_1: 32 IDCM
 SG_ IDCM_BrightnessManualAdjust_OnlyForIV2 : 0|2@1+ (1,0) [0|3] ""  ARHUD,WHUD,CGW
 SG_ IDCM_AutoBrightnessSet : 2|2@1+ (1,0) [0|3] ""  ARC,ARHUD,WHUD,FSE_M,CGW
 SG_ IDCM_HUDPositionCtrl_OnlyForIV2 : 4|2@1+ (1,0) [0|3] ""  ARHUD,WHUD,CGW
 SG_ IDCM_HUDPowerCtrl : 6|2@1+ (1,0) [0|3] ""  ARC,ARHUD,WHUD,CGW
 SG_ IDCM_HUDFactoryReset : 8|2@1+ (1,0) [0|3] ""  ARC,ARHUD,WHUD,CGW
 SG_ IDCM_ARCPowerCtrl : 10|2@1+ (1,0) [0|3] ""  ARC,ARHUD,CGW
 SG_ IDCM_HUDSnowModeSet : 12|2@1+ (1,0) [0|3] ""  ARC,WHUD,CGW
 SG_ IDCM_DispUnitSet : 14|2@1+ (1,0) [0|3] ""  ARC,WHUD,FSE_M,CGW
 SG_ IDCM_LanguageSet : 16|2@1+ (1,0) [0|3] ""  ARC,WHUD,FSE_M,CGW
 SG_ IDCM_TextDispMode : 18|2@1+ (1,0) [0|3] ""  ARC,WHUD,FSE_M,CGW
 SG_ IDCM_ARCDispPageSet_OnlyForIV2 : 20|3@1+ (1,0) [0|7] ""  ARC,CGW
 SG_ IDCM_FD_1_Reserved5 : 23|1@1+ (1,0) [0|0] ""  CGW
 SG_ IDCM_ARCDispSet : 24|3@1+ (1,0) [0|7] ""  ARC,CGW
 SG_ IDCM_BrightnessManualAdjust : 27|5@1+ (1,0) [0|31] ""  ARHUD,WHUD,FSE_M,CGW
 SG_ IDCM_HUDPositionCtrl : 32|5@1+ (1,0) [0|31] ""  ARHUD,WHUD,CGW
 SG_ IDCM_FD_1_Reserved1 : 37|27@1+ (1,0) [0|0] ""  CGW
 SG_ IDCM_SpeedUnitDispSet : 64|2@1+ (1,0) [0|3] ""  ARC,WHUD,FSE_M,CGW
 SG_ IDCM_LanguageDispSet : 66|2@1+ (1,0) [0|3] ""  ARC,WHUD,FSE_M,CGW
 SG_ IDCM_HUDSpeedManageDispSet : 68|2@1+ (1,0) [0|3] ""  ARC,WHUD,CGW
 SG_ IDCM_HUDWarningDispSet : 70|2@1+ (1,0) [0|3] ""  ARC,WHUD,CGW
 SG_ IDCM_HUDSOCDispSet : 72|2@1+ (1,0) [0|3] ""  ARC,WHUD,CGW
 SG_ IDCM_LaneDepartureWarningDispSet : 74|2@1+ (1,0) [0|3] ""  ARC,WHUD,CGW
 SG_ IDCM_ForwardInformationDispSet : 76|2@1+ (1,0) [0|3] ""  ARC,WHUD,CGW
 SG_ IDCM_NavigationDispSet : 78|2@1+ (1,0) [0|3] ""  ARC,WHUD,CGW
 SG_ IDCM_VehicleInformationDispSet : 80|2@1+ (1,0) [0|3] ""  ARC,WHUD,CGW
 SG_ IDCM_PhoneInformationDispSet_OnlyForIV2 : 82|2@1+ (1,0) [0|3] ""  ARC,WHUD,CGW
 SG_ IDCM_TotalMileageDispSet : 84|2@1+ (1,0) [0|3] ""  ARC,WHUD,CGW
 SG_ IDCM_ARNavigationDisplaySet : 86|2@1+ (1,0) [0|3] ""  ARC,CGW
 SG_ IDCM_HUDARWarningDispSet : 88|2@1+ (1,0) [0|3] ""  ARC,CGW
 SG_ IDCM_FD_1_Reserved2 : 90|38@1+ (1,0) [0|0] ""  CGW
 SG_ IDCM_FD_1_Reserved3 : 128|64@1+ (1,0) [0|0] ""  CGW
 SG_ IDCM_FD_1_Reserved4 : 192|64@1+ (1,0) [0|0] ""  CGW

BO_ 894 IDCM_FD_6: 32 IDCM
 SG_ IDCM_PhoneTextLength_OnlyForIV2 : 0|8@1+ (1,0) [0|240] ""  ARC,WHUD
 SG_ IDCM_PhoneCallNumber_OnlyForIV2 : 8|64@1+ (1,0) [0|0] ""  ARC,WHUD
 SG_ IDCM_PhoneCallName_OnlyForIV2 : 72|40@1+ (1,0) [0|0] ""  ARC,WHUD
 SG_ IDCM_PhoneFrameIndex_OnlyForIV2 : 112|4@1+ (1,0) [1|15] ""  ARC,WHUD
 SG_ IDCM_PhoneCallType_OnlyForIV2 : 116|2@1+ (1,0) [0|3] ""  ARC,WHUD
 SG_ IDCM_PhoneCallWaitType_OnlyForIV2 : 118|1@1+ (1,0) [0|1] ""  ARC,WHUD
 SG_ IDCM_FD_6_Reserved1 : 119|9@1+ (1,0) [0|0] ""  Vector__XXX
 SG_ IDCM_FD_6_Reserved2 : 128|64@1+ (1,0) [0|0] ""  Vector__XXX
 SG_ IDCM_FD_6_Reserved3 : 192|64@1+ (1,0) [0|0] ""  Vector__XXX

BO_ 1016 ARC_FD_1: 32 ARC
 SG_ ARC_ONOFF_St : 0|1@1+ (1,0) [0|1] ""  IDCM,CGW
 SG_ ARC_HUDSnowMode_St : 1|1@1+ (1,0) [0|1] ""  IDCM,CGW
 SG_ ARC_DispUnit_St : 2|1@1+ (1,0) [0|1] ""  IDCM,CGW
 SG_ ARC_Language_St : 3|1@1+ (1,0) [0|1] ""  IDCM,CGW
 SG_ ARC_ARHUDPowerCtrl : 4|1@1+ (1,0) [0|1] ""  IDCM,ARHUD,CGW
 SG_ ARC_DispPage_St_OnlyForIV2 : 5|3@1+ (1,0) [0|7] ""  IDCM,CGW
 SG_ ARC_TextDispMode_St : 8|2@1+ (1,0) [0|3] ""  IDCM,CGW
 SG_ ARC_Disp_St : 10|3@1+ (1,0) [0|7] ""  IDCM,CGW
 SG_ ARC_SpeedUnitDisp_St : 64|1@1+ (1,0) [0|1] ""  IDCM,CGW
 SG_ ARC_LanguageDispSet_St : 65|1@1+ (1,0) [0|1] ""  IDCM,CGW
 SG_ ARC_SpeedManageDisp_St : 66|1@1+ (1,0) [0|1] ""  IDCM,CGW
 SG_ ARC_WarningDisp_St : 67|1@1+ (1,0) [0|1] ""  IDCM,CGW
 SG_ ARC_HUDSOCDisp_St : 68|1@1+ (1,0) [0|1] ""  IDCM,CGW
 SG_ ARC_LaneDepartureWarningDisp_St : 69|1@1+ (1,0) [0|1] ""  IDCM,CGW
 SG_ ARC_ForwardInformationDisp_St : 70|1@1+ (1,0) [0|1] ""  IDCM,CGW
 SG_ ARC_NavigationDisp_St : 71|1@1+ (1,0) [0|1] ""  IDCM,CGW
 SG_ ARC_VehicleInformationDisp_St : 72|1@1+ (1,0) [0|1] ""  IDCM,CGW
 SG_ ARC_PhoneInformationDisp_St : 73|1@1+ (1,0) [0|1] ""  IDCM,CGW
 SG_ ARC_TotalMileageDisp_St : 74|1@1+ (1,0) [0|1] ""  IDCM,CGW
 SG_ ARC_ARNavigationDisp_St : 75|1@1+ (1,0) [0|1] ""  IDCM,CGW
 SG_ ARC_ARWarningDisp_St : 76|1@1+ (1,0) [0|1] ""  IDCM,CGW
 SG_ ARC_ProtocolVersion : 78|2@1+ (1,0) [0|3] ""  IDCM,CGW

BO_ 1017 ARHUD_FD_1: 32 ARHUD
 SG_ ARHUD_ONOFF_St : 0|1@1+ (1,0) [0|1] ""  IDCM,ARC,CGW
 SG_ ARHUD_DispBrightness_OnlyForIV2 : 1|4@1+ (1,0) [0|15] ""  IDCM,ARC,CGW
 SG_ ARHUD_AutoBrightness_St : 5|1@1+ (1,0) [0|1] ""  IDCM,ARC,CGW
 SG_ ARHUD_DispPosition : 8|5@1+ (1,0) [0|31] ""  IDCM,ARC,CGW
 SG_ ARHUD_DispBrightness : 16|5@1+ (1,0) [0|31] ""  IDCM,ARC,CGW
 SG_ ARHUD_Warning : 21|3@1+ (1,0) [0|7] ""  IDCM,ARC,CGW
 SG_ ARHUD_ProtocolVersion : 25|2@1+ (1,0) [0|3] ""  IDCM,ARC,CGW

BO_ 1018 WHUD_FD_1: 32 WHUD
 SG_ WHUD_ONOFF_St : 0|1@1+ (1,0) [0|1] ""  IDCM,CGW
 SG_ WHUD_AutoBrightness_St : 1|1@1+ (1,0) [0|1] ""  IDCM,CGW
 SG_ WHUD_DispUnitSet_St : 2|1@1+ (1,0) [0|1] ""  IDCM,CGW
 SG_ WHUD_LanguageSet_St : 3|1@1+ (1,0) [0|1] ""  IDCM,CGW
 SG_ WHUD_DispBrightness_OnlyForIV2 : 4|4@1+ (1,0) [0|15] ""  IDCM,CGW
 SG_ WHUD_DispPosition : 8|5@1+ (1,0) [0|31] ""  IDCM,CGW
 SG_ WHUD_HUDSnowMode_st : 13|1@1+ (1,0) [0|1] ""  IDCM,CGW
 SG_ WHUD_TextDispMode_St : 14|2@1+ (1,0) [0|3] ""  IDCM,CGW
 SG_ WHUD_DispPage_St : 16|3@1+ (1,0) [0|7] ""  IDCM,CGW
 SG_ WHUD_DispBrightness : 19|5@1+ (1,0) [0|31] ""  IDCM,CGW
 SG_ WHUD_SpeedUnitDispSet_St : 64|1@1+ (1,0) [0|1] ""  IDCM,CGW
 SG_ WHUD_LanguageDispSet_St : 65|1@1+ (1,0) [0|1] ""  IDCM,CGW
 SG_ WHUD_SpeedManageDisp_St : 66|1@1+ (1,0) [0|1] ""  IDCM,CGW
 SG_ WHUD_WarningDisp_St : 67|1@1+ (1,0) [0|1] ""  IDCM,CGW
 SG_ WHUD_SOCDisp_St : 68|1@1+ (1,0) [0|1] ""  IDCM,CGW
 SG_ WHUD_LaneDepartureWarningDisp_St : 69|1@1+ (1,0) [0|1] ""  IDCM,CGW
 SG_ WHUD_ForwardInformationDisp_St : 70|1@1+ (1,0) [0|1] ""  IDCM,CGW
 SG_ WHUD_NavigationDisp_St : 71|1@1+ (1,0) [0|1] ""  IDCM,CGW
 SG_ WHUD_VehicleInformationDisp_St : 72|1@1+ (1,0) [0|1] ""  IDCM,CGW
 SG_ WHUD_PhoneInformationDisp_St : 73|1@1+ (1,0) [0|1] ""  IDCM,CGW
 SG_ WHUD_TotalMileageDisp_St : 74|1@1+ (1,0) [0|1] ""  IDCM,CGW
 SG_ WHUD_Warning : 75|3@1+ (1,0) [0|7] ""  IDCM,CGW
 SG_ WHUD_ProtocolVersion : 80|2@1+ (1,0) [0|3] ""  IDCM,CGW

BO_ 759 IDCM_FD_8: 32 IDCM
 SG_ IDCM_FLOutletUpDownAngle : 0|8@1+ (1,0) [0|40] "°"  CGW
 SG_ IDCM_FLOutletLeftRightAngle : 8|8@1+ (1,0) [0|60] "°"  CGW
 SG_ IDCM_LCOutletUpDownAngle : 16|8@1+ (1,0) [0|40] "°"  CGW
 SG_ IDCM_LCOutletLeftRightAngle : 24|8@1+ (1,0) [0|60] "°"  CGW
 SG_ IDCM_RCOutletUpDownAngle : 32|8@1+ (1,0) [0|40] "°"  CGW
 SG_ IDCM_RCOutletLeftRightAngle : 40|8@1+ (1,0) [0|60] "°"  CGW
 SG_ IDCM_PanelOutletUpDownAngle : 48|8@1+ (1,0) [0|40] "°"  CGW
 SG_ IDCM_PanelOutletLeftRightAngle : 56|8@1+ (1,0) [0|60] "°"  CGW
 SG_ IDCM_FROutletUpDownAngle : 64|8@1+ (1,0) [0|40] "°"  CGW
 SG_ IDCM_FROutletLeftRightAngle : 72|8@1+ (1,0) [0|60] "°"  CGW
 SG_ IDCM_FLOutletSwitch_Cmd : 80|2@1+ (1,0) [0|3] ""  CGW
 SG_ IDCM_LCOutletSwitch_Cmd : 82|2@1+ (1,0) [0|3] ""  CGW
 SG_ IDCM_PanelOutletSwitch_Cmd : 84|2@1+ (1,0) [0|3] ""  CGW
 SG_ IDCM_RCOutletSwitch_Cmd : 86|2@1+ (1,0) [0|3] ""  CGW
 SG_ IDCM_FROutletSwitch_Cmd : 88|2@1+ (1,0) [0|3] ""  CGW
 SG_ IDCM_AirOutletMode_Cmd : 90|3@1+ (1,0) [0|7] ""  CGW
 SG_ IDCM_FD_8_Reserved1 : 93|35@1+ (1,0) [0|0] ""  CGW
 SG_ IDCM_FD_8_Reserved2 : 128|64@1+ (1,0) [0|0] ""  CGW
 SG_ IDCM_FD_8_Reserved3 : 192|64@1+ (1,0) [0|0] ""  CGW

BO_ 756 IDCM_FD_9: 32 IDCM
 SG_ IDCM_FD_9_Reserved5 : 0|3@1+ (1,0) [0|0] ""  CGW
 SG_ IDCM_ChargeCtrl : 3|3@1+ (1,0) [0|7] ""  CGW
 SG_ IDCM_PowerSaveModeSet : 6|2@1+ (1,0) [0|3] ""  CGW
 SG_ IDCM_ChargeCutOffSet : 8|8@1+ (0.5,0) [0|100] "％"  CGW
 SG_ IDCM_DischargeSOCCutOffSet : 16|8@1+ (0.5,0) [0|100] "％"  CGW
 SG_ IDCM_CreepModeSet : 24|2@1+ (1,0) [0|3] ""  CGW
 SG_ IDCM_FD_9_Reserved6 : 26|3@1+ (1,0) [0|0] ""  CGW
 SG_ IDCM_HVOffConfirmFeedback : 29|1@1+ (1,0) [0|1] ""  CGW
 SG_ IDCM_MaintenanceModeSwitch : 30|2@1+ (1,0) [0|3] ""  CGW
 SG_ IDCM_CoastRegenStrengthSet : 32|8@1+ (0.5,0) [0|100] "％"  CGW
 SG_ IDCM_DischargeRangeCutOffSet : 40|10@1+ (1,0) [0|1000] "km"  CGW
 SG_ IDCM_LocalCharge_Req : 50|2@1+ (1,0) [0|3] ""  CGW
 SG_ IDCM_LocalDischarge_Req : 52|2@1+ (1,0) [0|3] ""  CGW
 SG_ IDCM_FD_9_Reserved7 : 54|10@1+ (1,0) [0|0] ""  CGW
 SG_ IDCM_FD_9_Checksum1 : 64|8@1+ (1,0) [0|255] ""  CGW
 SG_ IDCM_FD_9_RollingCounter1 : 72|4@1+ (1,0) [0|15] ""  CGW
 SG_ IDCM_PTModeChange_Cmd_OnlyForIV2 : 76|4@1+ (1,0) [0|15] ""  CGW
 SG_ IDCM_SoftsandModeEnable_OnlyForIV2 : 80|2@1+ (1,0) [0|3] ""  CGW
 SG_ IDCM_OffRoadModeEnable_OnlyForIV2 : 82|2@1+ (1,0) [0|3] ""  CGW
 SG_ IDCM_TargetVehicleMode_OnlyForIV2 : 84|4@1+ (1,0) [0|15] ""  CGW
 SG_ IDCM_WinterModeEnable_OnlyForIV2 : 88|2@1+ (1,0) [0|3] ""  CGW
 SG_ IDCM_EPSModeChange_Cmd_OnlyForIV2 : 90|3@1+ (1,0) [0|7] ""  CGW
 SG_ IDCM_AirSModeChange_Cmd_OnlyForIV2 : 93|3@1+ (1,0) [0|7] ""  CGW
 SG_ IDCM_SWSMode_OnlyForIV2 : 96|2@1+ (1,0) [0|3] ""  CGW
 SG_ IDCM_CDCModeChangeCmd_OnlyForIV2 : 98|3@1+ (1,0) [0|7] ""  CGW
 SG_ IDCM_ACModeChange_Cmd_OnlyForIV2 : 101|3@1+ (1,0) [0|7] ""  CGW
 SG_ IDCM_FD_9_Reserved2 : 104|24@1+ (1,0) [0|0] ""  CGW
 SG_ IDCM_ReservationChargeEnaable : 128|2@1+ (1,0) [0|3] ""  CGW
 SG_ IDCM_ReserveChargeTimeMin : 130|6@1+ (1,0) [0|59] "min"  CGW
 SG_ IDCM_ReserveChargeDurationSet : 136|16@1+ (1,0) [0|65534] "min"  CGW
 SG_ IDCM_ReserveChargeCutoffSOCSet : 152|8@1+ (0.5,0) [0|100] "％"  CGW
 SG_ IDCM_ReserveChargeTimeHour : 160|5@1+ (1,0) [0|23] "h"  CGW
 SG_ IDCM_Offroadmode_Req : 165|2@1+ (1,0) [0|3] ""  CGW
 SG_ IDCM_FD_9_Reserved1 : 167|1@1+ (1,0) [0|0] ""  CGW
 SG_ IDCM_TractionModeSetting : 168|2@1+ (1,0) [0|3] ""  CGW
 SG_ IDCM_ReserveChargeEndTimeMin : 170|6@1+ (1,0) [0|59] "min"  CGW
 SG_ IDCM_ReserveChargeEndTimeHour : 176|5@1+ (1,0) [0|23] "h"  CGW
 SG_ IDCM_Android_Ready : 181|2@1+ (1,0) [0|3] ""  CGW
 SG_ IDCM_ControllerFaultStatus : 183|1@1+ (1,0) [0|1] ""  CGW
 SG_ IDCM_FD_9_Reserved3 : 184|8@1+ (1,0) [0|0] ""  CGW
 SG_ IDCM_FD_9_Reserved4 : 192|64@1+ (1,0) [0|0] ""  CGW

BO_ 755 IDCM_FD_25: 32 IDCM
 SG_ IDCM_FD_25_Checksum1 : 0|8@1+ (1,0) [0|255] ""  CGW
 SG_ IDCM_FD_25_RollingCounter1 : 8|4@1+ (1,0) [0|15] ""  CGW
 SG_ IDCM_PTModeChange_Cmd : 12|4@1+ (1,0) [0|15] ""  CGW
 SG_ IDCM_SoftsandModeEnable : 16|2@1+ (1,0) [0|3] ""  CGW
 SG_ IDCM_OffRoadModeEnable : 18|2@1+ (1,0) [0|3] ""  CGW
 SG_ IDCM_TargetVehicleMode : 20|4@1+ (1,0) [0|15] ""  CGW
 SG_ IDCM_WinterModeEnable : 24|2@1+ (1,0) [0|3] ""  CGW
 SG_ IDCM_EPSModeChange_Cmd : 26|3@1+ (1,0) [0|7] ""  CGW
 SG_ IDCM_AirSModeChange_Cmd : 29|3@1+ (1,0) [0|7] ""  CGW
 SG_ IDCM_SWSMode : 32|2@1+ (1,0) [0|3] ""  CGW
 SG_ IDCM_CDCModeChangeCmd : 34|3@1+ (1,0) [0|7] ""  CGW
 SG_ IDCM_ACModeChange_Cmd : 37|3@1+ (1,0) [0|7] ""  CGW
 SG_ IDCM_FD_25_Reserved1 : 40|24@1+ (1,0) [0|0] ""  CGW
 SG_ IDCM_FD_25_Reserved2 : 64|64@1+ (1,0) [0|0] ""  CGW
 SG_ IDCM_FD_25_Reserved3 : 128|64@1+ (1,0) [0|0] ""  CGW
 SG_ IDCM_FD_25_Reserved4 : 192|64@1+ (1,0) [0|0] ""  CGW

BO_ 370 IDCM_FD_10: 32 IDCM
 SG_ IDCM_FD_10_Checksum1 : 0|8@1+ (1,0) [0|255] ""  CGW
 SG_ IDCM_FD_10_RollingCounter1 : 8|4@1+ (1,0) [0|15] ""  CGW
 SG_ IDCM_TCSSwitch : 12|2@1+ (1,0) [0|3] ""  CGW
 SG_ IDCM_AVHSwitch : 14|2@1+ (1,0) [0|3] ""  CGW
 SG_ IDCM_EBBrakeModeSet : 16|3@1+ (1,0) [0|7] ""  CGW
 SG_ IDCM_HDCSwitch : 19|2@1+ (1,0) [0|3] ""  CGW
 SG_ IDCM_FD_10_Reserved2 : 21|43@1+ (1,0) [0|0] ""  CGW
 SG_ IDCM_FD_10_Checksum2 : 64|8@1+ (1,0) [0|255] ""  CGW
 SG_ IDCM_FD_10_RollingCounter2 : 72|4@1+ (1,0) [0|15] ""  CGW
 SG_ IDCM_FD_10_Reserved3 : 76|4@1+ (1,0) [0|0] ""  CGW
 SG_ IDCM_PassengerAirbagSet_OnlyForIV2 : 80|1@1+ (1,0) [0|1] ""  CGW
 SG_ IDCM_PassengerAirbagSet : 81|2@1+ (1,0) [0|3] ""  CGW
 SG_ IDCM_FD_10_Reserved4 : 83|45@1+ (1,0) [0|0] ""  CGW
 SG_ IDCM_FD_10_Checksum3 : 128|8@1+ (1,0) [0|255] ""  CGW
 SG_ IDCM_FD_10_RollingCounter3 : 136|4@1+ (1,0) [0|15] ""  CGW
 SG_ IDCM_FD_10_Reserved5 : 140|4@1+ (1,0) [0|0] ""  CGW
 SG_ IDCM_LiftMode_Req : 144|2@1+ (1,0) [0|3] ""  CGW
 SG_ IDCM_EasyloadMode_Req : 146|2@1+ (1,0) [0|3] ""  CGW
 SG_ IDCM_VehicleSpeedDependentLevelSwitch_Req : 148|2@1+ (1,0) [0|3] ""  CGW
 SG_ IDCM_FD_10_Reserved6 : 150|40@1+ (1,0) [0|0] ""  CGW
 SG_ IDCM_FD_10_Reserved7 : 192|64@1+ (1,0) [0|0] ""  CGW

BO_ 371 IDCM_FD_11: 32 IDCM
 SG_ IDCM_DriverSideApproachOpenDoorSet : 0|2@1+ (1,0) [0|3] ""  CGW
 SG_ IDCM_PassengerSideApproachOpenDoorSet : 2|2@1+ (1,0) [0|3] ""  CGW
 SG_ IDCM_FD_11_Reserved10 : 4|2@1+ (1,0) [0|0] ""  CGW
 SG_ IDCM_ApprchUnLockSet_OnlyForIV2 : 6|2@1+ (1,0) [0|3] ""  CGW
 SG_ IDCM_WalkAwayLockCloseDoorSet : 8|2@1+ (1,0) [0|3] ""  CGW
 SG_ IDCM_UnLockModeSet : 10|4@1+ (1,0) [0|15] ""  CGW
 SG_ IDCM_FD_11_Reserved12 : 14|2@1+ (1,0) [0|0] ""  CGW
 SG_ IDCM_ApprchUnLockSet : 16|3@1+ (1,0) [0|7] ""  CGW
 SG_ IDCM_FD_11_Reserved1 : 19|7@1+ (1,0) [0|0] ""  CGW
 SG_ IDCM_RemoteLowPressureWarnSet : 26|2@1+ (1,0) [0|3] ""  CGW
 SG_ IDCM_RearDefrostCtrl_Cmd : 28|2@1+ (1,0) [0|3] ""  CGW
 SG_ IDCM_WelcomeModeSet : 30|2@1+ (1,0) [0|3] ""  CGW
 SG_ IDCM_FD_11_Reserved2 : 32|1@1+ (1,0) [0|0] ""  CGW
 SG_ IDCM_LightDelayCloseTimeSet : 33|3@1+ (1,0) [0|7] ""  CGW
 SG_ IDCM_TopLightModeSet : 36|2@1+ (1,0) [0|3] ""  CGW
 SG_ IDCM_TopLightSwitch : 38|2@1+ (1,0) [0|3] ""  CGW
 SG_ IDCM_BackLghtIntensityAdjust_Cmd : 40|8@1+ (1,0) [0|255] ""  FSE_M,CGW
 SG_ IDCM_AutoLightSet : 48|2@1+ (1,0) [0|3] ""  FSE_M,CGW
 SG_ IDCM_AutoLightSet_Vld : 50|1@1+ (1,0) [0|1] ""  FSE_M,CGW
 SG_ IDCM_RainAutoCloseWindowSet : 51|2@1+ (1,0) [0|3] ""  CGW
 SG_ IDCM_AutoHighBeam_Cmd : 53|2@1+ (1,0) [0|3] ""  CGW
 SG_ IDCM_FD_11_Reserved3 : 55|2@1+ (1,0) [0|0] ""  CGW
 SG_ IDCM_AVASEnable : 57|2@1+ (1,0) [0|3] ""  CGW
 SG_ IDCM_AVASSoundType : 59|3@1+ (1,0) [0|7] ""  CGW
 SG_ IDCM_HornModeSet : 62|2@1+ (1,0) [0|3] ""  CGW
 SG_ IDCM_BonusModeSet : 64|2@1+ (1,0) [0|3] ""  CGW
 SG_ IDCM_FLSeatAjustMode_OnlyForIV2 : 66|3@1+ (1,0) [0|7] ""  CGW
 SG_ IDCM_FRSeatAdjustMode_OnlyForIV2 : 69|3@1+ (1,0) [0|7] ""  CGW
 SG_ IDCM_FrdCanCvr : 72|2@1+ (1,0) [0|3] ""  CGW
 SG_ IDCM_Guard_Mode_Alarm : 74|2@1+ (1,0) [0|3] ""  CGW
 SG_ IDCM_BackMirrorAutoFoldSet : 76|2@1+ (1,0) [0|3] ""  CGW
 SG_ IDCM_BackMirrorAutoTurnOverSet : 78|2@1+ (1,0) [0|3] ""  CGW
 SG_ IDCM_BackMirrorAutoUnfoldSet : 80|2@1+ (1,0) [0|3] ""  CGW
 SG_ IDCM_SteerWheelHeat_Cmd : 82|3@1+ (1,0) [0|7] ""  CGW
 SG_ IDCM_FD_11_Reserved5 : 85|3@1+ (1,0) [0|0] ""  CGW
 SG_ IDCM_SteerWheelHeatTemp_Cmd : 88|6@1+ (0.5,20) [20|50] "℃"  CGW
 SG_ IDCM_FD_11_Reserved11 : 94|2@1+ (1,0) [0|0] ""  CGW
 SG_ IDCM_FD_11_Reserved6 : 96|32@1+ (1,0) [0|0] ""  CGW
 SG_ IDCM_FD_11_Checksum1 : 128|8@1+ (1,0) [0|255] ""  CGW
 SG_ IDCM_FD_11_RollingCounter1 : 136|4@1+ (1,0) [0|15] ""  CGW
 SG_ IDCM_FD_11_Reserved7 : 140|4@1+ (1,0) [0|0] ""  CGW
 SG_ IDCM_BDCMPowerCtrl_Cmd : 144|2@1+ (1,0) [0|3] ""  CGW
 SG_ IDCM_HoodLockCtrl_Cmd : 146|2@1+ (1,0) [0|3] ""  CGW
 SG_ IDCM_LockCtrl_Cmd : 148|2@1+ (1,0) [0|3] ""  CGW
 SG_ IDCM_ChargeCapCtrl_Cmd : 150|2@1+ (1,0) [0|3] ""  CGW
 SG_ IDCM_FrontWiperService_Cmd : 152|2@1+ (1,0) [0|3] ""  CGW
 SG_ IDCM_FrontWiperMode_Cmd : 154|2@1+ (1,0) [0|3] ""  CGW
 SG_ IDCM_SafetyLockSet_Req : 156|2@1+ (1,0) [0|3] ""  CGW
 SG_ IDCM_FD_11_Reserved8 : 158|34@1+ (1,0) [0|0] ""  CGW
 SG_ IDCM_FD_11_Reserved9 : 192|64@1+ (1,0) [0|0] ""  CGW

BO_ 494 IDCM_FD_12: 32 IDCM
 SG_ IDCM_FLFrontBackAdjust_Cmd_OnlyForIV2 : 0|2@1+ (1,0) [0|3] ""  CGW
 SG_ IDCM_FLSeatHeightAdjust_Cmd_OnlyForIV2 : 2|2@1+ (1,0) [0|3] ""  CGW
 SG_ IDCM_FLSeatBackCushionAdjust_Cmd_OnlyForIV2 : 4|2@1+ (1,0) [0|3] ""  CGW
 SG_ IDCM_FLSeatCushionAngleAdjust_Cmd_OnlyForIV2 : 6|2@1+ (1,0) [0|3] ""  CGW
 SG_ IDCM_FLSeatHeatGear_Cmd : 10|3@1+ (1,0) [0|7] ""  CGW
 SG_ IDCM_FLSeatVentilation_Cmd : 13|3@1+ (1,0) [0|7] ""  CGW
 SG_ IDCM_FLSeatFrontBackPosition_Cmd : 16|8@1+ (0.5,0) [0|100] "％"  CGW
 SG_ IDCM_FLSeatHeightPosition_Cmd : 24|8@1+ (0.5,0) [0|100] "％"  CGW
 SG_ IDCM_FLSeatBackCushionPosition_Cmd : 32|8@1+ (0.5,0) [0|100] "％"  CGW
 SG_ IDCM_FLSeatCushionAnglePosition_Cmd : 40|8@1+ (0.5,0) [0|100] "％"  CGW
 SG_ IDCM_FLSeatMassageMode_Cmd : 48|3@1+ (1,0) [0|7] ""  CGW
 SG_ IDCM_FLLumbarSupportFrontBackAdjust_Cmd : 52|2@1+ (1,0) [0|3] ""  CGW
 SG_ IDCM_FLLumbarSupportUpDownAdjust_Cmd : 54|2@1+ (1,0) [0|3] ""  CGW
 SG_ IDCM_FLSeatMassageStrength_Cmd : 56|3@1+ (1,0) [0|7] ""  CGW
 SG_ IDCM_FLSeatAjustMode : 59|3@1+ (1,0) [0|7] ""  CGW
 SG_ IDCM_FD_12_Reserved1 : 62|2@1+ (1,0) [0|0] ""  CGW
 SG_ IDCM_FRSeatFrontBackAdjust_Cmd : 64|2@1+ (1,0) [0|3] ""  CGW
 SG_ IDCM_FRSeatHeightAdjust_Cmd : 66|2@1+ (1,0) [0|3] ""  CGW
 SG_ IDCM_FRSeatBackCushionAdjust_Cmd : 68|2@1+ (1,0) [0|3] ""  CGW
 SG_ IDCM_FRSeatLegSupportAdjust_Cmd : 72|2@1+ (1,0) [0|3] ""  CGW
 SG_ IDCM_FRSeatHeatGear_Cmd : 74|3@1+ (1,0) [0|7] ""  CGW
 SG_ IDCM_FRSeatVentilation_Cmd : 77|3@1+ (1,0) [0|7] ""  CGW
 SG_ IDCM_FRSeatFrontBackPosition_Cmd : 80|8@1+ (0.5,0) [0|100] "％"  CGW
 SG_ IDCM_FRSeatBackCushionPosition_Cmd : 88|8@1+ (0.5,0) [0|100] "％"  CGW
 SG_ IDCM_FRSeatHeightPosition_Cmd : 96|8@1+ (0.5,0) [0|100] "％"  CGW
 SG_ IDCM_FRSeatLegSupportPosition_Cmd : 104|8@1+ (0.5,0) [0|100] "％"  CGW
 SG_ IDCM_FRLumbarSupportFrontBackAdjust_Cmd : 112|2@1+ (1,0) [0|3] ""  CGW
 SG_ IDCM_FRLumbarSupportUpDownAdjust_Cmd : 114|2@1+ (1,0) [0|3] ""  CGW
 SG_ IDCM_FRSeatMassageMode_Cmd : 116|3@1+ (1,0) [0|7] ""  CGW
 SG_ IDCM_FRSeatMassageStrength_Cmd : 120|3@1+ (1,0) [0|7] ""  CGW
 SG_ IDCM_FRSeatAdjustMode : 123|3@1+ (1,0) [0|7] ""  CGW
 SG_ IDCM_FD_12_Reserved2 : 126|2@1+ (1,0) [0|0] ""  CGW
 SG_ IDCM_DriverPositionMemoryID : 128|8@1+ (1,0) [0|254] ""  CGW
 SG_ IDCM_DriverPositionMemory_Cmd : 136|2@1+ (1,0) [0|3] ""  CGW
 SG_ IDCM_PassengerPositionMemory_Cmd : 138|2@1+ (1,0) [0|3] ""  CGW
 SG_ IDCM_DriverMemoryExportPosition : 140|4@1+ (1,0) [0|15] ""  CGW
 SG_ IDCM_PssengerMemoryExportPosition : 144|4@1+ (1,0) [0|15] ""  CGW
 SG_ IDCM_PassengerSeatSoftPointSet_Cmd : 148|2@1+ (1,0) [0|3] ""  CGW
 SG_ IDCM_FD_12_Reserved3 : 150|2@1+ (1,0) [0|0] ""  CGW
 SG_ IDCM_SCAMTiltPositionSet : 152|16@1+ (1,0) [32768|33290] "edge"  CGW
 SG_ IDCM_SCAMTelescopePositionSet : 168|16@1+ (1,0) [32768|33393] "edge"  CGW
 SG_ IDCM_FD_12_Checksum1 : 184|8@1+ (1,0) [0|255] ""  CGW
 SG_ IDCM_FD_12_RollingCounter1 : 192|4@1+ (1,0) [0|15] ""  CGW
 SG_ IDCM_FD_12_Reserved6 : 196|4@1+ (1,0) [0|0] ""  CGW
 SG_ IDCM_FLFrontBackAdjust_Cmd : 200|2@1+ (1,0) [0|3] ""  CGW
 SG_ IDCM_FLSeatHeightAdjust_Cmd : 202|2@1+ (1,0) [0|3] ""  CGW
 SG_ IDCM_FLSeatBackCushionAdjust_Cmd : 204|2@1+ (1,0) [0|3] ""  CGW
 SG_ IDCM_FLSeatCushionAngleAdjust_Cmd : 206|2@1+ (1,0) [0|3] ""  CGW
 SG_ IDCM_FD_12_Reserved4 : 208|16@1+ (1,0) [0|0] ""  CGW
 SG_ IDCM_FD_12_Reserved5 : 224|32@1+ (1,0) [0|0] ""  CGW

BO_ 495 IDCM_FD_13: 32 IDCM
 SG_ IDCM_SRLSeatFrontBackAdjust_Cmd : 0|2@1+ (1,0) [0|3] ""  CGW
 SG_ IDCM_SRLSeatBackCushionAdjust_Cmd : 2|2@1+ (1,0) [0|3] ""  CGW
 SG_ IDCM_SRLSeatLegSupportAdjust_Cmd : 4|2@1+ (1,0) [0|3] ""  CGW
 SG_ IDCM_SRLSeatLateralAdjust_Cmd : 6|2@1+ (1,0) [0|3] ""  CGW
 SG_ IDCM_SRLSeatHeatGear_Cmd : 8|3@1+ (1,0) [0|7] ""  CGW
 SG_ IDCM_SRLSeatVentilationGear_Cmd : 11|3@1+ (1,0) [0|7] ""  CGW
 SG_ IDCM_FD_13_Reserved4 : 14|2@1+ (1,0) [0|0] ""  CGW
 SG_ IDCM_SRLSeatMassageMode_Cmd : 16|3@1+ (1,0) [0|7] ""  CGW
 SG_ IDCM_SRLLumbarSupportFrontBackAdjust_Cmd : 20|2@1+ (1,0) [0|3] ""  CGW
 SG_ IDCM_SRLLumbarSupportUpDwnAdjust_Cmd : 22|2@1+ (1,0) [0|3] ""  CGW
 SG_ IDCM_SRLSeatFrontBackPosition_Cmd : 24|8@1+ (0.5,0) [0|100] "％"  CGW
 SG_ IDCM_SRLSeatSidePosition_Cmd : 32|8@1+ (0.5,0) [0|100] "％"  CGW
 SG_ IDCM_SRLSeatBackCushionPosition_Cmd : 40|8@1+ (0.5,0) [0|100] "％"  CGW
 SG_ IDCM_SRLSeatLegSupportPosition_Cmd : 56|8@1+ (0.5,0) [0|100] "％"  CGW
 SG_ IDCM_SRRSeatFrontBackAdjust_Cmd : 64|2@1+ (1,0) [0|3] ""  CGW
 SG_ IDCM_SRRSeatBackCushionAdjust_Cmd : 66|2@1+ (1,0) [0|3] ""  CGW
 SG_ IDCM_SRRSeatLegSupportAdjust_Cmd : 68|2@1+ (1,0) [0|3] ""  CGW
 SG_ IDCM_SRRSeatLateralAdjust_Cmd : 70|2@1+ (1,0) [0|3] ""  CGW
 SG_ IDCM_SRRSeatHeatGear_Cmd : 72|3@1+ (1,0) [0|7] ""  CGW
 SG_ IDCM_SRRSeatVentilation_Cmd : 75|3@1+ (1,0) [0|7] ""  CGW
 SG_ IDCM_FD_13_Reserved5 : 78|2@1+ (1,0) [0|0] ""  CGW
 SG_ IDCM_SRRSeatMassageMode_Cmd : 80|3@1+ (1,0) [0|7] ""  CGW
 SG_ IDCM_SRRLumbarSupportFrontBackAdjust_Cmd : 84|2@1+ (1,0) [0|3] ""  CGW
 SG_ IDCM_SRRLumbarSupportUpDownAdjust_Cmd : 86|2@1+ (1,0) [0|3] ""  CGW
 SG_ IDCM_SRRSeatFrontBackPosition_Cmd : 88|8@1+ (0.5,0) [0|100] "％"  CGW
 SG_ IDCM_SRRSeatSidePosition_Cmd : 96|8@1+ (0.5,0) [0|100] "％"  CGW
 SG_ IDCM_SRRSeatBackCushionPosition_Cmd : 104|8@1+ (0.5,0) [0|100] "％"  CGW
 SG_ IDCM_SRRSeatLegSupportPosition_Cmd : 120|8@1+ (0.5,0) [0|100] "％"  CGW
 SG_ IDCM_SRLZeroGravity_Cmd : 128|3@1+ (1,0) [0|7] ""  CGW
 SG_ IDCM_SRRZeroGravity_Cmd : 131|3@1+ (1,0) [0|7] ""  CGW
 SG_ IDCM_SRLEasyEntry_Cmd : 134|2@1+ (1,0) [0|3] ""  CGW
 SG_ IDCM_SRREasyEntry_Cmd : 136|2@1+ (1,0) [0|3] ""  CGW
 SG_ IDCM_FD_13_Reserved3 : 138|6@1+ (1,0) [0|0] ""  CGW
 SG_ IDCM_SRLSeatMassageStrength_Cmd : 144|3@1+ (1,0) [0|7] ""  CGW
 SG_ IDCM_SRRSeatMassageStrength_Cmd : 147|3@1+ (1,0) [0|7] ""  CGW
 SG_ IDCM_FD_13_Reserved1 : 150|42@1+ (1,0) [0|0] ""  CGW
 SG_ IDCM_FD_13_Reserved2 : 192|64@1+ (1,0) [0|0] ""  CGW

BO_ 374 IDCM_FD_14: 32 IDCM
 SG_ IDCM_FDoorOpenAngleSet : 0|8@1+ (0.5,0) [0|100] "％"  CGW
 SG_ IDCM_RDoorOpenAngleSet : 8|8@1+ (0.5,0) [0|100] "％"  CGW
 SG_ IDCM_NTOpenAngleSet : 16|8@1+ (0.5,0) [0|100] "％"  CGW
 SG_ IDCM_NTTourModOpenAngleSet : 32|8@1+ (0.5,0) [0|100] "％"  CGW
 SG_ IDCM_FLDoorOpenAngleCtrl_Cmd : 40|8@1+ (0.5,0) [0|100] "％"  CGW
 SG_ IDCM_FRDoorOpenAngleCtrl_Cmd : 48|8@1+ (0.5,0) [0|100] "％"  CGW
 SG_ IDCM_RLDoorOpenAngleCtrl_Cmd : 56|8@1+ (0.5,0) [0|100] "％"  CGW
 SG_ IDCM_RRDoorOpenAngleCtrl_Cmd : 64|8@1+ (0.5,0) [0|100] "％"  CGW
 SG_ IDCM_LNTOpenAngleCtrl_Cmd : 72|8@1+ (0.5,0) [0|100] "％"  CGW
 SG_ IDCM_RNTOpenAngleCtrl_Cmd : 80|8@1+ (0.5,0) [0|100] "％"  CGW
 SG_ IDCM_TailNormOpenAngleSet : 88|8@1+ (0.5,0) [0|100] "％"  CGW
 SG_ IDCM_TailGarageOpenAngleSet : 96|8@1+ (0.5,0) [0|100] "％"  CGW
 SG_ IDCM_FLDoorCtrl_Cmd_OnlyForIV2 : 104|2@1+ (1,0) [0|3] ""  CGW
 SG_ IDCM_FRDoorCtrl_Cmd_OnlyForIV2 : 106|2@1+ (1,0) [0|3] ""  CGW
 SG_ IDCM_RLDoorCtrl_Cmd_OnlyForIV2 : 108|2@1+ (1,0) [0|3] ""  CGW
 SG_ IDCM_RRDoorCtrl_Cmd_OnlyForIV2 : 110|2@1+ (1,0) [0|3] ""  CGW
 SG_ IDCM_LNTCtrl_Cmd_OnlyForIV2 : 112|2@1+ (1,0) [0|3] ""  CGW
 SG_ IDCM_RNTCtrl_Cmd_OnlyForIV2 : 114|2@1+ (1,0) [0|3] ""  CGW
 SG_ IDCM_NTModeSet : 118|2@1+ (1,0) [0|3] ""  CGW
 SG_ IDCM_FD_14_Reserved3 : 120|2@1+ (1,0) [0|0] ""  CGW
 SG_ IDCM_FDoorVariableRateSet : 122|3@1+ (1,0) [0|7] ""  CGW
 SG_ IDCM_RDoorVariableRateSet : 125|3@1+ (1,0) [0|7] ""  CGW
 SG_ IDCM_NTVariableRateSet : 128|3@1+ (1,0) [0|7] ""  CGW
 SG_ IDCM_TailgateCtrl_Cmd : 131|3@1+ (1,0) [0|7] ""  CGW
 SG_ IDCM_TailOpenModeSet : 134|2@1+ (1,0) [0|3] ""  CGW
 SG_ IDCM_TailgateFootOpenSet : 136|2@1+ (1,0) [0|3] ""  CGW
 SG_ IDCM_FD_14_Reserved4 : 138|6@1+ (1,0) [0|0] ""  CGW
 SG_ IDCM_FD_14_Checksum1 : 144|8@1+ (1,0) [0|255] ""  CGW
 SG_ IDCM_FD_14_RollingCounter1 : 152|4@1+ (1,0) [0|15] ""  CGW
 SG_ IDCM_FD_14_Reserved5 : 156|4@1+ (1,0) [0|0] ""  CGW
 SG_ IDCM_FLDoorCtrl_Cmd : 160|2@1+ (1,0) [0|3] ""  CGW
 SG_ IDCM_FRDoorCtrl_Cmd : 162|2@1+ (1,0) [0|3] ""  CGW
 SG_ IDCM_RLDoorCtrl_Cmd : 164|2@1+ (1,0) [0|3] ""  CGW
 SG_ IDCM_RRDoorCtrl_Cmd : 166|2@1+ (1,0) [0|3] ""  CGW
 SG_ IDCM_LNTCtrl_Cmd : 168|2@1+ (1,0) [0|3] ""  CGW
 SG_ IDCM_RNTCtrl_Cmd : 170|2@1+ (1,0) [0|3] ""  CGW
 SG_ IDCM_FD_14_Reserved1 : 172|36@1+ (1,0) [0|0] ""  CGW
 SG_ IDCM_FD_14_Reserved2 : 208|46@1+ (1,0) [0|0] ""  CGW

BO_ 375 IDCM_FD_15: 32 IDCM
 SG_ IDCM_FLWindowCtrl_Cmd : 0|3@1+ (1,0) [0|7] ""  CGW
 SG_ IDCM_FRWindowCtrl_Cmd : 3|3@1+ (1,0) [0|7] ""  CGW
 SG_ IDCM_RLWindowSwitchForbid : 6|2@1+ (1,0) [0|3] ""  CGW
 SG_ IDCM_RRWindowSwitchForbid : 8|2@1+ (1,0) [0|3] ""  CGW
 SG_ IDCM_RLWindowCtrl_Cmd : 10|3@1+ (1,0) [0|7] ""  CGW
 SG_ IDCM_RRWindowCtrl_Cmd : 13|3@1+ (1,0) [0|7] ""  CGW
 SG_ IDCM_FLWindowPosition_Cmd : 16|8@1+ (1,0) [0|100] "％"  CGW
 SG_ IDCM_FRWindowPosition_Cmd : 24|8@1+ (1,0) [0|100] "％"  CGW
 SG_ IDCM_RLWindowPosition_Cmd : 32|8@1+ (1,0) [0|100] "％"  CGW
 SG_ IDCM_RRWindowPosition_Cmd : 40|8@1+ (1,0) [0|100] "％"  CGW
 SG_ IDCM_FD_15_Reserved1 : 48|16@1+ (1,0) [0|0] ""  CGW
 SG_ IDCM_FD_15_Reserved3 : 64|64@1+ (1,0) [0|0] ""  CGW
 SG_ IDCM_FLBackMirrorUpDownPositionSet : 128|8@1+ (0.5,0) [0|100] "％"  CGW
 SG_ IDCM_FLBackMirrorLeftRightPositionSet : 136|8@1+ (0.5,0) [0|100] "％"  CGW
 SG_ IDCM_FRBackMirrorUpDownPositionSet : 144|8@1+ (0.5,0) [0|100] "％"  CGW
 SG_ IDCM_FRBackMirrorLeftRightPositionSet : 152|8@1+ (0.5,0) [0|100] "％"  CGW
 SG_ IDCM_ReverseFLBackMirrorUDPositionSet : 160|8@1+ (0.5,0) [0|100] "％"  CGW
 SG_ IDCM_ReverseFLBackMirrorLRPositionSet : 168|8@1+ (0.5,0) [0|100] "％"  CGW
 SG_ IDCM_ReverseFRBackMirrorUDPositionSet : 176|8@1+ (0.5,0) [0|100] "％"  CGW
 SG_ IDCM_ReverseFRBackMirrorLRPositionSet : 184|8@1+ (0.5,0) [0|100] "％"  CGW
 SG_ IDCM_FD_15_Reserved4 : 192|64@1+ (1,0) [0|0] ""  CGW

BO_ 376 IDCM_FD_16: 32 IDCM
 SG_ IDCM_LeftProjectAUpDownAdjust : 0|8@1+ (1,-128) [-127|127] ""  CGW
 SG_ IDCM_LeftProjectALeftRightAdjust : 8|8@1+ (1,-128) [-127|127] ""  CGW
 SG_ IDCM_LeftProjectBUpDownAdjust : 16|8@1+ (1,-128) [-127|127] ""  CGW
 SG_ IDCM_LeftProjectBLeftRightAdjust : 24|8@1+ (1,-128) [-127|127] ""  CGW
 SG_ IDCM_LeftProjectCUpDownAdjust : 32|8@1+ (1,-128) [-127|127] ""  CGW
 SG_ IDCM_LeftProjectCLeftRightAdjust : 40|8@1+ (1,-128) [-127|127] ""  CGW
 SG_ IDCM_LeftProjectDUpDownAdjust : 48|8@1+ (1,-128) [-127|127] ""  CGW
 SG_ IDCM_LeftProjectDLeftRightAdjust : 56|8@1+ (1,-128) [-127|127] ""  CGW
 SG_ IDCM_RightProjectAUpDownAdjust : 64|8@1+ (1,-128) [-127|127] ""  CGW
 SG_ IDCM_RightProjectALeftRightAdjust : 72|8@1+ (1,-128) [-127|127] ""  CGW
 SG_ IDCM_RightProjectBUpDownAdjust : 80|8@1+ (1,-128) [-127|127] ""  CGW
 SG_ IDCM_RightProjectBLeftRightAdjust : 88|8@1+ (1,-128) [-127|127] ""  CGW
 SG_ IDCM_RightProjectCUpDownAdjust : 96|8@1+ (1,-128) [-127|127] ""  CGW
 SG_ IDCM_RightProjectCLeftRightAdjust : 104|8@1+ (1,-128) [-127|127] ""  CGW
 SG_ IDCM_RightProjectDUpDownAdjust : 112|8@1+ (1,-128) [-127|127] ""  CGW
 SG_ IDCM_RightProjectDLeftRightAdjust : 120|8@1+ (1,-128) [-127|127] ""  CGW
 SG_ IDCM_SmartLightEnable : 128|2@1+ (1,0) [0|3] ""  CGW
 SG_ IDCM_LightPedestriansWarnFunctionEn : 130|2@1+ (1,0) [0|3] ""  CGW
 SG_ IDCM_ADBEnable : 132|2@1+ (1,0) [0|3] ""  CGW
 SG_ IDCM_LightFrontVehicleCollisionWarnEn : 134|2@1+ (1,0) [0|3] ""  CGW
 SG_ IDCM_LightLaneChangeWarnEn : 136|2@1+ (1,0) [0|3] ""  CGW
 SG_ IDCM_LightTurnWarnEn : 138|2@1+ (1,0) [0|3] ""  CGW
 SG_ IDCM_LightLaneDepartureWarnEn : 140|2@1+ (1,0) [0|3] ""  CGW
 SG_ IDCM_LightSpeedLimitWarnEn : 142|2@1+ (1,0) [0|3] ""  CGW
 SG_ IDCM_LightSmartNavigationPromptEn : 144|2@1+ (1,0) [0|3] ""  CGW
 SG_ IDCM_LightDrivingLinePromptEn : 146|2@1+ (1,0) [0|3] ""  CGW
 SG_ IDCM_LightVideoProjectPlayEn : 148|2@1+ (1,0) [0|3] ""  CGW
 SG_ IDCM_DrivingLinePromptButton : 150|2@1+ (1,0) [0|3] ""  CGW
 SG_ IDCM_ISDSmartNavigationPromptEn : 152|2@1+ (1,0) [0|3] ""  CGW
 SG_ IDCM_ISDSpeedLimitPromptEN : 154|2@1+ (1,0) [0|3] ""  CGW
 SG_ IDCM_ISDChargeCon_St : 156|2@1+ (1,0) [0|3] ""  CGW
 SG_ IDCM_FD_16_Reserved4 : 158|2@1+ (1,0) [0|0] ""  CGW
 SG_ IDCM_FD_16_Reserved1 : 160|6@1+ (1,0) [0|0] ""  CGW
 SG_ IDCM_LightSignatureProjectEnable : 166|2@1+ (1,0) [0|3] ""  CGW
 SG_ IDCM_LightAutomaticPiolotPromptEn : 168|2@1+ (1,0) [0|3] ""  CGW
 SG_ IDCM_PPrjctProjectLampSelect : 170|3@1+ (1,0) [0|7] ""  CGW
 SG_ IDCM_ProjectAreaSelect : 173|2@1+ (1,0) [0|3] ""  CGW
 SG_ IDCM_FD_16_Reserved2 : 175|3@1+ (1,0) [0|0] ""  CGW
 SG_ IDCM_ISDEnduranceMileagePromptEn : 178|2@1+ (1,0) [0|3] ""  CGW
 SG_ IDCM_ISDRearVehicleCollisionWarnEn : 180|2@1+ (1,0) [0|3] ""  CGW
 SG_ IDCM_ISDHighBeamOFFRemainderEn : 182|2@1+ (1,0) [0|3] ""  CGW
 SG_ IDCM_PedestrianFirstPromptButtonEn : 184|2@1+ (1,0) [0|3] ""  CGW
 SG_ IDCM_ISDLockStateRemainderEn : 186|2@1+ (1,0) [0|3] ""  CGW
 SG_ IDCM_ThanksButton : 188|2@1+ (1,0) [0|3] ""  CGW
 SG_ IDCM_ISDChangeDrivingModeEn : 190|2@1+ (1,0) [0|3] ""  CGW
 SG_ IDCM_ISDCustomersModeEn : 192|2@1+ (1,0) [0|3] ""  CGW
 SG_ IDCM_ISDCustomerEditEn : 194|2@1+ (1,0) [0|3] ""  CGW
 SG_ IDCM_ISDPedestrianFirstEn : 196|2@1+ (1,0) [0|3] ""  CGW
 SG_ IDCM_FCSremindwayset : 198|2@1+ (1,0) [0|3] ""  CGW
 SG_ IDCM_RCWremindwayset : 200|2@1+ (1,0) [0|3] ""  CGW
 SG_ IDCM_LKSremindwayset : 202|2@1+ (1,0) [0|3] ""  CGW
 SG_ IDCM_ISAremindwayset : 204|2@1+ (1,0) [0|3] ""  CGW
 SG_ IDCM_FD_16_Reserved3 : 206|50@1+ (1,0) [0|0] ""  CGW

BO_ 377 IDCM_FD_17: 32 IDCM
 SG_ IDCM_FD_17_Checksum1 : 0|8@1+ (1,0) [0|255] ""  CGW
 SG_ IDCM_FD_17_RollingCounter1 : 8|4@1+ (1,0) [0|15] ""  CGW
 SG_ IDCM_FD_17_Reserved1 : 12|4@1+ (1,0) [0|0] ""  CGW
 SG_ IDCM_HighBeam_Cmd : 16|2@1+ (1,0) [0|3] ""  CGW
 SG_ IDCM_HghBeam_Cmd_Vld : 18|1@1+ (1,0) [0|1] ""  CGW
 SG_ IDCM_LowBeam_Cmd : 19|2@1+ (1,0) [0|3] ""  CGW
 SG_ IDCM_LowBeam_Cmd_Vld : 21|1@1+ (1,0) [0|1] ""  CGW
 SG_ IDCM_PositionLight_Cmd : 22|2@1+ (1,0) [0|3] ""  CGW
 SG_ IDCM_PositionLight_Cmd_Vld : 24|1@1+ (1,0) [0|1] ""  CGW
 SG_ IDCM_RearFogLight_Cmd : 25|2@1+ (1,0) [0|3] ""  CGW
 SG_ IDCM_RearFogLight_Cmd_Vld : 27|1@1+ (1,0) [0|1] ""  CGW
 SG_ IDCM_HazrdWarnLamp_Cmd : 28|2@1+ (1,0) [0|3] ""  CGW
 SG_ IDCM_HazrdWarnLamp_Cmd_Vld : 30|1@1+ (1,0) [0|1] ""  CGW
 SG_ IDCM_FD_17_Reserved6 : 31|1@1+ (1,0) [0|0] ""  CGW
 SG_ IDCM_PositionLowBeamLightSet : 32|3@1+ (1,0) [0|7] ""  CGW
 SG_ IDCM_FD_17_Reserved2 : 35|29@1+ (1,0) [0|0] ""  CGW
 SG_ IDCM_SaveLightShowModeChoose : 64|4@1+ (1,0) [0|15] ""  CGW
 SG_ IDCM_PreviewSwitch : 68|2@1+ (1,0) [0|3] ""  CGW
 SG_ IDCM_SaveButton : 70|2@1+ (1,0) [0|3] ""  CGW
 SG_ IDCM_FestivalLightShowSet_Year : 72|8@1+ (1,1970) [1970|2100] "Year"  CGW
 SG_ IDCM_FestivalLightShowSet_Month : 80|4@1+ (1,0) [1|12] "Month"  CGW
 SG_ IDCM_PreviewLightShowModeChoose : 84|4@1+ (1,0) [0|15] ""  CGW
 SG_ IDCM_FestivalLightShowSet_Day : 88|6@1+ (1,0) [1|31] "Day"  CGW
 SG_ IDCM_LightShowEn : 94|2@1+ (1,0) [0|3] ""  CGW
 SG_ IDCM_LightShowEnSetChoose : 96|4@1+ (1,0) [0|15] ""  CGW
 SG_ IDCM_FestivalLightShowSet_Index : 100|4@1+ (1,0) [0|15] ""  CGW
 SG_ IDCM_FD_17_Reserved3 : 104|20@1+ (1,0) [0|0] ""  CGW
 SG_ IDCM_FD_17_Reserved4 : 128|64@1+ (1,0) [0|0] ""  CGW
 SG_ IDCM_FD_17_Reserved5 : 192|64@1+ (1,0) [0|0] ""  CGW

BO_ 753 IDCM_FD_18: 32 IDCM
 SG_ IDCM_VehicleTotalMileage : 0|24@1+ (0.1,0) [0|999999.9] "Km"  ARC,ARHUD,WHUD,VSP,CGW
 SG_ IDCM_FD_18_Reserved1 : 24|24@1+ (1,0) [0|0] ""  CGW
 SG_ IDCM_FD_18_Checksum1 : 48|8@1+ (1,0) [0|255] ""  CGW
 SG_ IDCM_FD_18_RollingCounter1 : 56|4@1+ (1,0) [0|15] ""  CGW
 SG_ IDCM_FD_18_Reserved6 : 60|4@1+ (1,0) [0|0] ""  CGW
 SG_ IDCM_SystemFailure : 64|1@1+ (1,0) [0|1] ""  FSE_M,CGW
 SG_ IDCM_DisplayError : 65|1@1+ (1,0) [0|1] ""  ARC,ARHUD,WHUD,CGW
 SG_ IDCM_LowConsumMode_OnlyForIV2 : 66|2@1+ (1,0) [0|3] ""  ARC,ARHUD,WHUD,VSP,CGW
 SG_ IDCM_ValetMode_St : 68|2@1+ (1,0) [0|3] ""  CGW
 SG_ IDCM_InstrumentLeftSidePage : 70|2@1+ (1,0) [0|3] ""  CGW
 SG_ IDCM_LowConsumMode : 72|2@1+ (1,0) [0|3] ""  ARC,ARHUD,WHUD,VSP,CGW
 SG_ IDCM_FD_18_Reserved7 : 74|2@1+ (1,0) [0|0] ""  CGW
 SG_ IDCM_LowVolt_Keep_Req : 76|2@1+ (1,0) [0|3] ""  CGW
 SG_ IDCM_CampingMode_Req : 78|2@1+ (1,0) [0|3] ""  CGW
 SG_ IDCM_MaxSpeedLimit_Cmd : 80|8@1+ (1,0) [0|254] "km/h"  CGW
 SG_ IDCM_EverydayEnergyConsume : 88|20@1+ (1,0) [0|1048574] "wh"  CGW
 SG_ IDCM_ECall_Request : 108|2@1+ (1,0) [0|3] ""  CGW
 SG_ IDCM_BCall_Request : 110|2@1+ (1,0) [0|3] ""  CGW
 SG_ IDCM_CampingModeSOC_Set : 112|10@1+ (0.1,0) [0|100] "%"  CGW
 SG_ IDCM_ProtocolVersion : 122|2@1+ (1,0) [0|3] ""  ARC,ARHUD,WHUD,VSP,CGW
 SG_ IDCM_FD_18_Reserved2 : 124|4@1+ (1,0) [0|0] ""  CGW
 SG_ IDCM_FD_18_Checksum2 : 128|8@1+ (1,0) [0|255] ""  CGW
 SG_ IDCM_FD_18_RollingCounter2 : 136|4@1+ (1,0) [0|15] ""  CGW
 SG_ IDCM_FD_18_Reserved5 : 140|4@1+ (1,0) [0|0] ""  CGW
 SG_ IDCM_V2X_Enable : 144|2@1+ (1,0) [0|3] ""  CGW
 SG_ IDCM_FD_18_Reserved3 : 146|46@1+ (1,0) [0|0] ""  CGW
 SG_ IDCM_FD_18_Reserved4 : 192|64@1+ (1,0) [0|0] ""  CGW

BO_ 881 IDCM_FD_19: 32 IDCM
 SG_ IDCM_FD_19_Checksum1 : 0|8@1+ (1,0) [0|255] ""  ARC,WHUD,CGW
 SG_ IDCM_FD_19_RollingCounter1 : 8|4@1+ (1,0) [0|15] ""  ARC,WHUD,CGW
 SG_ IDCM_FD_19_Reserved1 : 12|4@1+ (1,0) [0|0] ""  ARC,WHUD,CGW
 SG_ IDCM_IFCISDRestDistance : 16|12@1+ (0.1,0) [0.1|70] "km"  CGW
 SG_ IDCM_IFCRoadType : 28|4@1+ (1,0) [0|15] ""  ARC,WHUD,CGW
 SG_ IDCM_IFCSpeedLimtType : 32|4@1+ (1,0) [0|15] ""  CGW
 SG_ IDCM_IFCSpeedLimitUnit : 36|2@1+ (1,0) [0|3] ""  CGW
 SG_ IDCM_IFCNavigationSt : 38|2@1+ (1,0) [0|3] ""  ARC,WHUD,CGW
 SG_ IDCM_IFCSLCAheadDistance : 40|13@1+ (1,0) [1|6000] "m"  ARC,WHUD,CGW
 SG_ IDCM_IFCZoneCode : 53|3@1+ (1,0) [0|7] ""  CGW
 SG_ IDCM_FD_19_Reserved2 : 56|8@1+ (1,0) [0|0] ""  CGW
 SG_ IDCM_FD_19_Checksum2 : 64|8@1+ (1,0) [0|255] ""  CGW
 SG_ IDCM_FD_19_RollingCounter2 : 72|4@1+ (1,0) [0|15] ""  CGW
 SG_ IDCM_FD_19_Reserved3 : 76|4@1+ (1,0) [0|0] ""  CGW
 SG_ IDCM_FCSSwitch : 80|2@1+ (1,0) [0|3] ""  CGW
 SG_ IDCM_LKSSwitch : 82|2@1+ (1,0) [0|3] ""  CGW
 SG_ IDCM_LKSSensitivity : 84|2@1+ (1,0) [0|3] ""  CGW
 SG_ IDCM_ELKSwitch : 86|2@1+ (1,0) [0|3] ""  CGW
 SG_ IDCM_HWAILC_Switch : 88|2@1+ (1,0) [0|3] ""  CGW
 SG_ IDCM_ISASwitch : 90|2@1+ (1,0) [0|3] ""  CGW
 SG_ IDCM_AHBSwitch : 92|2@1+ (1,0) [0|3] ""  CGW
 SG_ IDCM_LCASwitch : 94|2@1+ (1,0) [0|3] ""  CGW
 SG_ IDCM_DOWSwitch : 96|2@1+ (1,0) [0|3] ""  CGW
 SG_ IDCM_RCTASwitch : 98|2@1+ (1,0) [0|3] ""  CGW
 SG_ IDCM_RCWSwitch : 100|2@1+ (1,0) [0|3] ""  CGW
 SG_ IDCM_FCTASwitch : 102|2@1+ (1,0) [0|3] ""  CGW
 SG_ IDCM_LKSType : 104|2@1+ (1,0) [0|3] ""  CGW
 SG_ IDCM_ISA_WarningOffset : 106|3@1+ (1,0) [0|7] ""  CGW
 SG_ IDCM_ValetMode_AccDisable_Cmd : 109|2@1+ (1,0) [0|3] ""  CGW
 SG_ IDCM_FD_19_Reserved4 : 111|17@1+ (1,0) [0|0] ""  CGW
 SG_ IDCM_FD_19_Reserved5 : 128|64@1+ (1,0) [0|0] ""  CGW
 SG_ IDCM_FD_19_Reserved6 : 192|64@1+ (1,0) [0|0] ""  CGW

CM_ " ";

CM_ BO_ 889 "ARCHUD控制、设置";
CM_ BO_ 894 "HUD显示电话信息";
CM_ BO_ 1016 "ARC设置反馈";
CM_ BO_ 1017 "ARHUD状态";
CM_ BO_ 1018 "WHUD状态反馈";
CM_ BO_ 759 "OLM设置";
CM_ BO_ 756 "PT设置";
CM_ BO_ 755 "PT设置";
CM_ BO_ 370 "发给CH设置";
CM_ BO_ 371 "发给BD设置";
CM_ BO_ 494 "主副驾座椅控制&记忆调出";
CM_ BO_ 495 "二排左右座椅控制";
CM_ BO_ 374 "门控制";
CM_ BO_ 375 "窗控制&后视镜控制";
CM_ BO_ 376 "发给DLP设置";
CM_ BO_ 377 "DLP命令";
CM_ BO_ 753 "总里程&IDCM故障信息";
CM_ BO_ 881 "ADCM设置";
CM_ SG_ 889 IDCM_BrightnessManualAdjust_OnlyForIV2 "IDCM Brightness Manual Adjust
亮度手动调节";
CM_ SG_ 889 IDCM_AutoBrightnessSet "Auto Brightness Set
亮度自适应ON/OFF设定";
CM_ SG_ 889 IDCM_HUDPositionCtrl_OnlyForIV2 "HUD Position Control
主镜面旋转位置控制，向上或向下";
CM_ SG_ 889 IDCM_HUDPowerCtrl "HUD Power Control
HUD电源控制";
CM_ SG_ 889 IDCM_HUDFactoryReset "HUD Factory REset 
HUD恢复出厂";
CM_ SG_ 889 IDCM_ARCPowerCtrl "ARC Power Contro
ARC电源控制";
CM_ SG_ 889 IDCM_HUDSnowModeSet "HUD Snow Mode Set
雪地模式设置";
CM_ SG_ 889 IDCM_DispUnitSet "DIsplay Unit Set
显示单位设置";
CM_ SG_ 889 IDCM_LanguageSet "Language Set
语言设置";
CM_ SG_ 889 IDCM_TextDispMode "Text Display Mode
文字显示方式设置";
CM_ SG_ 889 IDCM_ARCDispPageSet_OnlyForIV2 "ARC Display Page Set
ARC显示页面设定";
CM_ SG_ 889 IDCM_FD_1_Reserved5 "Reserved for future extensions
信号扩展预留位";
CM_ SG_ 889 IDCM_ARCDispSet "ARC Display Set
ARC显示设定";
CM_ SG_ 889 IDCM_BrightnessManualAdjust "IDCM Brightness Manual Adjust
亮度手动调节";
CM_ SG_ 889 IDCM_HUDPositionCtrl "HUD Position Control
主镜面旋转位置控制";
CM_ SG_ 889 IDCM_FD_1_Reserved1 "Reserved for future extensions
信号扩展预留位";
CM_ SG_ 889 IDCM_SpeedUnitDispSet "Speed Unit Disp Set
速度单位显示设置";
CM_ SG_ 889 IDCM_LanguageDispSet "Language Disp Set
语言显示设置";
CM_ SG_ 889 IDCM_HUDSpeedManageDispSet "HUD Speed Manage Disp Set
HUD速度管理显示设置";
CM_ SG_ 889 IDCM_HUDWarningDispSet "HUD Warning Disp Set
Warning显示设置";
CM_ SG_ 889 IDCM_HUDSOCDispSet "HUD SOC Disp Set
电量约束显示设置";
CM_ SG_ 889 IDCM_LaneDepartureWarningDispSet "Lane Departure Warning Display Set
车道偏离显示设置";
CM_ SG_ 889 IDCM_ForwardInformationDispSet "Forward Information Display Set
前方安全侦测显示设置";
CM_ SG_ 889 IDCM_NavigationDispSet "Navigation Display Set
导航指引显示设置";
CM_ SG_ 889 IDCM_VehicleInformationDispSet "Vehicle Information Display Set
车辆信息显示设置";
CM_ SG_ 889 IDCM_PhoneInformationDispSet_OnlyForIV2 "Phone Information Display Set
电话信息显示设置";
CM_ SG_ 889 IDCM_TotalMileageDispSet "Total Mileage Display Set
行驶里程显示设置";
CM_ SG_ 889 IDCM_ARNavigationDisplaySet "AR Navigation Display Set
AR导航指引显示设置";
CM_ SG_ 889 IDCM_HUDARWarningDispSet "HUD AR Warning Display Set
AR预警显示设置";
CM_ SG_ 889 IDCM_FD_1_Reserved2 "Reserved for future extensions
信号扩展预留位";
CM_ SG_ 889 IDCM_FD_1_Reserved3 "Reserved for future extensions
信号扩展预留位";
CM_ SG_ 889 IDCM_FD_1_Reserved4 "Reserved for future extensions
信号扩展预留位";
CM_ SG_ 894 IDCM_PhoneTextLength_OnlyForIV2 "Bluetooth Phone Text Length
蓝牙电话文本数据总字节数";
CM_ SG_ 894 IDCM_PhoneCallNumber_OnlyForIV2 "Phone Call Number
蓝牙电话号码";
CM_ SG_ 894 IDCM_PhoneCallName_OnlyForIV2 "Phone Call Name
蓝牙电话人名";
CM_ SG_ 894 IDCM_PhoneFrameIndex_OnlyForIV2 "Phone Frame Index
蓝牙电话帧序号";
CM_ SG_ 894 IDCM_PhoneCallType_OnlyForIV2 "Phone Call Type
蓝牙电话通话类型";
CM_ SG_ 894 IDCM_PhoneCallWaitType_OnlyForIV2 "Phone Call Wait Type
蓝牙电话呼叫等待提示";
CM_ SG_ 894 IDCM_FD_6_Reserved1 "Reserved for future extensions
信号扩展预留位";
CM_ SG_ 894 IDCM_FD_6_Reserved2 "Reserved for future extensions
信号扩展预留位";
CM_ SG_ 894 IDCM_FD_6_Reserved3 "Reserved for future extensions
信号扩展预留位";
CM_ SG_ 759 IDCM_FLOutletUpDownAngle "Front Left Outlet Up Down Rotate Angle
左前出风口扇叶上下转动角度";
CM_ SG_ 759 IDCM_FLOutletLeftRightAngle "Front Left OutletLeft Right Rotate Angle
左前出风口扇叶左右转动角度";
CM_ SG_ 759 IDCM_LCOutletUpDownAngle "Left Center Outlet Up Down Rotate Angle
左中出风口扇叶上下转动角度";
CM_ SG_ 759 IDCM_LCOutletLeftRightAngle "Left Center OutletLeft Right Rotate Angle
左中出风口扇叶左右转动角度";
CM_ SG_ 759 IDCM_RCOutletUpDownAngle "Right Center Outlet Up Down Rotate Angle
右中出风口扇叶上下转动角度";
CM_ SG_ 759 IDCM_RCOutletLeftRightAngle "Right Center OutletLeft Right Rotate Angle
右中出风口扇叶左右转动角度";
CM_ SG_ 759 IDCM_PanelOutletUpDownAngle "Panel Outlet Up Down Rotate Angle
仪表盘出风口扇叶上下转动角度";
CM_ SG_ 759 IDCM_PanelOutletLeftRightAngle "Panel OutletLeft Right Rotate Angle
仪表盘出风口扇叶左右转动角度";
CM_ SG_ 759 IDCM_FROutletUpDownAngle "Front Right Outlet Up Down Rotate Angle
右前出风口扇叶上下转动角度";
CM_ SG_ 759 IDCM_FROutletLeftRightAngle "Front Right OutletLeft Right Rotate Angle
右前出风口扇叶左右转动角度";
CM_ SG_ 759 IDCM_FLOutletSwitch_Cmd "Front Left Outlet Module Switch Command
左前出风口风门开关命令";
CM_ SG_ 759 IDCM_LCOutletSwitch_Cmd "Left Center Outlet Module Switch Command
左中出风口风门开关命令";
CM_ SG_ 759 IDCM_PanelOutletSwitch_Cmd "Panel Outlet Module Switch Command
仪表盘出风口风门开关命令";
CM_ SG_ 759 IDCM_RCOutletSwitch_Cmd "Right Center Outlet Module Switch Command
右中出风口风门开关命令";
CM_ SG_ 759 IDCM_FROutletSwitch_Cmd "Front Right Outlet Module Switch Command
右前出风口风门开关命令";
CM_ SG_ 759 IDCM_AirOutletMode_Cmd "Air Outlet Mode Command
吹风模式命令";
CM_ SG_ 759 IDCM_FD_8_Reserved1 "Reserved for future extensions
信号扩展预留位";
CM_ SG_ 759 IDCM_FD_8_Reserved2 "Reserved for future extensions
信号扩展预留位";
CM_ SG_ 759 IDCM_FD_8_Reserved3 "Reserved for future extensions
信号扩展预留位";
CM_ SG_ 756 IDCM_FD_9_Reserved5 "Reserved for future extensions
信号扩展预留位";
CM_ SG_ 756 IDCM_ChargeCtrl "ChargeControlRequest
充电开关";
CM_ SG_ 756 IDCM_PowerSaveModeSet "PowerSaveModeSet
节电模式设置";
CM_ SG_ 756 IDCM_ChargeCutOffSet "ChargeCut-OffSet
充电截止设置";
CM_ SG_ 756 IDCM_DischargeSOCCutOffSet "Discharge SOC Cut Off Set
放电截止SOC设置";
CM_ SG_ 756 IDCM_CreepModeSet "CreepModeSet
creep设置";
CM_ SG_ 756 IDCM_FD_9_Reserved6 "Reserved for future extensions
信号扩展预留位";
CM_ SG_ 756 IDCM_HVOffConfirmFeedback "High Voltage Off Confirm Feedback
紧急开关下电确认反馈";
CM_ SG_ 756 IDCM_MaintenanceModeSwitch "Maintenance Mode Switch
维修模式开关";
CM_ SG_ 756 IDCM_CoastRegenStrengthSet "Coast Regen Strength Set
滑行能量回收强度";
CM_ SG_ 756 IDCM_DischargeRangeCutOffSet "Discharge Range Cut Off Set
放电截止里程设置";
CM_ SG_ 756 IDCM_LocalCharge_Req "Local Charge Request
本地充电请求";
CM_ SG_ 756 IDCM_LocalDischarge_Req "Local Discharge Request
本地用户放电请求";
CM_ SG_ 756 IDCM_FD_9_Reserved7 "Reserved for future extensions
信号扩展预留位";
CM_ SG_ 756 IDCM_FD_9_Checksum1 "E2E Signal Group Checksum
Checksum is the actual value after calculation. See the 'ChecksumAlgorithm' sheet for the specific algorithm.
E2E信号组校验和
Checksum为计算后实际值，具体算法参见“ChecksumAlgorithm”页";
CM_ SG_ 756 IDCM_FD_9_RollingCounter1 "E2E Signal Group Counter
Counter value is automatically accumulated, added from 0 to 14 and then looped to the initial value of 0. Every time a message is sent, counter adds 1.
E2E信号组计数器
Counter值为自动累加，从0加到14，然后循环至初始值0，每次报文发送，Counter加1";
CM_ SG_ 756 IDCM_PTModeChange_Cmd_OnlyForIV2 "Exclusive-PT Mode Change Command
专属-PT目标模式";
CM_ SG_ 756 IDCM_SoftsandModeEnable_OnlyForIV2 "Softsand Mode Enable
Softsand模式使能";
CM_ SG_ 756 IDCM_OffRoadModeEnable_OnlyForIV2 "OffRoad Mode Enable
Off-road模式使能";
CM_ SG_ 756 IDCM_TargetVehicleMode_OnlyForIV2 "Target Vehicle Mode
整车目标模式";
CM_ SG_ 756 IDCM_WinterModeEnable_OnlyForIV2 "Winter Mode Enable
Winter模式使能";
CM_ SG_ 756 IDCM_EPSModeChange_Cmd_OnlyForIV2 "Exclusive-EPS Mode Change COmmand
专属-EPS目标模式";
CM_ SG_ 756 IDCM_AirSModeChange_Cmd_OnlyForIV2 "Exclusive-AirS Mode Change Command
专属-AirS目标模式";
CM_ SG_ 756 IDCM_SWSMode_OnlyForIV2 "SWS Mode
多功能开关模式";
CM_ SG_ 756 IDCM_CDCModeChangeCmd_OnlyForIV2 "Exclusive-CDC Mode Change Command
专属-CDC目标模式";
CM_ SG_ 756 IDCM_ACModeChange_Cmd_OnlyForIV2 "Exclusive-AC Change Command
专属-AC目标模式";
CM_ SG_ 756 IDCM_FD_9_Reserved2 "Reserved for future extensions
信号扩展预留位";
CM_ SG_ 756 IDCM_ReservationChargeEnaable "IDCM_ReservationChargeEnable
大屏预约充电使能";
CM_ SG_ 756 IDCM_ReserveChargeTimeMin "Reservation Charging Time-Minute
大屏预约充电起始时间-分钟";
CM_ SG_ 756 IDCM_ReserveChargeDurationSet "Reservation Charging Duration Set
大屏预约充电时长";
CM_ SG_ 756 IDCM_ReserveChargeCutoffSOCSet "Reservation Charging Cut-off SOCSet
大屏预约充电截止SOC";
CM_ SG_ 756 IDCM_ReserveChargeTimeHour "Reservation Charging Time-Hour
大屏预约充电起始时间-小时";
CM_ SG_ 756 IDCM_Offroadmode_Req "IDCM Offroad Mode Request
IDCM发送OffRoad模式请求标志位";
CM_ SG_ 756 IDCM_FD_9_Reserved1 "Reserved for future extensions
信号扩展预留位";
CM_ SG_ 756 IDCM_TractionModeSetting "Traction Mode Setting
Traction Mode设置信号";
CM_ SG_ 756 IDCM_ReserveChargeEndTimeMin "Reservation Charging End Time-Minute
大屏预约充电截止时间-分钟";
CM_ SG_ 756 IDCM_ReserveChargeEndTimeHour "Reservation Charging End Time-Hour
大屏预约充电截止时间-小时";
CM_ SG_ 756 IDCM_Android_Ready "IDCM Android Ready
IDCM安卓系统已启动";
CM_ SG_ 756 IDCM_ControllerFaultStatus "Controller Fault Status
描述ECU当前故障状态";
CM_ SG_ 756 IDCM_FD_9_Reserved3 "Reserved for future extensions
信号扩展预留位";
CM_ SG_ 756 IDCM_FD_9_Reserved4 "Reserved for future extensions
信号扩展预留位";
CM_ SG_ 755 IDCM_FD_25_Checksum1 "E2E Signal Group Checksum
Checksum is the actual value after calculation. See the 'ChecksumAlgorithm' sheet for the specific algorithm.
E2E信号组校验和
Checksum为计算后实际值，具体算法参见“ChecksumAlgorithm”页";
CM_ SG_ 755 IDCM_FD_25_RollingCounter1 "E2E Signal Group Counter
Counter value is automatically accumulated, added from 0 to 14 and then looped to the initial value of 0. Every time a message is sent, counter adds 1.
E2E信号组计数器
Counter值为自动累加，从0加到14，然后循环至初始值0，每次报文发送，Counter加1";
CM_ SG_ 755 IDCM_PTModeChange_Cmd "Exclusive-PT Mode Change Command
专属-PT目标模式";
CM_ SG_ 755 IDCM_SoftsandModeEnable "Softsand Mode Enable
Softsand模式使能";
CM_ SG_ 755 IDCM_OffRoadModeEnable "OffRoad Mode Enable
Off-road模式使能";
CM_ SG_ 755 IDCM_TargetVehicleMode "Target Vehicle Mode
整车目标模式";
CM_ SG_ 755 IDCM_WinterModeEnable "Winter Mode Enable
Winter模式使能";
CM_ SG_ 755 IDCM_EPSModeChange_Cmd "Exclusive-EPS Mode Change Command
专属-EPS目标模式";
CM_ SG_ 755 IDCM_AirSModeChange_Cmd "Exclusive-AirS Mode Change Command
专属-AirS目标模式";
CM_ SG_ 755 IDCM_SWSMode "SWS Mode
多功能开关模式";
CM_ SG_ 755 IDCM_CDCModeChangeCmd "Exclusive-CDC Mode Change Command
专属-CDC目标模式";
CM_ SG_ 755 IDCM_ACModeChange_Cmd "Exclusive-AC Change Command
专属-AC目标模式";
CM_ SG_ 755 IDCM_FD_25_Reserved1 "Reserved for future extensions
信号扩展预留位";
CM_ SG_ 755 IDCM_FD_25_Reserved2 "Reserved for future extensions
信号扩展预留位";
CM_ SG_ 755 IDCM_FD_25_Reserved3 "Reserved for future extensions
信号扩展预留位";
CM_ SG_ 755 IDCM_FD_25_Reserved4 "Reserved for future extensions
信号扩展预留位";
CM_ SG_ 370 IDCM_FD_10_Checksum1 "E2E Signal Group Checksum
Checksum is the actual value after calculation. See the 'ChecksumAlgorithm' sheet for the specific algorithm.
E2E信号组校验和
Checksum为计算后实际值，具体算法参见“ChecksumAlgorithm”页";
CM_ SG_ 370 IDCM_FD_10_RollingCounter1 "E2E Signal Group Counter
Counter value is automatically accumulated, added from 0 to 14 and then looped to the initial value of 0. Every time a message is sent, counter adds 1.
E2E信号组计数器
Counter值为自动累加，从0加到14，然后循环至初始值0，每次报文发送，Counter加1";
CM_ SG_ 370 IDCM_TCSSwitch "TCS Switch
TCS开启关闭设置信号";
CM_ SG_ 370 IDCM_AVHSwitch "AVH Switch
AVH开启关闭设置信号";
CM_ SG_ 370 IDCM_EBBrakeModeSet "EB Brake Mode Set
踏板感觉";
CM_ SG_ 370 IDCM_HDCSwitch "HDC Switch
HDC开启关闭设置信号";
CM_ SG_ 370 IDCM_FD_10_Reserved2 "Reserved for future extensions
信号扩展预留位";
CM_ SG_ 370 IDCM_FD_10_Checksum2 "E2E Signal Group Checksum
Checksum is the actual value after calculation. See the 'ChecksumAlgorithm' sheet for the specific algorithm.
E2E信号组校验和
Checksum为计算后实际值，具体算法参见“ChecksumAlgorithm”页";
CM_ SG_ 370 IDCM_FD_10_RollingCounter2 "E2E Signal Group Counter
Counter value is automatically accumulated, added from 0 to 14 and then looped to the initial value of 0. Every time a message is sent, counter adds 1.
E2E信号组计数器
Counter值为自动累加，从0加到14，然后循环至初始值0，每次报文发送，Counter加1";
CM_ SG_ 370 IDCM_FD_10_Reserved3 "Reserved for future extensions
信号扩展预留位";
CM_ SG_ 370 IDCM_PassengerAirbagSet_OnlyForIV2 "Passenger Airbag Set
副驾气囊设置";
CM_ SG_ 370 IDCM_PassengerAirbagSet "Passenger Airbag Set
副驾气囊设置";
CM_ SG_ 370 IDCM_FD_10_Reserved4 "Reserved for future extensions
信号扩展预留位";
CM_ SG_ 370 IDCM_FD_10_Checksum3 "E2E Signal Group Checksum
Checksum is the actual value after calculation. See the 'ChecksumAlgorithm' sheet for the specific algorithm.
E2E信号组校验和
Checksum为计算后实际值，具体算法参见“ChecksumAlgorithm”页";
CM_ SG_ 370 IDCM_FD_10_RollingCounter3 "E2E Signal Group Counter
Counter value is automatically accumulated, added from 0 to 14 and then looped to the initial value of 0. Every time a message is sent, counter adds 1.
E2E信号组计数器
Counter值为自动累加，从0加到14，然后循环至初始值0，每次报文发送，Counter加1";
CM_ SG_ 370 IDCM_FD_10_Reserved5 "Reserved for future extensions
信号扩展预留位";
CM_ SG_ 370 IDCM_LiftMode_Req "Lift Mode Request
举升模式";
CM_ SG_ 370 IDCM_EasyloadMode_Req "Easyload Mode Request
Easy Loading模式";
CM_ SG_ 370 IDCM_VehicleSpeedDependentLevelSwitch_Req "Vehicle Speed Dependent Level Switch Request
随速调节功能开关请求";
CM_ SG_ 370 IDCM_FD_10_Reserved6 "Reserved for future extensions
信号扩展预留位";
CM_ SG_ 370 IDCM_FD_10_Reserved7 "Reserved for future extensions
信号扩展预留位";
CM_ SG_ 371 IDCM_DriverSideApproachOpenDoorSet "Driver Side Approach Open Door Set
主驾靠近开门";
CM_ SG_ 371 IDCM_PassengerSideApproachOpenDoorSet "Passenger Side Approach Open Door Set
副驾靠近开门";
CM_ SG_ 371 IDCM_FD_11_Reserved10 "Reserved for future extensions
信号扩展预留位";
CM_ SG_ 371 IDCM_ApprchUnLockSet_OnlyForIV2 "Approach Unlock Set
靠近解锁设置信号";
CM_ SG_ 371 IDCM_WalkAwayLockCloseDoorSet "Walk Away Lock Close Door Set
远离闭锁关门设置信号";
CM_ SG_ 371 IDCM_UnLockModeSet "Unlock Mode Set
解锁模式配置信号";
CM_ SG_ 371 IDCM_FD_11_Reserved12 "Reserved for future extensions
信号扩展预留位";
CM_ SG_ 371 IDCM_ApprchUnLockSet "Approach Unlock Set
靠近解锁设置信号";
CM_ SG_ 371 IDCM_FD_11_Reserved1 "Reserved for future extensions
信号扩展预留位";
CM_ SG_ 371 IDCM_RemoteLowPressureWarnSet "Remote Low Pressure Warn Set
远程低压报警功能设置信号";
CM_ SG_ 371 IDCM_RearDefrostCtrl_Cmd "Rear Defog Control Command
后窗除霜开关信号";
CM_ SG_ 371 IDCM_WelcomeModeSet "Welcome Mode Set
迎宾模式设置信号";
CM_ SG_ 371 IDCM_FD_11_Reserved2 "Reserved for future extensions
信号扩展预留位";
CM_ SG_ 371 IDCM_LightDelayCloseTimeSet "Light Delay Closing Time Set
灯光延时关闭时间设置信号";
CM_ SG_ 371 IDCM_TopLightModeSet "Top Light Mode Set
顶灯模式设置信号";
CM_ SG_ 371 IDCM_TopLightSwitch "Top Light Switch
顶灯开关设置";
CM_ SG_ 371 IDCM_BackLghtIntensityAdjust_Cmd "Backlight Intensity Adjust Command
背光灯亮度调节信号";
CM_ SG_ 371 IDCM_AutoLightSet "AutoLightSetCommand
自动灯光设置命令信号";
CM_ SG_ 371 IDCM_AutoLightSet_Vld "StatusofAutoLightControlCommand
自动灯光控制命令有效信号";
CM_ SG_ 371 IDCM_RainAutoCloseWindowSet "Rain Auto Close Window Set
下雨自动关闭门窗设置信号";
CM_ SG_ 371 IDCM_AutoHighBeam_Cmd "Auto High Beam Control Command
自动远光灯开启关闭设置信号";
CM_ SG_ 371 IDCM_FD_11_Reserved3 "Reserved for future extensions
信号扩展预留位";
CM_ SG_ 371 IDCM_AVASEnable "AVASEnable
AVAS使能信号";
CM_ SG_ 371 IDCM_AVASSoundType "AVAS Sound Type
音源选择";
CM_ SG_ 371 IDCM_HornModeSet "Horn Mode Set
喇叭模式设置信号";
CM_ SG_ 371 IDCM_BonusModeSet "Bonus Mode Set
彩蛋模式设置";
CM_ SG_ 371 IDCM_FLSeatAjustMode_OnlyForIV2 "Front Left Seat Adjust Mode
主驾座椅调节模式";
CM_ SG_ 371 IDCM_FRSeatAdjustMode_OnlyForIV2 "Front Right Seat Adjust Mode
副驾座椅调节模式";
CM_ SG_ 371 IDCM_FrdCanCvr "Disables signal from the front hatch cover in the driving mode
代驾模式前舱盖禁用信号";
CM_ SG_ 371 IDCM_Guard_Mode_Alarm "Safety housekeeper horn alarm sound
安全管家喇叭报警音";
CM_ SG_ 371 IDCM_BackMirrorAutoFoldSet "Rearview Mirror Automatically Fold Set
车外后视镜自动折叠设置信号";
CM_ SG_ 371 IDCM_BackMirrorAutoTurnOverSet "Rearview Mirror Automatically Turn Over Set
后视镜自动下翻设置信号";
CM_ SG_ 371 IDCM_BackMirrorAutoUnfoldSet "Rearview Mirror Automatically unfolding Set
后视镜自动展开设置信号";
CM_ SG_ 371 IDCM_SteerWheelHeat_Cmd "Steering Wheel Heat Command
方向盘加热控制命令";
CM_ SG_ 371 IDCM_FD_11_Reserved5 "Reserved for future extensions
信号扩展预留位";
CM_ SG_ 371 IDCM_SteerWheelHeatTemp_Cmd "Steering Wheel Heat Temperature Command
方向盘加热温度控制命令";
CM_ SG_ 371 IDCM_FD_11_Reserved11 "Reserved for future extensions
信号扩展预留位";
CM_ SG_ 371 IDCM_FD_11_Reserved6 "Reserved for future extensions
信号扩展预留位";
CM_ SG_ 371 IDCM_FD_11_Checksum1 "E2E Signal Group Checksum
Checksum is the actual value after calculation. See the 'ChecksumAlgorithm' sheet for the specific algorithm.
E2E信号组校验和
Checksum为计算后实际值，具体算法参见“ChecksumAlgorithm”页";
CM_ SG_ 371 IDCM_FD_11_RollingCounter1 "E2E Signal Group Counter
Counter value is automatically accumulated, added from 0 to 14 and then looped to the initial value of 0. Every time a message is sent, counter adds 1.
E2E信号组计数器
Counter值为自动累加，从0加到14，然后循环至初始值0，每次报文发送，Counter加1";
CM_ SG_ 371 IDCM_FD_11_Reserved7 "Reserved for future extensions
信号扩展预留位";
CM_ SG_ 371 IDCM_BDCMPowerCtrl_Cmd "Power Control Command
BDCM上下电命令信号";
CM_ SG_ 371 IDCM_HoodLockCtrl_Cmd "Hood Lock Control Command
前备箱锁控制（hood）";
CM_ SG_ 371 IDCM_LockCtrl_Cmd "Lock Control Command
中控锁开关控制信号";
CM_ SG_ 371 IDCM_ChargeCapCtrl_Cmd "Charge Cap Control Command
充电口盖控制命令";
CM_ SG_ 371 IDCM_FrontWiperService_Cmd "Front Wiper Service Command
前雨刮维修命令";
CM_ SG_ 371 IDCM_FrontWiperMode_Cmd "Front Wiper Mode Command
雨刮运行模式设置命令信号";
CM_ SG_ 371 IDCM_SafetyLockSet_Req "Child Safety Lock Set
儿童锁设置信号";
CM_ SG_ 371 IDCM_FD_11_Reserved8 "Reserved for future extensions
信号扩展预留位";
CM_ SG_ 371 IDCM_FD_11_Reserved9 "Reserved for future extensions
信号扩展预留位";
CM_ SG_ 494 IDCM_FLFrontBackAdjust_Cmd_OnlyForIV2 "Front Left Front Back Adjust Command
主驾座椅前后调节命令信号";
CM_ SG_ 494 IDCM_FLSeatHeightAdjust_Cmd_OnlyForIV2 "Front Left Seat Height Adjust Command
主驾座椅高度调节命令信号";
CM_ SG_ 494 IDCM_FLSeatBackCushionAdjust_Cmd_OnlyForIV2 "Front Left Seat Back Cushion Adjust COmmand
主驾座椅靠背调节命令信号";
CM_ SG_ 494 IDCM_FLSeatCushionAngleAdjust_Cmd_OnlyForIV2 "Front Left Seat Cushion Angle Adjust Command
主驾座椅坐垫角度调节命令信号";
CM_ SG_ 494 IDCM_FLSeatHeatGear_Cmd "Front Left Seat Heat Gear Command
主驾座椅加热命令信号";
CM_ SG_ 494 IDCM_FLSeatVentilation_Cmd "Front Left Seat Ventilation COmmand
主驾座椅通风命令信号";
CM_ SG_ 494 IDCM_FLSeatFrontBackPosition_Cmd "Front Left Seat Front Back Position Command
主驾座椅前后位置命令";
CM_ SG_ 494 IDCM_FLSeatHeightPosition_Cmd "Front Left Seat Height Position Command
主驾座椅高度位置命令";
CM_ SG_ 494 IDCM_FLSeatBackCushionPosition_Cmd "Front Left Seat Back Cushion Position Command
主驾座椅靠背倾斜位置命令";
CM_ SG_ 494 IDCM_FLSeatCushionAnglePosition_Cmd "Front Left Seat Cushion Angle Position Command
主驾座椅坐垫角度位置命令";
CM_ SG_ 494 IDCM_FLSeatMassageMode_Cmd "Front Left Seat Massage Mode Command
主驾座椅按摩模式信号";
CM_ SG_ 494 IDCM_FLLumbarSupportFrontBackAdjust_Cmd "Front Left Lumbar Support Front Back Adjust Command
主驾座椅腰托气袋前后调节命令信号";
CM_ SG_ 494 IDCM_FLLumbarSupportUpDownAdjust_Cmd "Front Left Lumbar Support Up Down Adjust Command
主驾座椅腰托气袋上下调节命令信号";
CM_ SG_ 494 IDCM_FLSeatMassageStrength_Cmd "Front Left Seat Massage Strength Command
主驾驶座椅按摩力度信号";
CM_ SG_ 494 IDCM_FLSeatAjustMode "Front Left Seat Adjust Mode
主驾座椅调节模式";
CM_ SG_ 494 IDCM_FD_12_Reserved1 "Reserved for future extensions
信号扩展预留位";
CM_ SG_ 494 IDCM_FRSeatFrontBackAdjust_Cmd "Front Right Seat Front Back Adjust Command
副驾座椅前后调节命令信号";
CM_ SG_ 494 IDCM_FRSeatHeightAdjust_Cmd "Front Right Seat Height Adjust Command
副驾座椅高度调节命令信号";
CM_ SG_ 494 IDCM_FRSeatBackCushionAdjust_Cmd "Front Right Seat Back Cushion Adjust Command
副驾座椅靠背调节命令信号";
CM_ SG_ 494 IDCM_FRSeatLegSupportAdjust_Cmd "Front Right Seat Leg Support Adjust Command
副驾座椅腿托调节命令信号";
CM_ SG_ 494 IDCM_FRSeatHeatGear_Cmd "Front Right Seat Heat Gear COmmand
副驾座椅加热命令信号";
CM_ SG_ 494 IDCM_FRSeatVentilation_Cmd "Front Right Seat Ventilation Command
副驾座椅通风命令信号";
CM_ SG_ 494 IDCM_FRSeatFrontBackPosition_Cmd "Front Right Seat Front Back Position COmmand
副驾座椅前后位置命令";
CM_ SG_ 494 IDCM_FRSeatBackCushionPosition_Cmd "Front Right Seat Back Cushion Position COmmand
副驾座椅靠背倾斜位置命令";
CM_ SG_ 494 IDCM_FRSeatHeightPosition_Cmd "Front Right Seat Height Position Command
副驾座椅高度位置命令";
CM_ SG_ 494 IDCM_FRSeatLegSupportPosition_Cmd "Front Right Seat Leg Support Position Command
副驾座椅腿托位置命令";
CM_ SG_ 494 IDCM_FRLumbarSupportFrontBackAdjust_Cmd "Front Right Lumbar Support Front Back Adjust Command
副驾座椅腰托气袋前后调节命令信号";
CM_ SG_ 494 IDCM_FRLumbarSupportUpDownAdjust_Cmd "Front Right Lumbar Support Up Down Adjust Command
副驾座椅腰托气袋上下调节命令信号";
CM_ SG_ 494 IDCM_FRSeatMassageMode_Cmd "Front Right Seat Massage Mode Command
副驾座椅按摩模式信号";
CM_ SG_ 494 IDCM_FRSeatMassageStrength_Cmd "Front Right Seat Massage Strength Command
副驾驶座椅按摩力度信号";
CM_ SG_ 494 IDCM_FRSeatAdjustMode "Front Right Seat Adjust Mode
副驾座椅调节模式";
CM_ SG_ 494 IDCM_FD_12_Reserved2 "Reserved for future extensions
信号扩展预留位";
CM_ SG_ 494 IDCM_DriverPositionMemoryID "Driver Position Memory ID
主驾位置记忆账户ID";
CM_ SG_ 494 IDCM_DriverPositionMemory_Cmd "Driver Position Memory Command
主驾位置记忆请求";
CM_ SG_ 494 IDCM_PassengerPositionMemory_Cmd "Passenger Position Memory
副驾位置记忆请求";
CM_ SG_ 494 IDCM_DriverMemoryExportPosition "Driver Memory Export Position
主驾记忆/调出位置";
CM_ SG_ 494 IDCM_PssengerMemoryExportPosition "Passenger Memory Export Position
副驾记忆/调出位置";
CM_ SG_ 494 IDCM_PassengerSeatSoftPointSet_Cmd "Passenger Seat Soft Point Set Command
副驾座椅软止点设置";
CM_ SG_ 494 IDCM_FD_12_Reserved3 "Reserved for future extensions
信号扩展预留位";
CM_ SG_ 494 IDCM_SCAMTiltPositionSet "SACM Memory Export - Tilt Position Set
方向盘记忆调出 - Tilt位置设置";
CM_ SG_ 494 IDCM_SCAMTelescopePositionSet "SACM Memory Export - Telescope Position Set
方向盘记忆调出 - Telescope位置设置";
CM_ SG_ 494 IDCM_FD_12_Checksum1 "E2E Signal Group Checksum
Checksum is the actual value after calculation. See the 'ChecksumAlgorithm' sheet for the specific algorithm.
E2E信号组校验和
Checksum为计算后实际值，具体算法参见“ChecksumAlgorithm”页";
CM_ SG_ 494 IDCM_FD_12_RollingCounter1 "E2E Signal Group Counter
Counter value is automatically accumulated, added from 0 to 14 and then looped to the initial value of 0. Every time a message is sent, counter adds 1.
E2E信号组计数器
Counter值为自动累加，从0加到14，然后循环至初始值0，每次报文发送，Counter加1";
CM_ SG_ 494 IDCM_FD_12_Reserved6 "Reserved for future extensions
信号扩展预留位";
CM_ SG_ 494 IDCM_FLFrontBackAdjust_Cmd "Front Left Front Back Adjust Command
主驾座椅前后调节命令信号";
CM_ SG_ 494 IDCM_FLSeatHeightAdjust_Cmd "Front Left Seat Height Adjust Command
主驾座椅高度调节命令信号";
CM_ SG_ 494 IDCM_FLSeatBackCushionAdjust_Cmd "Front Left Seat Back Cushion Adjust COmmand
主驾座椅靠背调节命令信号";
CM_ SG_ 494 IDCM_FLSeatCushionAngleAdjust_Cmd "Front Left Seat Cushion Angle Adjust Command
主驾座椅坐垫角度调节命令信号";
CM_ SG_ 494 IDCM_FD_12_Reserved4 "Reserved for future extensions
信号扩展预留位";
CM_ SG_ 494 IDCM_FD_12_Reserved5 "Reserved for future extensions
信号扩展预留位";
CM_ SG_ 495 IDCM_SRLSeatFrontBackAdjust_Cmd "Second Row Left Seat Front Back Adjust Command
二排左座椅前后调节命令信号";
CM_ SG_ 495 IDCM_SRLSeatBackCushionAdjust_Cmd "Second Row Left Seat Back Cushion Adjust Command
二排左座椅靠背调节命令信号";
CM_ SG_ 495 IDCM_SRLSeatLegSupportAdjust_Cmd "Second Row Left Seat Leg Support Adjust Command
二排左座椅腿托调节命令信号";
CM_ SG_ 495 IDCM_SRLSeatLateralAdjust_Cmd "Second Row Left Seat Lateral Adjust COmmand
二排左侧座椅侧向调节命令信号";
CM_ SG_ 495 IDCM_SRLSeatHeatGear_Cmd "Second Row Left Heat Gear Command
二排左座椅加热命令信号";
CM_ SG_ 495 IDCM_SRLSeatVentilationGear_Cmd "Second Row Left Seat Ventilation Gear Command
二排左座椅通风命令信号";
CM_ SG_ 495 IDCM_FD_13_Reserved4 "Reserved for future extensions
信号扩展预留位";
CM_ SG_ 495 IDCM_SRLSeatMassageMode_Cmd "Second Row Left Seat Massage Mode Command
二排左座椅按摩模式信号";
CM_ SG_ 495 IDCM_SRLLumbarSupportFrontBackAdjust_Cmd "Second Row Left Lumbar Support Front Back Adjust Command
二排左座椅腰托气袋前后调节命令信号";
CM_ SG_ 495 IDCM_SRLLumbarSupportUpDwnAdjust_Cmd "Second Row Left Lumbar Support Up Dwn Adjust Command
二排左座椅腰托气袋上下调节命令信号";
CM_ SG_ 495 IDCM_SRLSeatFrontBackPosition_Cmd "Second Row Left Seat Front Back Position Command
二排左座椅前后位置命令";
CM_ SG_ 495 IDCM_SRLSeatSidePosition_Cmd "Second Row Left Seat Side Position Command
二排左座椅侧向位置控制请求";
CM_ SG_ 495 IDCM_SRLSeatBackCushionPosition_Cmd "Second Row Left Seat Back Cushion Position COmmand
二排左座椅靠背倾斜位置命令";
CM_ SG_ 495 IDCM_SRLSeatLegSupportPosition_Cmd "Second Row Left Seat Leg Support Position Command
二排左座椅腿托位置控制请求";
CM_ SG_ 495 IDCM_SRRSeatFrontBackAdjust_Cmd "Second Row Right Seat Front Back Adjust Command
二排右座椅前后调节命令信号";
CM_ SG_ 495 IDCM_SRRSeatBackCushionAdjust_Cmd "Second Row Right Seat Back Cushion Adjust Command
二排右座椅靠背调节命令信号";
CM_ SG_ 495 IDCM_SRRSeatLegSupportAdjust_Cmd "Second Roe Right Seat Leg Support Adjust Command
二排右座椅腿托调节命令信号";
CM_ SG_ 495 IDCM_SRRSeatLateralAdjust_Cmd "Second Row Right Seat Lateral Adjust Command
二排右侧座椅侧向调节命令信号";
CM_ SG_ 495 IDCM_SRRSeatHeatGear_Cmd "Second Row Right Seat Heat Gear Command
二排右座椅加热命令信号";
CM_ SG_ 495 IDCM_SRRSeatVentilation_Cmd "Second Row Right Seat Ventilation Command
二排右座椅通风命令信号";
CM_ SG_ 495 IDCM_FD_13_Reserved5 "Reserved for future extensions
信号扩展预留位";
CM_ SG_ 495 IDCM_SRRSeatMassageMode_Cmd "Second Row Right Seat Massage Mode Command
二排右座椅按摩模式信号";
CM_ SG_ 495 IDCM_SRRLumbarSupportFrontBackAdjust_Cmd "Second Row Right Lumbar Support Front Back Adjust Command
二排右座椅腰托气袋前后调节命令信号";
CM_ SG_ 495 IDCM_SRRLumbarSupportUpDownAdjust_Cmd "Second Row Right Lumbar Support Up Down Adjust Command
二排右座椅腰托气袋上下调节命令信号";
CM_ SG_ 495 IDCM_SRRSeatFrontBackPosition_Cmd "Second Row Right Seat Front Back Position Command
二排右座椅前后位置控制请求";
CM_ SG_ 495 IDCM_SRRSeatSidePosition_Cmd "Second Row Right Seat Side Position Command
二排右座椅侧向位置控制请求";
CM_ SG_ 495 IDCM_SRRSeatBackCushionPosition_Cmd "Second Row Right Seat Back Cushion Position Command
二排右座椅靠背倾斜位置控制请求";
CM_ SG_ 495 IDCM_SRRSeatLegSupportPosition_Cmd "Second Row Right Seat Leg Support Position Command
二排右座椅腿托位置控制请求";
CM_ SG_ 495 IDCM_SRLZeroGravity_Cmd "Second Row Left Zero Gravity Command
二排左零重力控制信号";
CM_ SG_ 495 IDCM_SRRZeroGravity_Cmd "Second Row Right Zero Gravity Command
二排右零重力控制信号";
CM_ SG_ 495 IDCM_SRLEasyEntry_Cmd "Second Row Left Easy Entry Command
二排左座椅Easy-Entry控制信号";
CM_ SG_ 495 IDCM_SRREasyEntry_Cmd "Second Row Right Easy Entry Command
二排右座椅Easy-Entry控制信号";
CM_ SG_ 495 IDCM_FD_13_Reserved3 "Reserved for future extensions
信号扩展预留位";
CM_ SG_ 495 IDCM_SRLSeatMassageStrength_Cmd "Second Row Left Seat Massage Strength Command
二排左驶座椅按摩力度信号";
CM_ SG_ 495 IDCM_SRRSeatMassageStrength_Cmd "Second Row Right Seat Massage Strength Command
二排右驶座椅按摩力度信号";
CM_ SG_ 495 IDCM_FD_13_Reserved1 "Reserved for future extensions
信号扩展预留位";
CM_ SG_ 495 IDCM_FD_13_Reserved2 "Reserved for future extensions
信号扩展预留位";
CM_ SG_ 374 IDCM_FDoorOpenAngleSet "Front Door Open Angle Set
前门开启角度设置信号";
CM_ SG_ 374 IDCM_RDoorOpenAngleSet "Rear Door Open Angle Set
后门开角度设置信号";
CM_ SG_ 374 IDCM_NTOpenAngleSet "NT Door Open Angle Set
NT门门开角度设置信号";
CM_ SG_ 374 IDCM_NTTourModOpenAngleSet "NT Door Tour Mod Open Angle Set
NT门观光模式开启角度设置信号";
CM_ SG_ 374 IDCM_FLDoorOpenAngleCtrl_Cmd "Front Left Door Open Angle Control Command
左前门开启角度控制信号";
CM_ SG_ 374 IDCM_FRDoorOpenAngleCtrl_Cmd "Front Right Door Open Angle Control Command
右前门开启角度控制信号";
CM_ SG_ 374 IDCM_RLDoorOpenAngleCtrl_Cmd "Rear Left Door Open Angle Control Command
左后门开角度控制命令信号";
CM_ SG_ 374 IDCM_RRDoorOpenAngleCtrl_Cmd "Rear Rear Door Open Angle Control Command
右后门开角度控制命令信号";
CM_ SG_ 374 IDCM_LNTOpenAngleCtrl_Cmd "Left NT Door Open Angle Control Command
左NT门门开角度控制命令信号";
CM_ SG_ 374 IDCM_RNTOpenAngleCtrl_Cmd "Right NT Door Open Angle Control Command
右NT门门开角度控制命令信号";
CM_ SG_ 374 IDCM_TailNormOpenAngleSet "Tailgate Normally Open Angle Set
尾门正常开启角度设置信号";
CM_ SG_ 374 IDCM_TailGarageOpenAngleSet "TailgateGarageModeOpenAngleSet
尾门车库模式开启角度设置信号";
CM_ SG_ 374 IDCM_FLDoorCtrl_Cmd_OnlyForIV2 "Front Left Door Control Command
左前电动吸合门控制信号";
CM_ SG_ 374 IDCM_FRDoorCtrl_Cmd_OnlyForIV2 "Front Right Door Control Command
右前电动吸合门控制信号";
CM_ SG_ 374 IDCM_RLDoorCtrl_Cmd_OnlyForIV2 "Rear Left Door Control Command
左后门控制信号";
CM_ SG_ 374 IDCM_RRDoorCtrl_Cmd_OnlyForIV2 "Rear Right Door Control Command
右后门控制信号";
CM_ SG_ 374 IDCM_LNTCtrl_Cmd_OnlyForIV2 "Left NT Door Control Command
左NT门控制信号";
CM_ SG_ 374 IDCM_RNTCtrl_Cmd_OnlyForIV2 "Right NT Door Control Command
右NT门控制信号";
CM_ SG_ 374 IDCM_NTModeSet "NT Door Mode Set
NT门模式设置命令信号";
CM_ SG_ 374 IDCM_FD_14_Reserved3 "Reserved for future extensions
信号扩展预留位";
CM_ SG_ 374 IDCM_FDoorVariableRateSet "Front Door Variable Rate Set
电吸门可变速率设置";
CM_ SG_ 374 IDCM_RDoorVariableRateSet "Right Door Variable Rate Set
后门可变速率设置";
CM_ SG_ 374 IDCM_NTVariableRateSet "NT Door Variable Rate Set
NT门可变速率设置";
CM_ SG_ 374 IDCM_TailgateCtrl_Cmd "Tailgate Control Command
尾门控制信号";
CM_ SG_ 374 IDCM_TailOpenModeSet "Tailgate Open Mode Set
尾门开启模式信号";
CM_ SG_ 374 IDCM_TailgateFootOpenSet "Tailgate Foot Open Set
尾门脚踏开启设置信号";
CM_ SG_ 374 IDCM_FD_14_Reserved4 "Reserved for future extensions
信号扩展预留位";
CM_ SG_ 374 IDCM_FD_14_Checksum1 "E2E Signal Group Checksum
Checksum is the actual value after calculation. See the 'ChecksumAlgorithm' sheet for the specific algorithm.
E2E信号组校验和
Checksum为计算后实际值，具体算法参见“ChecksumAlgorithm”页";
CM_ SG_ 374 IDCM_FD_14_RollingCounter1 "E2E Signal Group Counter
Counter value is automatically accumulated, added from 0 to 14 and then looped to the initial value of 0. Every time a message is sent, counter adds 1.
E2E信号组计数器
Counter值为自动累加，从0加到14，然后循环至初始值0，每次报文发送，Counter加1";
CM_ SG_ 374 IDCM_FD_14_Reserved5 "Reserved for future extensions
信号扩展预留位";
CM_ SG_ 374 IDCM_FLDoorCtrl_Cmd "Front Left Door Control Command
左前电动吸合门控制信号";
CM_ SG_ 374 IDCM_FRDoorCtrl_Cmd "Front Right Door Control Command
右前电动吸合门控制信号";
CM_ SG_ 374 IDCM_RLDoorCtrl_Cmd "Rear Left Door Control Command
左后门控制信号";
CM_ SG_ 374 IDCM_RRDoorCtrl_Cmd "Rear Right Door Control Command
右后门控制信号";
CM_ SG_ 374 IDCM_LNTCtrl_Cmd "Left NT Door Control Command
左NT门控制信号";
CM_ SG_ 374 IDCM_RNTCtrl_Cmd "Right NT Door Control Command
右NT门控制信号";
CM_ SG_ 374 IDCM_FD_14_Reserved1 "Reserved for future extensions
信号扩展预留位";
CM_ SG_ 374 IDCM_FD_14_Reserved2 "Reserved for future extensions
信号扩展预留位";
CM_ SG_ 375 IDCM_FLWindowCtrl_Cmd "Front Left Window Control Command
左前车窗控制命令信号";
CM_ SG_ 375 IDCM_FRWindowCtrl_Cmd "Front Right Window Control Command
右前车窗控制命令信号";
CM_ SG_ 375 IDCM_RLWindowSwitchForbid "RL Window Switch Forbid
后排左车窗开关禁止命令";
CM_ SG_ 375 IDCM_RRWindowSwitchForbid "RR Window Switch Forbid
后排右车窗开关禁止命令";
CM_ SG_ 375 IDCM_RLWindowCtrl_Cmd "Rear Left Window Control Command
左后车窗控制命令信号";
CM_ SG_ 375 IDCM_RRWindowCtrl_Cmd "Rear Right Window Control Command
右后车窗控制命令信号";
CM_ SG_ 375 IDCM_FLWindowPosition_Cmd "Front Left Window Position Command
左前车窗位置调节信号";
CM_ SG_ 375 IDCM_FRWindowPosition_Cmd "Front Right Window Position Command
右前车窗位置调节信号";
CM_ SG_ 375 IDCM_RLWindowPosition_Cmd "Rear Left Window Position Command
左后车窗位置调节信号";
CM_ SG_ 375 IDCM_RRWindowPosition_Cmd "Rear Right Window Position Command
右后车窗位置调节信号";
CM_ SG_ 375 IDCM_FD_15_Reserved1 "Reserved for future extensions
信号扩展预留位";
CM_ SG_ 375 IDCM_FD_15_Reserved3 "Reserved for future extensions
信号扩展预留位";
CM_ SG_ 375 IDCM_FLBackMirrorUpDownPositionSet "Front Left Back Mirror Up Down Position Set
左前后视镜上下位置设置";
CM_ SG_ 375 IDCM_FLBackMirrorLeftRightPositionSet "Front Left Back Mirror Left Right Position Set
左前后视镜左右位置设置";
CM_ SG_ 375 IDCM_FRBackMirrorUpDownPositionSet "Front Right Back Mirror Up Down Position Set
右前后视镜上下位置设置";
CM_ SG_ 375 IDCM_FRBackMirrorLeftRightPositionSet "Front Righ Back Mirror Left Right Position Set
右前后视镜左右位置设置";
CM_ SG_ 375 IDCM_ReverseFLBackMirrorUDPositionSet "Reverse Front Left Back Mirror Up Down Position Set
倒车左前后视镜上下记忆位置设置";
CM_ SG_ 375 IDCM_ReverseFLBackMirrorLRPositionSet "Reverse Front Left Back Mirror Left Right Position Set
倒车左前后视镜左右记忆位置设置";
CM_ SG_ 375 IDCM_ReverseFRBackMirrorUDPositionSet "Reverse Front Right Back Mirror Up Down Position Set
倒车右前后视镜上下记忆位置设置";
CM_ SG_ 375 IDCM_ReverseFRBackMirrorLRPositionSet "Reverse Front Righ Back Mirror Left Right Position Set
倒车右前后视镜左右记忆位置设置";
CM_ SG_ 375 IDCM_FD_15_Reserved4 "Reserved for future extensions
信号扩展预留位";
CM_ SG_ 376 IDCM_LeftProjectAUpDownAdjust "Left Project A Up Down Adjust
左灯投影A点上下调整";
CM_ SG_ 376 IDCM_LeftProjectALeftRightAdjust "Left Project A Left Right Adjust
左灯投影A点左右调整";
CM_ SG_ 376 IDCM_LeftProjectBUpDownAdjust "Left Project B Up Down Adjust
左灯投影B点上下调整";
CM_ SG_ 376 IDCM_LeftProjectBLeftRightAdjust "Left Project B Left Right Adjust
左灯投影B点左右调整";
CM_ SG_ 376 IDCM_LeftProjectCUpDownAdjust "Left Project C Up Down Adjust
左灯投影C点上下调整";
CM_ SG_ 376 IDCM_LeftProjectCLeftRightAdjust "Left Project C Left Right Adjust
左灯投影C点左右调整";
CM_ SG_ 376 IDCM_LeftProjectDUpDownAdjust "Left Project D Up Down Adjust
左灯投影D点上下调整";
CM_ SG_ 376 IDCM_LeftProjectDLeftRightAdjust "Left Project D Left Right Adjust
左灯投影D点左右调整";
CM_ SG_ 376 IDCM_RightProjectAUpDownAdjust "Right Project A Up Down Adjust
右灯投影A点上下调整";
CM_ SG_ 376 IDCM_RightProjectALeftRightAdjust "Right Project A Left Right Adjust
右灯投影A点左右调整";
CM_ SG_ 376 IDCM_RightProjectBUpDownAdjust "Right Project B Up Down Adjust
右灯投影B点上下调整";
CM_ SG_ 376 IDCM_RightProjectBLeftRightAdjust "Right Project B Left Right Adjust
右灯投影B点左右调整";
CM_ SG_ 376 IDCM_RightProjectCUpDownAdjust "Right Project C Up Down Adjust
右灯投影C点上下调整";
CM_ SG_ 376 IDCM_RightProjectCLeftRightAdjust "Right Project C Left Right Adjust
右灯投影C点左右调整";
CM_ SG_ 376 IDCM_RightProjectDUpDownAdjust "Right Project D Up Down Adjust
右灯投影D点上下调整";
CM_ SG_ 376 IDCM_RightProjectDLeftRightAdjust "Right Project D Left Right Adjust
右灯投影D点左右调整";
CM_ SG_ 376 IDCM_SmartLightEnable "Smart Light Module Enable
智能灯光开启";
CM_ SG_ 376 IDCM_LightPedestriansWarnFunctionEn "Light Pedestrians Warn Function Enable
大灯行人警示使能开关";
CM_ SG_ 376 IDCM_ADBEnable "ADBFunctionEnable
ADB功能使能开关";
CM_ SG_ 376 IDCM_LightFrontVehicleCollisionWarnEn "Light Front Vehicle Collision Warn Enable
大灯前车碰撞预警使能开关";
CM_ SG_ 376 IDCM_LightLaneChangeWarnEn "Light Lane Change Warn Enable
大灯变道辅助提示使能开关";
CM_ SG_ 376 IDCM_LightTurnWarnEn "Light Turn Warn Enable
大灯转向提示使能开关";
CM_ SG_ 376 IDCM_LightLaneDepartureWarnEn "Light Lane Departure Warn Enable
大灯车道偏离预警使能开关";
CM_ SG_ 376 IDCM_LightSpeedLimitWarnEn "Light Speed Limit Warn Enable
大灯限速提示使能开关";
CM_ SG_ 376 IDCM_LightSmartNavigationPromptEn "Light Smart Navigation Prompt Enable
大灯智能导航提示使能开关";
CM_ SG_ 376 IDCM_LightDrivingLinePromptEn "Light Driving Line Prompt Enable
大灯行驶轨迹提示使能开关";
CM_ SG_ 376 IDCM_LightVideoProjectPlayEn "Light Video Project Play Enable
大灯投影播放使能开关";
CM_ SG_ 376 IDCM_DrivingLinePromptButton "DrivingLinePromptButton
行驶轨迹提示按钮信号";
CM_ SG_ 376 IDCM_ISDSmartNavigationPromptEn "ISD Smart Navigation Prompt Enable
ISD智能导航提示使能开关";
CM_ SG_ 376 IDCM_ISDSpeedLimitPromptEN "ISD Speed Limit Prompt Enable
ISD限速提示使能开关";
CM_ SG_ 376 IDCM_ISDChargeCon_St "ISD Charging gun connection status display switch
ISD充电枪连接状态显示开关";
CM_ SG_ 376 IDCM_FD_16_Reserved4 "Reserved for future extensions
信号扩展预留位";
CM_ SG_ 376 IDCM_FD_16_Reserved1 "Reserved for future extensions
信号扩展预留位";
CM_ SG_ 376 IDCM_LightSignatureProjectEnable "Light Signature Project Enable
大灯签名投影功能激活开关";
CM_ SG_ 376 IDCM_LightAutomaticPiolotPromptEn "Light Automatic Piolot Prompt Enable
大灯自动驾驶提示使能开关";
CM_ SG_ 376 IDCM_PPrjctProjectLampSelect "Project Lamp Selact
投影灯选择（左灯/右灯投影选择）";
CM_ SG_ 376 IDCM_ProjectAreaSelect "Project Area Select
投影位置选择，包括:投影到墙（规定距离范围）；投影到地";
CM_ SG_ 376 IDCM_FD_16_Reserved2 "Reserved for future extensions
信号扩展预留位";
CM_ SG_ 376 IDCM_ISDEnduranceMileagePromptEn "ISD Endurance Mileage Prompt Enable
ISD续航里程提示使能开关";
CM_ SG_ 376 IDCM_ISDRearVehicleCollisionWarnEn "ISD Rear Vehicle Collision Warn Enable
ISD后车碰撞预警使能开关";
CM_ SG_ 376 IDCM_ISDHighBeamOFFRemainderEn "ISD High Beam Lamp Off Remainder Enable
ISD关闭远光提示使能开关";
CM_ SG_ 376 IDCM_PedestrianFirstPromptButtonEn "Pedestrian First Prompt Button Enable
行人优先通行按钮信号使能开关";
CM_ SG_ 376 IDCM_ISDLockStateRemainderEn "ISD Lock State Remainder Enable
ISD车辆上锁状态提示使能开关";
CM_ SG_ 376 IDCM_ThanksButton "Thanks Button
点赞按钮";
CM_ SG_ 376 IDCM_ISDChangeDrivingModeEn "ISD Change Driving Mode Enable
ISD驾驶模式切换使能开关";
CM_ SG_ 376 IDCM_ISDCustomersModeEn "ISD Customers Mode Enable
ISD自定义模式使能开关";
CM_ SG_ 376 IDCM_ISDCustomerEditEn "ISD Customer Edit Enable
ISD客户自编辑模式使能开关";
CM_ SG_ 376 IDCM_ISDPedestrianFirstEn "ISD Pedestrian First Enable
ISD行人优先提示使能开关";
CM_ SG_ 376 IDCM_FCSremindwayset "FCS Remind Way Set
FCS提醒方式设置";
CM_ SG_ 376 IDCM_RCWremindwayset "RCW Remind Way Set
RCW提醒方式设置";
CM_ SG_ 376 IDCM_LKSremindwayset "LKS Remind Way Set
LKS提醒方式设置";
CM_ SG_ 376 IDCM_ISAremindwayset "ISA Remind Way Set
ISA提醒方式设置";
CM_ SG_ 376 IDCM_FD_16_Reserved3 "Reserved for future extensions
信号扩展预留位";
CM_ SG_ 377 IDCM_FD_17_Checksum1 "E2E Signal Group Checksum
Checksum is the actual value after calculation. See the 'ChecksumAlgorithm' sheet for the specific algorithm.
E2E信号组校验和
Checksum为计算后实际值，具体算法参见“ChecksumAlgorithm”页";
CM_ SG_ 377 IDCM_FD_17_RollingCounter1 "E2E Signal Group Counter
Counter value is automatically accumulated, added from 0 to 14 and then looped to the initial value of 0. Every time a message is sent, counter adds 1.
E2E信号组计数器
Counter值为自动累加，从0加到14，然后循环至初始值0，每次报文发送，Counter加1";
CM_ SG_ 377 IDCM_FD_17_Reserved1 "Reserved for future extensions
信号扩展预留位";
CM_ SG_ 377 IDCM_HighBeam_Cmd "High Beam Control Command
远光灯控制命令信号";
CM_ SG_ 377 IDCM_HghBeam_Cmd_Vld "Status of High Beam Control Command
远光灯控制命令有效信号";
CM_ SG_ 377 IDCM_LowBeam_Cmd "Low Beam Control Command
近光灯控制命令信号";
CM_ SG_ 377 IDCM_LowBeam_Cmd_Vld "Low Beam Control Command
近光灯控制命令有效信号";
CM_ SG_ 377 IDCM_PositionLight_Cmd "Position Light Control Command
位置灯控制命令信号";
CM_ SG_ 377 IDCM_PositionLight_Cmd_Vld "Status of Position Light Control Command
位置灯控制命令有效信号";
CM_ SG_ 377 IDCM_RearFogLight_Cmd "Rear Fog Light Control Command
后雾灯控制命令信号";
CM_ SG_ 377 IDCM_RearFogLight_Cmd_Vld "Status of Rear Fog Light Control Command
后雾灯控制命令有效信号";
CM_ SG_ 377 IDCM_HazrdWarnLamp_Cmd "Hazard Warning Lamp
危险报警灯控制命令信号";
CM_ SG_ 377 IDCM_HazrdWarnLamp_Cmd_Vld "Status of Hazard Warning Lamp
危险报警灯控制命令有效信号";
CM_ SG_ 377 IDCM_FD_17_Reserved6 "Reserved for future extensions
信号扩展预留位";
CM_ SG_ 377 IDCM_PositionLowBeamLightSet "Position-LowBeam?Light?Set?
位置灯-近光灯灯光设置信号";
CM_ SG_ 377 IDCM_FD_17_Reserved2 "Reserved for future extensions
信号扩展预留位";
CM_ SG_ 377 IDCM_SaveLightShowModeChoose "Save Light Show Mode Choose
保存的灯光秀选择";
CM_ SG_ 377 IDCM_PreviewSwitch "Preview Enable
预览按钮开关";
CM_ SG_ 377 IDCM_SaveButton "Save Button
保存按键信号";
CM_ SG_ 377 IDCM_FestivalLightShowSet_Year "Festival Light Show Set - Year
节日灯光秀设置 - 年";
CM_ SG_ 377 IDCM_FestivalLightShowSet_Month "Festival Light Show Set - Month
节日灯光秀设置 - 月";
CM_ SG_ 377 IDCM_PreviewLightShowModeChoose "Preview Light Show Mode Choose
预览灯光秀选择";
CM_ SG_ 377 IDCM_FestivalLightShowSet_Day "Festival Light Show Set - Day
节日灯光秀设置 - 日";
CM_ SG_ 377 IDCM_LightShowEn "Light Show Enable
灯光秀使能设置信号";
CM_ SG_ 377 IDCM_LightShowEnSetChoose "Light Show Enable Set Choose
使能设置的灯光秀选择";
CM_ SG_ 377 IDCM_FestivalLightShowSet_Index "Festival Light Show Set Mode
节日灯光秀设置_节日编号";
CM_ SG_ 377 IDCM_FD_17_Reserved3 "Reserved for future extensions
信号扩展预留位";
CM_ SG_ 377 IDCM_FD_17_Reserved4 "Reserved for future extensions
信号扩展预留位";
CM_ SG_ 377 IDCM_FD_17_Reserved5 "Reserved for future extensions
信号扩展预留位";
CM_ SG_ 753 IDCM_VehicleTotalMileage "Vehicle Total Mileage
车辆行驶总里程(该信号初始值为上次值)";
CM_ SG_ 753 IDCM_FD_18_Reserved1 "Reserved for future extensions
信号扩展预留位";
CM_ SG_ 753 IDCM_FD_18_Checksum1 "E2E Signal Group Checksum
Checksum is the actual value after calculation. See the 'ChecksumAlgorithm' sheet for the specific algorithm.
E2E信号组校验和
Checksum为计算后实际值，具体算法参见“ChecksumAlgorithm”页";
CM_ SG_ 753 IDCM_FD_18_RollingCounter1 "E2E Signal Group Counter
Counter value is automatically accumulated, added from 0 to 14 and then looped to the initial value of 0. Every time a message is sent, counter adds 1.
E2E信号组计数器
Counter值为自动累加，从0加到14，然后循环至初始值0，每次报文发送，Counter加1";
CM_ SG_ 753 IDCM_FD_18_Reserved6 "Reserved for future extensions
信号扩展预留位";
CM_ SG_ 753 IDCM_SystemFailure "IDCM System Failure
IDCM系统故障";
CM_ SG_ 753 IDCM_DisplayError "IDCM Display Error
IDCM仪表显示故障信号";
CM_ SG_ 753 IDCM_LowConsumMode_OnlyForIV2 "Low Consum Mode
设置进入低电量模式";
CM_ SG_ 753 IDCM_ValetMode_St "Valet Mode Status
代客模式";
CM_ SG_ 753 IDCM_InstrumentLeftSidePage "Instrument Left Side Page
仪表左侧页面（用于BDCM调整ACC或HH Pilot速度）";
CM_ SG_ 753 IDCM_LowConsumMode "Low Consum Mode
设置进入低电量模式";
CM_ SG_ 753 IDCM_FD_18_Reserved7 "Reserved for future extensions
信号扩展预留位";
CM_ SG_ 753 IDCM_LowVolt_Keep_Req "Maintain low voltage power on request
维持低压上电请求信号";
CM_ SG_ 753 IDCM_CampingMode_Req "Camping Mode Request
露营模式";
CM_ SG_ 753 IDCM_MaxSpeedLimit_Cmd "Maximum speed limit signal in driving mode
代驾模式最大车速限制信号";
CM_ SG_ 753 IDCM_EverydayEnergyConsume "Everyday Energy Consume
每日耗电量统计";
CM_ SG_ 753 IDCM_ECall_Request "Ecall Request
Ecall请求";
CM_ SG_ 753 IDCM_BCall_Request "Bcall Request
Bcall请求";
CM_ SG_ 753 IDCM_CampingModeSOC_Set "Camping mode SOC Set
露营模式SOC设置";
CM_ SG_ 753 IDCM_ProtocolVersion "IDCM Protocol Version
IDCM协议版本";
CM_ SG_ 753 IDCM_FD_18_Reserved2 "Reserved for future extensions
信号扩展预留位";
CM_ SG_ 753 IDCM_FD_18_Checksum2 "E2E Signal Group Checksum
Checksum is the actual value after calculation. See the 'ChecksumAlgorithm' sheet for the specific algorithm.
E2E信号组校验和
Checksum为计算后实际值，具体算法参见“ChecksumAlgorithm”页";
CM_ SG_ 753 IDCM_FD_18_RollingCounter2 "E2E Signal Group Counter
Counter value is automatically accumulated, added from 0 to 14 and then looped to the initial value of 0. Every time a message is sent, counter adds 1.
E2E信号组计数器
Counter值为自动累加，从0加到14，然后循环至初始值0，每次报文发送，Counter加1";
CM_ SG_ 753 IDCM_FD_18_Reserved5 "Reserved for future extensions
信号扩展预留位";
CM_ SG_ 753 IDCM_V2X_Enable "V2X_Enable
V2X功能开关信号";
CM_ SG_ 753 IDCM_FD_18_Reserved3 "Reserved for future extensions
信号扩展预留位";
CM_ SG_ 753 IDCM_FD_18_Reserved4 "Reserved for future extensions
信号扩展预留位";
CM_ SG_ 881 IDCM_FD_19_Checksum1 "E2E Signal Group Checksum
Checksum is the actual value after calculation. See the 'ChecksumAlgorithm' sheet for the specific algorithm.
E2E信号组校验和
Checksum为计算后实际值，具体算法参见“ChecksumAlgorithm”页";
CM_ SG_ 881 IDCM_FD_19_RollingCounter1 "E2E Signal Group Counter
Counter value is automatically accumulated, added from 0 to 14 and then looped to the initial value of 0. Every time a message is sent, counter adds 1.
E2E信号组计数器
Counter值为自动累加，从0加到14，然后循环至初始值0，每次报文发送，Counter加1";
CM_ SG_ 881 IDCM_FD_19_Reserved1 "Reserved for future extensions
信号扩展预留位";
CM_ SG_ 881 IDCM_IFCISDRestDistance "Interval speed detection rest of distacne. Once navigation jduge vehicle run in an interval speed detection area of road, this signal begin to send specific value, otherwise keep sending 0x0.
区间限速的剩余距离，一旦导航判断车辆行驶在区间限速，信号置为对应值，否则保持0x0.";
CM_ SG_ 881 IDCM_IFCRoadType "Road type from navigation map data and GPS location.
导航地图的道路类型";
CM_ SG_ 881 IDCM_IFCSpeedLimtType "speed limit type from navigation map data and GPS location.
导航地图限速类型";
CM_ SG_ 881 IDCM_IFCSpeedLimitUnit "Speed limit unit
导航地图限速单位";
CM_ SG_ 881 IDCM_IFCNavigationSt "Navigation state
导航状态";
CM_ SG_ 881 IDCM_IFCSLCAheadDistance "speed limit camera ahead distacne. Once navigation jduge there is a speed limit camera ahead that the vehicle will pass by, this signal begin to send specific value, otherwise keep sending 0x0.
前方限速拍照摄像头距离，一旦导航判断车辆前方将通过限速拍照摄像头，信号置为对应值，否则保持0x0.";
CM_ SG_ 881 IDCM_IFCZoneCode "Zone code
国家信息";
CM_ SG_ 881 IDCM_FD_19_Reserved2 "Reserved for future extensions
信号扩展预留位";
CM_ SG_ 881 IDCM_FD_19_Checksum2 "E2E Signal Group Checksum
Checksum is the actual value after calculation. See the 'ChecksumAlgorithm' sheet for the specific algorithm.
E2E信号组校验和
Checksum为计算后实际值，具体算法参见“ChecksumAlgorithm”页";
CM_ SG_ 881 IDCM_FD_19_RollingCounter2 "E2E Signal Group Counter
Counter value is automatically accumulated, added from 0 to 14 and then looped to the initial value of 0. Every time a message is sent, counter adds 1.
E2E信号组计数器
Counter值为自动累加，从0加到14，然后循环至初始值0，每次报文发送，Counter加1";
CM_ SG_ 881 IDCM_FD_19_Reserved3 "Reserved for future extensions
信号扩展预留位";
CM_ SG_ 881 IDCM_FCSSwitch "FCS（FCW and AEB） ON/OFF switch
FCS（FCW和AEB）开关";
CM_ SG_ 881 IDCM_LKSSwitch "LKS（LDW and LKA） ON/OFF switch
LKS（LDW和LKA）开关";
CM_ SG_ 881 IDCM_LKSSensitivity "LKS Sensitivity set
LKS敏感度设置";
CM_ SG_ 881 IDCM_ELKSwitch "ELK ON/OFF switch
ELK开关";
CM_ SG_ 881 IDCM_HWAILC_Switch "HWA indicator lane change on/off switch
HWA拨杆变道开关";
CM_ SG_ 881 IDCM_ISASwitch "ISA ON/OFF switch
ISA开关";
CM_ SG_ 881 IDCM_AHBSwitch "AHB ON/OFF switch
AHB开关";
CM_ SG_ 881 IDCM_LCASwitch "LCA ON/OFF switch
LCA开关";
CM_ SG_ 881 IDCM_DOWSwitch "DOW ON/OFF switch
DOW开关";
CM_ SG_ 881 IDCM_RCTASwitch "RCTA ON/OFF switch
RCTA开关";
CM_ SG_ 881 IDCM_RCWSwitch "RCW ON/OFF switch
RCW开关";
CM_ SG_ 881 IDCM_FCTASwitch "FCTA ON/OFF Switch
FCTA开关";
CM_ SG_ 881 IDCM_LKSType "LKS operate mode set
LKS操作模式设置";
CM_ SG_ 881 IDCM_ISA_WarningOffset "ISA warning offset set
ISA报警偏差设置";
CM_ SG_ 881 IDCM_ValetMode_AccDisable_Cmd "Valet Mode_Acc Disable Command
代驾模式ACC禁用信号";
CM_ SG_ 881 IDCM_FD_19_Reserved4 "Reserved for future extensions
信号扩展预留位";
CM_ SG_ 881 IDCM_FD_19_Reserved5 "Reserved for future extensions
信号扩展预留位";
CM_ SG_ 881 IDCM_FD_19_Reserved6 "Reserved for future extensions
信号扩展预留位";
CM_ SG_ 1016 ARC_ONOFF_St "ARC ON/OFF Status
ARC开/关";
CM_ SG_ 1016 ARC_HUDSnowMode_St "HUD Snow Mode Status
雪地模式状态";
CM_ SG_ 1016 ARC_DispUnit_St "DIsplay Unit Status
显示单位状态";
CM_ SG_ 1016 ARC_Language_St "Language Status
语言状态";
CM_ SG_ 1016 ARC_ARHUDPowerCtrl "ARHUD Power Control
ARHUD电源控制";
CM_ SG_ 1016 ARC_DispPage_St_OnlyForIV2 "HUD Display Page Status
HUD显示页面状态";
CM_ SG_ 1016 ARC_TextDispMode_St "Text Display Mode Status
文字显示方式设置状态";
CM_ SG_ 1016 ARC_Disp_St "HUD Display Status
HUD显示状态";
CM_ SG_ 1016 ARC_SpeedUnitDisp_St "Speed Unit Disp Status
速度单位显示状态";
CM_ SG_ 1016 ARC_LanguageDispSet_St "Language Disp Set Status
语言显示设置状态";
CM_ SG_ 1016 ARC_SpeedManageDisp_St "ARC Speed Manage Display Status
ARC速度管理显示状态";
CM_ SG_ 1016 ARC_WarningDisp_St "Warning Display status
Warning显示状态";
CM_ SG_ 1016 ARC_HUDSOCDisp_St "ARC HUD SOC Disp Status
ARC电量约束显示状态";
CM_ SG_ 1016 ARC_LaneDepartureWarningDisp_St "Lane Departure Warning Display Status
车道偏离显示状态";
CM_ SG_ 1016 ARC_ForwardInformationDisp_St "Forward Information Display Status
前方安全侦测显示状态";
CM_ SG_ 1016 ARC_NavigationDisp_St "Navigation Display Status
导航指引显示状态";
CM_ SG_ 1016 ARC_VehicleInformationDisp_St "Vehicle Information Display Status
车辆信息显示状态";
CM_ SG_ 1016 ARC_PhoneInformationDisp_St "Phone Information Display Status
电话信息显示状态";
CM_ SG_ 1016 ARC_TotalMileageDisp_St "Total Mileage Display Status
行驶里程显示状态";
CM_ SG_ 1016 ARC_ARNavigationDisp_St "AR Navigation Display Status
AR导航指引显示状态";
CM_ SG_ 1016 ARC_ARWarningDisp_St "AR Warning Display Status
AR预警显示状态";
CM_ SG_ 1016 ARC_ProtocolVersion "ARC Protocol Version
ARC协议版本";
CM_ SG_ 1017 ARHUD_ONOFF_St "ARHUD ON/OFF Status
ARHUD开/关状态";
CM_ SG_ 1017 ARHUD_DispBrightness_OnlyForIV2 "ARHUD Display Brightness
ARHUD亮度";
CM_ SG_ 1017 ARHUD_AutoBrightness_St "ARHUD Auto Brightness Status
ARHUD亮度自适应ON/OFF状态";
CM_ SG_ 1017 ARHUD_DispPosition "ARHUD Display Position
ARHUD图像显示位置";
CM_ SG_ 1017 ARHUD_DispBrightness "ARHUD Display Brightness
ARHUD亮度";
CM_ SG_ 1017 ARHUD_Warning "ARHUD Warning Information
ARHUD故障信息";
CM_ SG_ 1017 ARHUD_ProtocolVersion "ARHUD Protocol Version
ARHUD协议版本";
CM_ SG_ 1018 WHUD_ONOFF_St "WHUD ON/OFF Status
WHUD开/关状态";
CM_ SG_ 1018 WHUD_AutoBrightness_St "WHUD Auto Brightness Status
WHUD亮度自适应ON/OFF状态";
CM_ SG_ 1018 WHUD_DispUnitSet_St "DIsplay Unit Set Status
显示单位状态";
CM_ SG_ 1018 WHUD_LanguageSet_St "Language Set Status
语言状态";
CM_ SG_ 1018 WHUD_DispBrightness_OnlyForIV2 "WHUD Display Brightness
WHUD亮度";
CM_ SG_ 1018 WHUD_DispPosition "WHUD图像显示位置";
CM_ SG_ 1018 WHUD_HUDSnowMode_st "HUD Snow Mode Status
雪地模式状态";
CM_ SG_ 1018 WHUD_TextDispMode_St "Text Display Mode Status
文字显示方式状态";
CM_ SG_ 1018 WHUD_DispPage_St "HUD Display Page Status
HUD显示页面状态";
CM_ SG_ 1018 WHUD_DispBrightness "WHUD Display Brightness
WHUD亮度";
CM_ SG_ 1018 WHUD_SpeedUnitDispSet_St "Speed Unit Disp Set Status
速度单位显示设置状态";
CM_ SG_ 1018 WHUD_LanguageDispSet_St "Language Disp Set
语言显示设置状态";
CM_ SG_ 1018 WHUD_SpeedManageDisp_St "WHUD Speed Manage Disp Status
WHUD速度管理显示状态";
CM_ SG_ 1018 WHUD_WarningDisp_St "Warning Display Status
Warning显示状态";
CM_ SG_ 1018 WHUD_SOCDisp_St "WHUD SOC Disp Status
WHUD电量约束显示状态";
CM_ SG_ 1018 WHUD_LaneDepartureWarningDisp_St "Lane Departure Warning Display Status
车道偏离显示设置状态";
CM_ SG_ 1018 WHUD_ForwardInformationDisp_St "Forward Information Display Status
前方安全侦测显示状态";
CM_ SG_ 1018 WHUD_NavigationDisp_St "Navigation Display Status
导航指引显示状态";
CM_ SG_ 1018 WHUD_VehicleInformationDisp_St "Vehicle Information Display Status
车辆信息显示状态";
CM_ SG_ 1018 WHUD_PhoneInformationDisp_St "Phone Information Display Status
电话信息显示状态";
CM_ SG_ 1018 WHUD_TotalMileageDisp_St "Total Mileage Display Status
行驶里程显示状态";
CM_ SG_ 1018 WHUD_Warning "WHUD Warning Information
WHUD故障信息";
CM_ SG_ 1018 WHUD_ProtocolVersion "WHUD Protocol Version
WHUD协议版本";

BA_DEF_ BO_  "NmMessage" ENUM "No","Yes";
BA_DEF_ BO_  "GenMsgSendType" ENUM  "cyclic","Event","IfActive","CE","CA","NoMsgSendType";
BA_DEF_ BO_  "GenMsgCycleTime" INT 0 0;
BA_DEF_ SG_  "GenSigSendType" ENUM  "cyclic","OnChange","OnWrite","IfActive","OnChangeWithRepetition","OnWriteWithRepetition","IfActiveWithRepetition","NoSigSendType","OnChangeAndIfActive","OnChangeAndIfActiveWithRepetition","CA","CE","Event";
BA_DEF_ SG_  "GenSigStartValue" INT 0 0;
BA_DEF_ BO_  "GenMsgCycleTimeFast" INT 0 0;
BA_DEF_ BO_  "GenMsgNrOfRepetition" INT 0 0;
BA_DEF_  "DBName" STRING ;
BA_DEF_ BO_  "CANFD_BRS" ENUM  "0","1";
BA_DEF_ BO_  "VFrameFormat" ENUM  "StandardCAN","ExtendedCAN","reserved","reserved","reserved","reserved","reserved","reserved","reserved","reserved","reserved","reserved","reserved","reserved","StandardCAN_FD","ExtendedCAN_FD";
BA_DEF_  "NmMessageCount" INT 0 255;
BA_DEF_ BO_  "GenMsgILSupport" ENUM  "No","Yes";
BA_DEF_  "NmBaseAddress" HEX 1024 1087;
BA_DEF_  "BusType" STRING ;
BA_DEF_DEF_  "NmMessage" "No";
BA_DEF_DEF_  "GenMsgSendType" "cyclic";
BA_DEF_DEF_  "GenMsgCycleTime" 0;
BA_DEF_DEF_  "GenSigSendType" "cyclic";
BA_DEF_DEF_  "GenSigStartValue" 0;
BA_DEF_DEF_  "GenMsgCycleTimeFast" 0;
BA_DEF_DEF_  "GenMsgNrOfRepetition" 0;
BA_DEF_DEF_  "DBName" "";
BA_DEF_DEF_  "CANFD_BRS" "1";
BA_DEF_DEF_  "VFrameFormat" "StandardCAN_FD";
BA_DEF_DEF_  "NmMessageCount" 128;
BA_DEF_DEF_  "GenMsgILSupport" "Yes";
BA_DEF_DEF_  "NmBaseAddress" 1024;
BA_DEF_DEF_  "BusType" "CAN FD";
BA_ "DBName" "HH_VX1(NCTCar)_IOV_BackboneCANFD_Network_CAN_Matrix_V4.0_网段矩阵";
BA_ "GenMsgSendType" BO_ 889 1;
BA_ "GenMsgCycleTimeFast" BO_ 889 50;
BA_ "GenMsgNrOfRepetition" BO_ 889 3;
BA_ "GenSigSendType" SG_ 889 IDCM_BrightnessManualAdjust_OnlyForIV2 5;
BA_ "GenSigSendType" SG_ 889 IDCM_AutoBrightnessSet 5;
BA_ "GenSigSendType" SG_ 889 IDCM_HUDPositionCtrl_OnlyForIV2 5;
BA_ "GenSigSendType" SG_ 889 IDCM_HUDPowerCtrl 5;
BA_ "GenSigSendType" SG_ 889 IDCM_HUDFactoryReset 5;
BA_ "GenSigSendType" SG_ 889 IDCM_ARCPowerCtrl 5;
BA_ "GenSigSendType" SG_ 889 IDCM_HUDSnowModeSet 5;
BA_ "GenSigSendType" SG_ 889 IDCM_DispUnitSet 5;
BA_ "GenSigSendType" SG_ 889 IDCM_LanguageSet 5;
BA_ "GenSigSendType" SG_ 889 IDCM_TextDispMode 5;
BA_ "GenSigSendType" SG_ 889 IDCM_ARCDispPageSet_OnlyForIV2 5;
BA_ "GenSigSendType" SG_ 889 IDCM_FD_1_Reserved5 5;
BA_ "GenSigSendType" SG_ 889 IDCM_ARCDispSet 5;
BA_ "GenSigSendType" SG_ 889 IDCM_BrightnessManualAdjust 5;
BA_ "GenSigStartValue" SG_ 889 IDCM_BrightnessManualAdjust 31;
BA_ "GenSigSendType" SG_ 889 IDCM_HUDPositionCtrl 5;
BA_ "GenSigStartValue" SG_ 889 IDCM_HUDPositionCtrl 31;
BA_ "GenSigSendType" SG_ 889 IDCM_FD_1_Reserved1 5;
BA_ "GenSigSendType" SG_ 889 IDCM_SpeedUnitDispSet 5;
BA_ "GenSigSendType" SG_ 889 IDCM_LanguageDispSet 5;
BA_ "GenSigSendType" SG_ 889 IDCM_HUDSpeedManageDispSet 5;
BA_ "GenSigSendType" SG_ 889 IDCM_HUDWarningDispSet 5;
BA_ "GenSigSendType" SG_ 889 IDCM_HUDSOCDispSet 5;
BA_ "GenSigSendType" SG_ 889 IDCM_LaneDepartureWarningDispSet 5;
BA_ "GenSigSendType" SG_ 889 IDCM_ForwardInformationDispSet 5;
BA_ "GenSigSendType" SG_ 889 IDCM_NavigationDispSet 5;
BA_ "GenSigSendType" SG_ 889 IDCM_VehicleInformationDispSet 5;
BA_ "GenSigSendType" SG_ 889 IDCM_PhoneInformationDispSet_OnlyForIV2 5;
BA_ "GenSigSendType" SG_ 889 IDCM_TotalMileageDispSet 5;
BA_ "GenSigSendType" SG_ 889 IDCM_ARNavigationDisplaySet 5;
BA_ "GenSigSendType" SG_ 889 IDCM_HUDARWarningDispSet 5;
BA_ "GenSigSendType" SG_ 889 IDCM_FD_1_Reserved2 5;
BA_ "GenSigSendType" SG_ 889 IDCM_FD_1_Reserved3 5;
BA_ "GenSigSendType" SG_ 889 IDCM_FD_1_Reserved4 5;
BA_ "GenMsgSendType" BO_ 894 1;
BA_ "GenSigSendType" SG_ 894 IDCM_PhoneTextLength_OnlyForIV2 2;
BA_ "GenSigSendType" SG_ 894 IDCM_PhoneCallNumber_OnlyForIV2 2;
BA_ "GenSigSendType" SG_ 894 IDCM_PhoneCallName_OnlyForIV2 2;
BA_ "GenSigSendType" SG_ 894 IDCM_PhoneFrameIndex_OnlyForIV2 2;
BA_ "GenSigStartValue" SG_ 894 IDCM_PhoneFrameIndex_OnlyForIV2 1;
BA_ "GenSigSendType" SG_ 894 IDCM_PhoneCallType_OnlyForIV2 2;
BA_ "GenSigStartValue" SG_ 894 IDCM_PhoneCallType_OnlyForIV2 3;
BA_ "GenSigSendType" SG_ 894 IDCM_PhoneCallWaitType_OnlyForIV2 2;
BA_ "GenSigSendType" SG_ 894 IDCM_FD_6_Reserved1 2;
BA_ "GenSigSendType" SG_ 894 IDCM_FD_6_Reserved2 2;
BA_ "GenSigSendType" SG_ 894 IDCM_FD_6_Reserved3 2;
BA_ "GenMsgSendType" BO_ 1016 3;
BA_ "GenMsgCycleTime" BO_ 1016 1000;
BA_ "GenMsgCycleTimeFast" BO_ 1016 50;
BA_ "GenMsgNrOfRepetition" BO_ 1016 3;
BA_ "GenSigSendType" SG_ 1016 ARC_DispUnit_St 5;
BA_ "GenSigStartValue" SG_ 1016 ARC_DispUnit_St 1;
BA_ "GenSigSendType" SG_ 1016 ARC_Language_St 5;
BA_ "GenSigSendType" SG_ 1016 ARC_ARHUDPowerCtrl 5;
BA_ "GenSigStartValue" SG_ 1016 ARC_DispPage_St_OnlyForIV2 7;
BA_ "GenSigSendType" SG_ 1016 ARC_TextDispMode_St 5;
BA_ "GenSigStartValue" SG_ 1016 ARC_TextDispMode_St 1;
BA_ "GenSigStartValue" SG_ 1016 ARC_Disp_St 7;
BA_ "GenSigSendType" SG_ 1016 ARC_SpeedUnitDisp_St 5;
BA_ "GenSigSendType" SG_ 1016 ARC_LanguageDispSet_St 5;
BA_ "GenSigSendType" SG_ 1016 ARC_LaneDepartureWarningDisp_St 5;
BA_ "GenSigSendType" SG_ 1016 ARC_ForwardInformationDisp_St 5;
BA_ "GenSigSendType" SG_ 1016 ARC_NavigationDisp_St 5;
BA_ "GenSigSendType" SG_ 1016 ARC_VehicleInformationDisp_St 5;
BA_ "GenSigSendType" SG_ 1016 ARC_PhoneInformationDisp_St 5;
BA_ "GenSigSendType" SG_ 1016 ARC_TotalMileageDisp_St 5;
BA_ "GenSigStartValue" SG_ 1016 ARC_ProtocolVersion 1;
BA_ "GenMsgSendType" BO_ 1017 3;
BA_ "GenMsgCycleTime" BO_ 1017 1000;
BA_ "GenMsgCycleTimeFast" BO_ 1017 50;
BA_ "GenMsgNrOfRepetition" BO_ 1017 3;
BA_ "GenSigSendType" SG_ 1017 ARHUD_DispBrightness_OnlyForIV2 5;
BA_ "GenSigStartValue" SG_ 1017 ARHUD_DispBrightness_OnlyForIV2 15;
BA_ "GenSigSendType" SG_ 1017 ARHUD_AutoBrightness_St 5;
BA_ "GenSigSendType" SG_ 1017 ARHUD_DispPosition 5;
BA_ "GenSigStartValue" SG_ 1017 ARHUD_DispPosition 31;
BA_ "GenSigSendType" SG_ 1017 ARHUD_DispBrightness 5;
BA_ "GenSigStartValue" SG_ 1017 ARHUD_DispBrightness 31;
BA_ "GenSigStartValue" SG_ 1017 ARHUD_ProtocolVersion 1;
BA_ "GenMsgSendType" BO_ 1018 3;
BA_ "GenMsgCycleTime" BO_ 1018 1000;
BA_ "GenMsgCycleTimeFast" BO_ 1018 50;
BA_ "GenMsgNrOfRepetition" BO_ 1018 3;
BA_ "GenSigSendType" SG_ 1018 WHUD_DispUnitSet_St 5;
BA_ "GenSigStartValue" SG_ 1018 WHUD_DispUnitSet_St 1;
BA_ "GenSigSendType" SG_ 1018 WHUD_LanguageSet_St 5;
BA_ "GenSigSendType" SG_ 1018 WHUD_DispBrightness_OnlyForIV2 5;
BA_ "GenSigStartValue" SG_ 1018 WHUD_DispBrightness_OnlyForIV2 15;
BA_ "GenSigSendType" SG_ 1018 WHUD_DispPosition 5;
BA_ "GenSigStartValue" SG_ 1018 WHUD_DispPosition 31;
BA_ "GenSigSendType" SG_ 1018 WHUD_TextDispMode_St 5;
BA_ "GenSigStartValue" SG_ 1018 WHUD_TextDispMode_St 1;
BA_ "GenSigSendType" SG_ 1018 WHUD_DispPage_St 5;
BA_ "GenSigStartValue" SG_ 1018 WHUD_DispPage_St 7;
BA_ "GenSigSendType" SG_ 1018 WHUD_DispBrightness 5;
BA_ "GenSigStartValue" SG_ 1018 WHUD_DispBrightness 31;
BA_ "GenSigSendType" SG_ 1018 WHUD_SpeedUnitDispSet_St 5;
BA_ "GenSigSendType" SG_ 1018 WHUD_LanguageDispSet_St 5;
BA_ "GenSigSendType" SG_ 1018 WHUD_LaneDepartureWarningDisp_St 5;
BA_ "GenSigSendType" SG_ 1018 WHUD_ForwardInformationDisp_St 5;
BA_ "GenSigSendType" SG_ 1018 WHUD_NavigationDisp_St 5;
BA_ "GenSigSendType" SG_ 1018 WHUD_VehicleInformationDisp_St 5;
BA_ "GenSigSendType" SG_ 1018 WHUD_PhoneInformationDisp_St 5;
BA_ "GenSigSendType" SG_ 1018 WHUD_TotalMileageDisp_St 5;
BA_ "GenSigStartValue" SG_ 1018 WHUD_ProtocolVersion 1;
BA_ "GenMsgSendType" BO_ 759 3;
BA_ "GenMsgCycleTime" BO_ 759 100;
BA_ "GenMsgCycleTimeFast" BO_ 759 50;
BA_ "GenMsgNrOfRepetition" BO_ 759 3;
BA_ "GenSigSendType" SG_ 759 IDCM_FLOutletUpDownAngle 5;
BA_ "GenSigStartValue" SG_ 759 IDCM_FLOutletUpDownAngle 255;
BA_ "GenSigSendType" SG_ 759 IDCM_FLOutletLeftRightAngle 5;
BA_ "GenSigStartValue" SG_ 759 IDCM_FLOutletLeftRightAngle 255;
BA_ "GenSigSendType" SG_ 759 IDCM_LCOutletUpDownAngle 5;
BA_ "GenSigStartValue" SG_ 759 IDCM_LCOutletUpDownAngle 255;
BA_ "GenSigSendType" SG_ 759 IDCM_LCOutletLeftRightAngle 5;
BA_ "GenSigStartValue" SG_ 759 IDCM_LCOutletLeftRightAngle 255;
BA_ "GenSigSendType" SG_ 759 IDCM_RCOutletUpDownAngle 5;
BA_ "GenSigStartValue" SG_ 759 IDCM_RCOutletUpDownAngle 255;
BA_ "GenSigSendType" SG_ 759 IDCM_RCOutletLeftRightAngle 5;
BA_ "GenSigStartValue" SG_ 759 IDCM_RCOutletLeftRightAngle 255;
BA_ "GenSigSendType" SG_ 759 IDCM_PanelOutletUpDownAngle 5;
BA_ "GenSigStartValue" SG_ 759 IDCM_PanelOutletUpDownAngle 255;
BA_ "GenSigSendType" SG_ 759 IDCM_PanelOutletLeftRightAngle 5;
BA_ "GenSigStartValue" SG_ 759 IDCM_PanelOutletLeftRightAngle 255;
BA_ "GenSigSendType" SG_ 759 IDCM_FROutletUpDownAngle 5;
BA_ "GenSigStartValue" SG_ 759 IDCM_FROutletUpDownAngle 255;
BA_ "GenSigSendType" SG_ 759 IDCM_FROutletLeftRightAngle 5;
BA_ "GenSigStartValue" SG_ 759 IDCM_FROutletLeftRightAngle 255;
BA_ "GenSigSendType" SG_ 759 IDCM_FLOutletSwitch_Cmd 5;
BA_ "GenSigSendType" SG_ 759 IDCM_LCOutletSwitch_Cmd 5;
BA_ "GenSigSendType" SG_ 759 IDCM_PanelOutletSwitch_Cmd 5;
BA_ "GenSigSendType" SG_ 759 IDCM_RCOutletSwitch_Cmd 5;
BA_ "GenSigSendType" SG_ 759 IDCM_FROutletSwitch_Cmd 5;
BA_ "GenMsgSendType" BO_ 756 3;
BA_ "GenMsgCycleTime" BO_ 756 100;
BA_ "GenMsgCycleTimeFast" BO_ 756 20;
BA_ "GenMsgNrOfRepetition" BO_ 756 3;
BA_ "GenSigSendType" SG_ 756 IDCM_FD_9_Reserved5 5;
BA_ "GenSigSendType" SG_ 756 IDCM_ChargeCtrl 5;
BA_ "GenSigSendType" SG_ 756 IDCM_PowerSaveModeSet 5;
BA_ "GenSigSendType" SG_ 756 IDCM_ChargeCutOffSet 5;
BA_ "GenSigStartValue" SG_ 756 IDCM_ChargeCutOffSet 255;
BA_ "GenSigSendType" SG_ 756 IDCM_DischargeSOCCutOffSet 5;
BA_ "GenSigStartValue" SG_ 756 IDCM_DischargeSOCCutOffSet 255;
BA_ "GenSigSendType" SG_ 756 IDCM_CreepModeSet 5;
BA_ "GenSigSendType" SG_ 756 IDCM_FD_9_Reserved6 5;
BA_ "GenSigSendType" SG_ 756 IDCM_HVOffConfirmFeedback 5;
BA_ "GenSigSendType" SG_ 756 IDCM_MaintenanceModeSwitch 5;
BA_ "GenSigSendType" SG_ 756 IDCM_CoastRegenStrengthSet 5;
BA_ "GenSigStartValue" SG_ 756 IDCM_CoastRegenStrengthSet 255;
BA_ "GenSigSendType" SG_ 756 IDCM_DischargeRangeCutOffSet 5;
BA_ "GenSigStartValue" SG_ 756 IDCM_DischargeRangeCutOffSet 1023;
BA_ "GenSigSendType" SG_ 756 IDCM_LocalCharge_Req 5;
BA_ "GenSigSendType" SG_ 756 IDCM_LocalDischarge_Req 5;
BA_ "GenSigSendType" SG_ 756 IDCM_FD_9_Reserved7 5;
BA_ "GenSigStartValue" SG_ 756 IDCM_PTModeChange_Cmd_OnlyForIV2 15;
BA_ "GenSigStartValue" SG_ 756 IDCM_TargetVehicleMode_OnlyForIV2 15;
BA_ "GenSigStartValue" SG_ 756 IDCM_EPSModeChange_Cmd_OnlyForIV2 7;
BA_ "GenSigStartValue" SG_ 756 IDCM_AirSModeChange_Cmd_OnlyForIV2 7;
BA_ "GenSigStartValue" SG_ 756 IDCM_CDCModeChangeCmd_OnlyForIV2 7;
BA_ "GenSigStartValue" SG_ 756 IDCM_ACModeChange_Cmd_OnlyForIV2 7;
BA_ "GenSigSendType" SG_ 756 IDCM_FD_9_Reserved2 5;
BA_ "GenSigSendType" SG_ 756 IDCM_ReservationChargeEnaable 5;
BA_ "GenSigSendType" SG_ 756 IDCM_ReserveChargeTimeMin 5;
BA_ "GenSigStartValue" SG_ 756 IDCM_ReserveChargeTimeMin 63;
BA_ "GenSigSendType" SG_ 756 IDCM_ReserveChargeDurationSet 5;
BA_ "GenSigStartValue" SG_ 756 IDCM_ReserveChargeDurationSet 65535;
BA_ "GenSigSendType" SG_ 756 IDCM_ReserveChargeCutoffSOCSet 5;
BA_ "GenSigStartValue" SG_ 756 IDCM_ReserveChargeCutoffSOCSet 255;
BA_ "GenSigSendType" SG_ 756 IDCM_ReserveChargeTimeHour 5;
BA_ "GenSigStartValue" SG_ 756 IDCM_ReserveChargeTimeHour 31;
BA_ "GenSigSendType" SG_ 756 IDCM_Offroadmode_Req 5;
BA_ "GenSigSendType" SG_ 756 IDCM_FD_9_Reserved1 5;
BA_ "GenSigSendType" SG_ 756 IDCM_TractionModeSetting 5;
BA_ "GenSigSendType" SG_ 756 IDCM_ReserveChargeEndTimeMin 5;
BA_ "GenSigStartValue" SG_ 756 IDCM_ReserveChargeEndTimeMin 63;
BA_ "GenSigSendType" SG_ 756 IDCM_ReserveChargeEndTimeHour 5;
BA_ "GenSigStartValue" SG_ 756 IDCM_ReserveChargeEndTimeHour 31;
BA_ "GenSigSendType" SG_ 756 IDCM_Android_Ready 5;
BA_ "GenSigSendType" SG_ 756 IDCM_FD_9_Reserved3 5;
BA_ "GenSigSendType" SG_ 756 IDCM_FD_9_Reserved4 5;
BA_ "GenMsgSendType" BO_ 755 3;
BA_ "GenMsgCycleTime" BO_ 755 100;
BA_ "GenMsgCycleTimeFast" BO_ 755 20;
BA_ "GenMsgNrOfRepetition" BO_ 755 3;
BA_ "GenSigSendType" SG_ 755 IDCM_FD_25_Checksum1 2;
BA_ "GenSigSendType" SG_ 755 IDCM_FD_25_RollingCounter1 2;
BA_ "GenSigSendType" SG_ 755 IDCM_PTModeChange_Cmd 5;
BA_ "GenSigSendType" SG_ 755 IDCM_SoftsandModeEnable 5;
BA_ "GenSigSendType" SG_ 755 IDCM_OffRoadModeEnable 5;
BA_ "GenSigSendType" SG_ 755 IDCM_TargetVehicleMode 5;
BA_ "GenSigSendType" SG_ 755 IDCM_WinterModeEnable 5;
BA_ "GenSigSendType" SG_ 755 IDCM_EPSModeChange_Cmd 5;
BA_ "GenSigSendType" SG_ 755 IDCM_AirSModeChange_Cmd 5;
BA_ "GenSigSendType" SG_ 755 IDCM_SWSMode 5;
BA_ "GenSigSendType" SG_ 755 IDCM_CDCModeChangeCmd 5;
BA_ "GenSigSendType" SG_ 755 IDCM_ACModeChange_Cmd 5;
BA_ "GenSigSendType" SG_ 755 IDCM_FD_25_Reserved1 5;
BA_ "GenSigSendType" SG_ 755 IDCM_FD_25_Reserved2 5;
BA_ "GenSigSendType" SG_ 755 IDCM_FD_25_Reserved3 5;
BA_ "GenSigSendType" SG_ 755 IDCM_FD_25_Reserved4 5;
BA_ "GenMsgSendType" BO_ 370 3;
BA_ "GenMsgCycleTime" BO_ 370 50;
BA_ "GenMsgCycleTimeFast" BO_ 370 20;
BA_ "GenMsgNrOfRepetition" BO_ 370 3;
BA_ "GenSigSendType" SG_ 370 IDCM_TCSSwitch 5;
BA_ "GenSigSendType" SG_ 370 IDCM_AVHSwitch 5;
BA_ "GenSigSendType" SG_ 370 IDCM_EBBrakeModeSet 5;
BA_ "GenSigSendType" SG_ 370 IDCM_HDCSwitch 5;
BA_ "GenSigSendType" SG_ 370 IDCM_FD_10_Reserved2 5;
BA_ "GenSigSendType" SG_ 370 IDCM_FD_10_Reserved3 5;
BA_ "GenSigSendType" SG_ 370 IDCM_PassengerAirbagSet_OnlyForIV2 5;
BA_ "GenSigSendType" SG_ 370 IDCM_PassengerAirbagSet 5;
BA_ "GenSigSendType" SG_ 370 IDCM_FD_10_Reserved4 5;
BA_ "GenSigSendType" SG_ 370 IDCM_FD_10_Reserved5 5;
BA_ "GenSigSendType" SG_ 370 IDCM_LiftMode_Req 5;
BA_ "GenSigSendType" SG_ 370 IDCM_EasyloadMode_Req 5;
BA_ "GenSigSendType" SG_ 370 IDCM_VehicleSpeedDependentLevelSwitch_Req 5;
BA_ "GenSigSendType" SG_ 370 IDCM_FD_10_Reserved6 5;
BA_ "GenSigSendType" SG_ 370 IDCM_FD_10_Reserved7 5;
BA_ "GenMsgSendType" BO_ 371 1;
BA_ "GenMsgCycleTimeFast" BO_ 371 50;
BA_ "GenMsgNrOfRepetition" BO_ 371 3;
BA_ "GenSigSendType" SG_ 371 IDCM_DriverSideApproachOpenDoorSet 5;
BA_ "GenSigSendType" SG_ 371 IDCM_PassengerSideApproachOpenDoorSet 5;
BA_ "GenSigSendType" SG_ 371 IDCM_FD_11_Reserved10 5;
BA_ "GenSigSendType" SG_ 371 IDCM_ApprchUnLockSet_OnlyForIV2 5;
BA_ "GenSigSendType" SG_ 371 IDCM_WalkAwayLockCloseDoorSet 5;
BA_ "GenSigSendType" SG_ 371 IDCM_UnLockModeSet 5;
BA_ "GenSigSendType" SG_ 371 IDCM_FD_11_Reserved12 5;
BA_ "GenSigSendType" SG_ 371 IDCM_ApprchUnLockSet 5;
BA_ "GenSigSendType" SG_ 371 IDCM_FD_11_Reserved1 5;
BA_ "GenSigSendType" SG_ 371 IDCM_RemoteLowPressureWarnSet 5;
BA_ "GenSigSendType" SG_ 371 IDCM_RearDefrostCtrl_Cmd 5;
BA_ "GenSigSendType" SG_ 371 IDCM_WelcomeModeSet 5;
BA_ "GenSigSendType" SG_ 371 IDCM_FD_11_Reserved2 5;
BA_ "GenSigSendType" SG_ 371 IDCM_LightDelayCloseTimeSet 5;
BA_ "GenSigSendType" SG_ 371 IDCM_TopLightModeSet 5;
BA_ "GenSigSendType" SG_ 371 IDCM_TopLightSwitch 5;
BA_ "GenSigSendType" SG_ 371 IDCM_BackLghtIntensityAdjust_Cmd 5;
BA_ "GenSigSendType" SG_ 371 IDCM_AutoLightSet 5;
BA_ "GenSigSendType" SG_ 371 IDCM_AutoLightSet_Vld 5;
BA_ "GenSigSendType" SG_ 371 IDCM_RainAutoCloseWindowSet 5;
BA_ "GenSigSendType" SG_ 371 IDCM_AutoHighBeam_Cmd 5;
BA_ "GenSigSendType" SG_ 371 IDCM_FD_11_Reserved3 5;
BA_ "GenSigSendType" SG_ 371 IDCM_AVASEnable 5;
BA_ "GenSigSendType" SG_ 371 IDCM_AVASSoundType 5;
BA_ "GenSigSendType" SG_ 371 IDCM_HornModeSet 5;
BA_ "GenSigSendType" SG_ 371 IDCM_BonusModeSet 5;
BA_ "GenSigSendType" SG_ 371 IDCM_FLSeatAjustMode_OnlyForIV2 5;
BA_ "GenSigSendType" SG_ 371 IDCM_FRSeatAdjustMode_OnlyForIV2 5;
BA_ "GenSigSendType" SG_ 371 IDCM_FrdCanCvr 5;
BA_ "GenSigSendType" SG_ 371 IDCM_Guard_Mode_Alarm 5;
BA_ "GenSigSendType" SG_ 371 IDCM_BackMirrorAutoFoldSet 5;
BA_ "GenSigSendType" SG_ 371 IDCM_BackMirrorAutoTurnOverSet 5;
BA_ "GenSigSendType" SG_ 371 IDCM_BackMirrorAutoUnfoldSet 5;
BA_ "GenSigSendType" SG_ 371 IDCM_SteerWheelHeat_Cmd 5;
BA_ "GenSigSendType" SG_ 371 IDCM_FD_11_Reserved5 5;
BA_ "GenSigSendType" SG_ 371 IDCM_SteerWheelHeatTemp_Cmd 5;
BA_ "GenSigStartValue" SG_ 371 IDCM_SteerWheelHeatTemp_Cmd 44;
BA_ "GenSigSendType" SG_ 371 IDCM_FD_11_Reserved11 5;
BA_ "GenSigSendType" SG_ 371 IDCM_FD_11_Reserved6 5;
BA_ "GenSigSendType" SG_ 371 IDCM_FD_11_Checksum1 2;
BA_ "GenSigSendType" SG_ 371 IDCM_FD_11_RollingCounter1 2;
BA_ "GenSigSendType" SG_ 371 IDCM_FD_11_Reserved7 5;
BA_ "GenSigSendType" SG_ 371 IDCM_BDCMPowerCtrl_Cmd 5;
BA_ "GenSigSendType" SG_ 371 IDCM_HoodLockCtrl_Cmd 5;
BA_ "GenSigSendType" SG_ 371 IDCM_LockCtrl_Cmd 5;
BA_ "GenSigSendType" SG_ 371 IDCM_ChargeCapCtrl_Cmd 5;
BA_ "GenSigSendType" SG_ 371 IDCM_FrontWiperService_Cmd 5;
BA_ "GenSigSendType" SG_ 371 IDCM_FrontWiperMode_Cmd 5;
BA_ "GenSigSendType" SG_ 371 IDCM_SafetyLockSet_Req 5;
BA_ "GenSigSendType" SG_ 371 IDCM_FD_11_Reserved8 5;
BA_ "GenSigSendType" SG_ 371 IDCM_FD_11_Reserved9 5;
BA_ "GenMsgSendType" BO_ 494 1;
BA_ "GenMsgCycleTimeFast" BO_ 494 50;
BA_ "GenMsgNrOfRepetition" BO_ 494 3;
BA_ "GenSigSendType" SG_ 494 IDCM_FLFrontBackAdjust_Cmd_OnlyForIV2 5;
BA_ "GenSigSendType" SG_ 494 IDCM_FLSeatHeightAdjust_Cmd_OnlyForIV2 5;
BA_ "GenSigSendType" SG_ 494 IDCM_FLSeatBackCushionAdjust_Cmd_OnlyForIV2 5;
BA_ "GenSigSendType" SG_ 494 IDCM_FLSeatCushionAngleAdjust_Cmd_OnlyForIV2 5;
BA_ "GenSigSendType" SG_ 494 IDCM_FLSeatHeatGear_Cmd 5;
BA_ "GenSigSendType" SG_ 494 IDCM_FLSeatVentilation_Cmd 5;
BA_ "GenSigSendType" SG_ 494 IDCM_FLSeatFrontBackPosition_Cmd 5;
BA_ "GenSigStartValue" SG_ 494 IDCM_FLSeatFrontBackPosition_Cmd 255;
BA_ "GenSigSendType" SG_ 494 IDCM_FLSeatHeightPosition_Cmd 5;
BA_ "GenSigStartValue" SG_ 494 IDCM_FLSeatHeightPosition_Cmd 255;
BA_ "GenSigSendType" SG_ 494 IDCM_FLSeatBackCushionPosition_Cmd 5;
BA_ "GenSigStartValue" SG_ 494 IDCM_FLSeatBackCushionPosition_Cmd 255;
BA_ "GenSigSendType" SG_ 494 IDCM_FLSeatCushionAnglePosition_Cmd 5;
BA_ "GenSigStartValue" SG_ 494 IDCM_FLSeatCushionAnglePosition_Cmd 255;
BA_ "GenSigSendType" SG_ 494 IDCM_FLSeatMassageMode_Cmd 5;
BA_ "GenSigSendType" SG_ 494 IDCM_FLLumbarSupportFrontBackAdjust_Cmd 5;
BA_ "GenSigSendType" SG_ 494 IDCM_FLLumbarSupportUpDownAdjust_Cmd 5;
BA_ "GenSigSendType" SG_ 494 IDCM_FLSeatMassageStrength_Cmd 5;
BA_ "GenSigSendType" SG_ 494 IDCM_FLSeatAjustMode 5;
BA_ "GenSigSendType" SG_ 494 IDCM_FD_12_Reserved1 5;
BA_ "GenSigSendType" SG_ 494 IDCM_FRSeatFrontBackAdjust_Cmd 5;
BA_ "GenSigSendType" SG_ 494 IDCM_FRSeatHeightAdjust_Cmd 5;
BA_ "GenSigSendType" SG_ 494 IDCM_FRSeatBackCushionAdjust_Cmd 5;
BA_ "GenSigSendType" SG_ 494 IDCM_FRSeatLegSupportAdjust_Cmd 5;
BA_ "GenSigSendType" SG_ 494 IDCM_FRSeatHeatGear_Cmd 5;
BA_ "GenSigSendType" SG_ 494 IDCM_FRSeatVentilation_Cmd 5;
BA_ "GenSigSendType" SG_ 494 IDCM_FRSeatFrontBackPosition_Cmd 5;
BA_ "GenSigStartValue" SG_ 494 IDCM_FRSeatFrontBackPosition_Cmd 255;
BA_ "GenSigSendType" SG_ 494 IDCM_FRSeatBackCushionPosition_Cmd 5;
BA_ "GenSigStartValue" SG_ 494 IDCM_FRSeatBackCushionPosition_Cmd 255;
BA_ "GenSigSendType" SG_ 494 IDCM_FRSeatHeightPosition_Cmd 5;
BA_ "GenSigStartValue" SG_ 494 IDCM_FRSeatHeightPosition_Cmd 255;
BA_ "GenSigSendType" SG_ 494 IDCM_FRSeatLegSupportPosition_Cmd 5;
BA_ "GenSigStartValue" SG_ 494 IDCM_FRSeatLegSupportPosition_Cmd 255;
BA_ "GenSigSendType" SG_ 494 IDCM_FRLumbarSupportFrontBackAdjust_Cmd 5;
BA_ "GenSigSendType" SG_ 494 IDCM_FRLumbarSupportUpDownAdjust_Cmd 5;
BA_ "GenSigSendType" SG_ 494 IDCM_FRSeatMassageMode_Cmd 5;
BA_ "GenSigSendType" SG_ 494 IDCM_FRSeatMassageStrength_Cmd 5;
BA_ "GenSigSendType" SG_ 494 IDCM_FRSeatAdjustMode 5;
BA_ "GenSigSendType" SG_ 494 IDCM_FD_12_Reserved2 5;
BA_ "GenSigSendType" SG_ 494 IDCM_DriverPositionMemoryID 5;
BA_ "GenSigStartValue" SG_ 494 IDCM_DriverPositionMemoryID 255;
BA_ "GenSigSendType" SG_ 494 IDCM_DriverPositionMemory_Cmd 5;
BA_ "GenSigSendType" SG_ 494 IDCM_PassengerPositionMemory_Cmd 5;
BA_ "GenSigSendType" SG_ 494 IDCM_DriverMemoryExportPosition 5;
BA_ "GenSigSendType" SG_ 494 IDCM_PssengerMemoryExportPosition 5;
BA_ "GenSigSendType" SG_ 494 IDCM_PassengerSeatSoftPointSet_Cmd 5;
BA_ "GenSigSendType" SG_ 494 IDCM_FD_12_Reserved3 5;
BA_ "GenSigSendType" SG_ 494 IDCM_SCAMTiltPositionSet 5;
BA_ "GenSigStartValue" SG_ 494 IDCM_SCAMTiltPositionSet 32768;
BA_ "GenSigSendType" SG_ 494 IDCM_SCAMTelescopePositionSet 5;
BA_ "GenSigStartValue" SG_ 494 IDCM_SCAMTelescopePositionSet 32768;
BA_ "GenSigSendType" SG_ 494 IDCM_FD_12_Checksum1 2;
BA_ "GenSigSendType" SG_ 494 IDCM_FD_12_RollingCounter1 2;
BA_ "GenSigSendType" SG_ 494 IDCM_FD_12_Reserved6 5;
BA_ "GenSigSendType" SG_ 494 IDCM_FLFrontBackAdjust_Cmd 5;
BA_ "GenSigSendType" SG_ 494 IDCM_FLSeatHeightAdjust_Cmd 5;
BA_ "GenSigSendType" SG_ 494 IDCM_FLSeatBackCushionAdjust_Cmd 5;
BA_ "GenSigSendType" SG_ 494 IDCM_FLSeatCushionAngleAdjust_Cmd 5;
BA_ "GenSigSendType" SG_ 494 IDCM_FD_12_Reserved4 5;
BA_ "GenSigSendType" SG_ 494 IDCM_FD_12_Reserved5 5;
BA_ "GenMsgSendType" BO_ 495 1;
BA_ "GenMsgCycleTimeFast" BO_ 495 50;
BA_ "GenMsgNrOfRepetition" BO_ 495 3;
BA_ "GenSigSendType" SG_ 495 IDCM_SRLSeatFrontBackAdjust_Cmd 5;
BA_ "GenSigSendType" SG_ 495 IDCM_SRLSeatBackCushionAdjust_Cmd 5;
BA_ "GenSigSendType" SG_ 495 IDCM_SRLSeatLegSupportAdjust_Cmd 5;
BA_ "GenSigSendType" SG_ 495 IDCM_SRLSeatLateralAdjust_Cmd 5;
BA_ "GenSigSendType" SG_ 495 IDCM_SRLSeatHeatGear_Cmd 5;
BA_ "GenSigSendType" SG_ 495 IDCM_SRLSeatVentilationGear_Cmd 5;
BA_ "GenSigSendType" SG_ 495 IDCM_FD_13_Reserved4 5;
BA_ "GenSigSendType" SG_ 495 IDCM_SRLSeatMassageMode_Cmd 5;
BA_ "GenSigSendType" SG_ 495 IDCM_SRLLumbarSupportFrontBackAdjust_Cmd 5;
BA_ "GenSigSendType" SG_ 495 IDCM_SRLLumbarSupportUpDwnAdjust_Cmd 5;
BA_ "GenSigSendType" SG_ 495 IDCM_SRLSeatFrontBackPosition_Cmd 5;
BA_ "GenSigStartValue" SG_ 495 IDCM_SRLSeatFrontBackPosition_Cmd 255;
BA_ "GenSigSendType" SG_ 495 IDCM_SRLSeatSidePosition_Cmd 5;
BA_ "GenSigStartValue" SG_ 495 IDCM_SRLSeatSidePosition_Cmd 255;
BA_ "GenSigSendType" SG_ 495 IDCM_SRLSeatBackCushionPosition_Cmd 5;
BA_ "GenSigStartValue" SG_ 495 IDCM_SRLSeatBackCushionPosition_Cmd 255;
BA_ "GenSigSendType" SG_ 495 IDCM_SRLSeatLegSupportPosition_Cmd 5;
BA_ "GenSigStartValue" SG_ 495 IDCM_SRLSeatLegSupportPosition_Cmd 255;
BA_ "GenSigSendType" SG_ 495 IDCM_SRRSeatFrontBackAdjust_Cmd 5;
BA_ "GenSigSendType" SG_ 495 IDCM_SRRSeatBackCushionAdjust_Cmd 5;
BA_ "GenSigSendType" SG_ 495 IDCM_SRRSeatLegSupportAdjust_Cmd 5;
BA_ "GenSigSendType" SG_ 495 IDCM_SRRSeatLateralAdjust_Cmd 5;
BA_ "GenSigSendType" SG_ 495 IDCM_SRRSeatHeatGear_Cmd 5;
BA_ "GenSigSendType" SG_ 495 IDCM_SRRSeatVentilation_Cmd 5;
BA_ "GenSigSendType" SG_ 495 IDCM_FD_13_Reserved5 5;
BA_ "GenSigSendType" SG_ 495 IDCM_SRRSeatMassageMode_Cmd 5;
BA_ "GenSigSendType" SG_ 495 IDCM_SRRLumbarSupportFrontBackAdjust_Cmd 5;
BA_ "GenSigSendType" SG_ 495 IDCM_SRRLumbarSupportUpDownAdjust_Cmd 5;
BA_ "GenSigSendType" SG_ 495 IDCM_SRRSeatFrontBackPosition_Cmd 5;
BA_ "GenSigStartValue" SG_ 495 IDCM_SRRSeatFrontBackPosition_Cmd 255;
BA_ "GenSigSendType" SG_ 495 IDCM_SRRSeatSidePosition_Cmd 5;
BA_ "GenSigStartValue" SG_ 495 IDCM_SRRSeatSidePosition_Cmd 255;
BA_ "GenSigSendType" SG_ 495 IDCM_SRRSeatBackCushionPosition_Cmd 5;
BA_ "GenSigStartValue" SG_ 495 IDCM_SRRSeatBackCushionPosition_Cmd 255;
BA_ "GenSigSendType" SG_ 495 IDCM_SRRSeatLegSupportPosition_Cmd 5;
BA_ "GenSigStartValue" SG_ 495 IDCM_SRRSeatLegSupportPosition_Cmd 255;
BA_ "GenSigSendType" SG_ 495 IDCM_SRLZeroGravity_Cmd 5;
BA_ "GenSigSendType" SG_ 495 IDCM_SRRZeroGravity_Cmd 5;
BA_ "GenSigSendType" SG_ 495 IDCM_SRLEasyEntry_Cmd 5;
BA_ "GenSigSendType" SG_ 495 IDCM_SRREasyEntry_Cmd 5;
BA_ "GenSigSendType" SG_ 495 IDCM_FD_13_Reserved3 5;
BA_ "GenSigSendType" SG_ 495 IDCM_SRLSeatMassageStrength_Cmd 5;
BA_ "GenSigSendType" SG_ 495 IDCM_SRRSeatMassageStrength_Cmd 5;
BA_ "GenSigSendType" SG_ 495 IDCM_FD_13_Reserved1 5;
BA_ "GenSigSendType" SG_ 495 IDCM_FD_13_Reserved2 5;
BA_ "GenMsgSendType" BO_ 374 1;
BA_ "GenMsgCycleTimeFast" BO_ 374 50;
BA_ "GenMsgNrOfRepetition" BO_ 374 3;
BA_ "GenSigSendType" SG_ 374 IDCM_FDoorOpenAngleSet 5;
BA_ "GenSigStartValue" SG_ 374 IDCM_FDoorOpenAngleSet 255;
BA_ "GenSigSendType" SG_ 374 IDCM_RDoorOpenAngleSet 5;
BA_ "GenSigStartValue" SG_ 374 IDCM_RDoorOpenAngleSet 255;
BA_ "GenSigSendType" SG_ 374 IDCM_NTOpenAngleSet 5;
BA_ "GenSigStartValue" SG_ 374 IDCM_NTOpenAngleSet 255;
BA_ "GenSigSendType" SG_ 374 IDCM_NTTourModOpenAngleSet 5;
BA_ "GenSigStartValue" SG_ 374 IDCM_NTTourModOpenAngleSet 255;
BA_ "GenSigSendType" SG_ 374 IDCM_FLDoorOpenAngleCtrl_Cmd 5;
BA_ "GenSigStartValue" SG_ 374 IDCM_FLDoorOpenAngleCtrl_Cmd 255;
BA_ "GenSigSendType" SG_ 374 IDCM_FRDoorOpenAngleCtrl_Cmd 5;
BA_ "GenSigStartValue" SG_ 374 IDCM_FRDoorOpenAngleCtrl_Cmd 255;
BA_ "GenSigSendType" SG_ 374 IDCM_RLDoorOpenAngleCtrl_Cmd 5;
BA_ "GenSigStartValue" SG_ 374 IDCM_RLDoorOpenAngleCtrl_Cmd 255;
BA_ "GenSigSendType" SG_ 374 IDCM_RRDoorOpenAngleCtrl_Cmd 5;
BA_ "GenSigStartValue" SG_ 374 IDCM_RRDoorOpenAngleCtrl_Cmd 255;
BA_ "GenSigSendType" SG_ 374 IDCM_LNTOpenAngleCtrl_Cmd 5;
BA_ "GenSigStartValue" SG_ 374 IDCM_LNTOpenAngleCtrl_Cmd 255;
BA_ "GenSigSendType" SG_ 374 IDCM_RNTOpenAngleCtrl_Cmd 5;
BA_ "GenSigStartValue" SG_ 374 IDCM_RNTOpenAngleCtrl_Cmd 255;
BA_ "GenSigSendType" SG_ 374 IDCM_TailNormOpenAngleSet 5;
BA_ "GenSigStartValue" SG_ 374 IDCM_TailNormOpenAngleSet 255;
BA_ "GenSigSendType" SG_ 374 IDCM_TailGarageOpenAngleSet 5;
BA_ "GenSigStartValue" SG_ 374 IDCM_TailGarageOpenAngleSet 255;
BA_ "GenSigSendType" SG_ 374 IDCM_FLDoorCtrl_Cmd_OnlyForIV2 5;
BA_ "GenSigSendType" SG_ 374 IDCM_FRDoorCtrl_Cmd_OnlyForIV2 5;
BA_ "GenSigSendType" SG_ 374 IDCM_RLDoorCtrl_Cmd_OnlyForIV2 5;
BA_ "GenSigSendType" SG_ 374 IDCM_RRDoorCtrl_Cmd_OnlyForIV2 5;
BA_ "GenSigSendType" SG_ 374 IDCM_LNTCtrl_Cmd_OnlyForIV2 5;
BA_ "GenSigSendType" SG_ 374 IDCM_RNTCtrl_Cmd_OnlyForIV2 5;
BA_ "GenSigSendType" SG_ 374 IDCM_NTModeSet 5;
BA_ "GenSigSendType" SG_ 374 IDCM_FD_14_Reserved3 5;
BA_ "GenSigSendType" SG_ 374 IDCM_FDoorVariableRateSet 5;
BA_ "GenSigSendType" SG_ 374 IDCM_RDoorVariableRateSet 5;
BA_ "GenSigSendType" SG_ 374 IDCM_NTVariableRateSet 5;
BA_ "GenSigSendType" SG_ 374 IDCM_TailgateCtrl_Cmd 5;
BA_ "GenSigSendType" SG_ 374 IDCM_TailOpenModeSet 5;
BA_ "GenSigSendType" SG_ 374 IDCM_TailgateFootOpenSet 5;
BA_ "GenSigSendType" SG_ 374 IDCM_FD_14_Reserved4 5;
BA_ "GenSigSendType" SG_ 374 IDCM_FD_14_Checksum1 2;
BA_ "GenSigSendType" SG_ 374 IDCM_FD_14_RollingCounter1 2;
BA_ "GenSigSendType" SG_ 374 IDCM_FD_14_Reserved5 5;
BA_ "GenSigSendType" SG_ 374 IDCM_FLDoorCtrl_Cmd 5;
BA_ "GenSigSendType" SG_ 374 IDCM_FRDoorCtrl_Cmd 5;
BA_ "GenSigSendType" SG_ 374 IDCM_RLDoorCtrl_Cmd 5;
BA_ "GenSigSendType" SG_ 374 IDCM_RRDoorCtrl_Cmd 5;
BA_ "GenSigSendType" SG_ 374 IDCM_LNTCtrl_Cmd 5;
BA_ "GenSigSendType" SG_ 374 IDCM_RNTCtrl_Cmd 5;
BA_ "GenSigSendType" SG_ 374 IDCM_FD_14_Reserved1 5;
BA_ "GenSigSendType" SG_ 374 IDCM_FD_14_Reserved2 5;
BA_ "GenMsgSendType" BO_ 375 1;
BA_ "GenMsgCycleTimeFast" BO_ 375 50;
BA_ "GenMsgNrOfRepetition" BO_ 375 3;
BA_ "GenSigSendType" SG_ 375 IDCM_FLWindowCtrl_Cmd 5;
BA_ "GenSigSendType" SG_ 375 IDCM_FRWindowCtrl_Cmd 5;
BA_ "GenSigSendType" SG_ 375 IDCM_RLWindowSwitchForbid 5;
BA_ "GenSigSendType" SG_ 375 IDCM_RRWindowSwitchForbid 5;
BA_ "GenSigSendType" SG_ 375 IDCM_RLWindowCtrl_Cmd 5;
BA_ "GenSigSendType" SG_ 375 IDCM_RRWindowCtrl_Cmd 5;
BA_ "GenSigSendType" SG_ 375 IDCM_FLWindowPosition_Cmd 5;
BA_ "GenSigStartValue" SG_ 375 IDCM_FLWindowPosition_Cmd 255;
BA_ "GenSigSendType" SG_ 375 IDCM_FRWindowPosition_Cmd 5;
BA_ "GenSigStartValue" SG_ 375 IDCM_FRWindowPosition_Cmd 255;
BA_ "GenSigSendType" SG_ 375 IDCM_RLWindowPosition_Cmd 5;
BA_ "GenSigStartValue" SG_ 375 IDCM_RLWindowPosition_Cmd 255;
BA_ "GenSigSendType" SG_ 375 IDCM_RRWindowPosition_Cmd 5;
BA_ "GenSigStartValue" SG_ 375 IDCM_RRWindowPosition_Cmd 255;
BA_ "GenSigSendType" SG_ 375 IDCM_FD_15_Reserved1 5;
BA_ "GenSigSendType" SG_ 375 IDCM_FD_15_Reserved3 5;
BA_ "GenSigSendType" SG_ 375 IDCM_FLBackMirrorUpDownPositionSet 5;
BA_ "GenSigStartValue" SG_ 375 IDCM_FLBackMirrorUpDownPositionSet 255;
BA_ "GenSigSendType" SG_ 375 IDCM_FLBackMirrorLeftRightPositionSet 5;
BA_ "GenSigStartValue" SG_ 375 IDCM_FLBackMirrorLeftRightPositionSet 255;
BA_ "GenSigSendType" SG_ 375 IDCM_FRBackMirrorUpDownPositionSet 5;
BA_ "GenSigStartValue" SG_ 375 IDCM_FRBackMirrorUpDownPositionSet 255;
BA_ "GenSigSendType" SG_ 375 IDCM_FRBackMirrorLeftRightPositionSet 5;
BA_ "GenSigStartValue" SG_ 375 IDCM_FRBackMirrorLeftRightPositionSet 255;
BA_ "GenSigSendType" SG_ 375 IDCM_ReverseFLBackMirrorUDPositionSet 5;
BA_ "GenSigStartValue" SG_ 375 IDCM_ReverseFLBackMirrorUDPositionSet 255;
BA_ "GenSigSendType" SG_ 375 IDCM_ReverseFLBackMirrorLRPositionSet 5;
BA_ "GenSigStartValue" SG_ 375 IDCM_ReverseFLBackMirrorLRPositionSet 255;
BA_ "GenSigSendType" SG_ 375 IDCM_ReverseFRBackMirrorUDPositionSet 5;
BA_ "GenSigStartValue" SG_ 375 IDCM_ReverseFRBackMirrorUDPositionSet 255;
BA_ "GenSigSendType" SG_ 375 IDCM_ReverseFRBackMirrorLRPositionSet 5;
BA_ "GenSigStartValue" SG_ 375 IDCM_ReverseFRBackMirrorLRPositionSet 255;
BA_ "GenSigSendType" SG_ 375 IDCM_FD_15_Reserved4 5;
BA_ "GenMsgSendType" BO_ 376 1;
BA_ "GenMsgCycleTimeFast" BO_ 376 50;
BA_ "GenMsgNrOfRepetition" BO_ 376 3;
BA_ "GenSigSendType" SG_ 376 IDCM_LeftProjectAUpDownAdjust 5;
BA_ "GenSigStartValue" SG_ 376 IDCM_LeftProjectAUpDownAdjust 128;
BA_ "GenSigSendType" SG_ 376 IDCM_LeftProjectALeftRightAdjust 5;
BA_ "GenSigStartValue" SG_ 376 IDCM_LeftProjectALeftRightAdjust 128;
BA_ "GenSigSendType" SG_ 376 IDCM_LeftProjectBUpDownAdjust 5;
BA_ "GenSigStartValue" SG_ 376 IDCM_LeftProjectBUpDownAdjust 128;
BA_ "GenSigSendType" SG_ 376 IDCM_LeftProjectBLeftRightAdjust 5;
BA_ "GenSigStartValue" SG_ 376 IDCM_LeftProjectBLeftRightAdjust 128;
BA_ "GenSigSendType" SG_ 376 IDCM_LeftProjectCUpDownAdjust 5;
BA_ "GenSigStartValue" SG_ 376 IDCM_LeftProjectCUpDownAdjust 128;
BA_ "GenSigSendType" SG_ 376 IDCM_LeftProjectCLeftRightAdjust 5;
BA_ "GenSigStartValue" SG_ 376 IDCM_LeftProjectCLeftRightAdjust 128;
BA_ "GenSigSendType" SG_ 376 IDCM_LeftProjectDUpDownAdjust 5;
BA_ "GenSigStartValue" SG_ 376 IDCM_LeftProjectDUpDownAdjust 128;
BA_ "GenSigSendType" SG_ 376 IDCM_LeftProjectDLeftRightAdjust 5;
BA_ "GenSigStartValue" SG_ 376 IDCM_LeftProjectDLeftRightAdjust 128;
BA_ "GenSigSendType" SG_ 376 IDCM_RightProjectAUpDownAdjust 5;
BA_ "GenSigStartValue" SG_ 376 IDCM_RightProjectAUpDownAdjust 128;
BA_ "GenSigSendType" SG_ 376 IDCM_RightProjectALeftRightAdjust 5;
BA_ "GenSigStartValue" SG_ 376 IDCM_RightProjectALeftRightAdjust 128;
BA_ "GenSigSendType" SG_ 376 IDCM_RightProjectBUpDownAdjust 5;
BA_ "GenSigStartValue" SG_ 376 IDCM_RightProjectBUpDownAdjust 128;
BA_ "GenSigSendType" SG_ 376 IDCM_RightProjectBLeftRightAdjust 5;
BA_ "GenSigStartValue" SG_ 376 IDCM_RightProjectBLeftRightAdjust 128;
BA_ "GenSigSendType" SG_ 376 IDCM_RightProjectCUpDownAdjust 5;
BA_ "GenSigStartValue" SG_ 376 IDCM_RightProjectCUpDownAdjust 128;
BA_ "GenSigSendType" SG_ 376 IDCM_RightProjectCLeftRightAdjust 5;
BA_ "GenSigStartValue" SG_ 376 IDCM_RightProjectCLeftRightAdjust 128;
BA_ "GenSigSendType" SG_ 376 IDCM_RightProjectDUpDownAdjust 5;
BA_ "GenSigStartValue" SG_ 376 IDCM_RightProjectDUpDownAdjust 128;
BA_ "GenSigSendType" SG_ 376 IDCM_RightProjectDLeftRightAdjust 5;
BA_ "GenSigStartValue" SG_ 376 IDCM_RightProjectDLeftRightAdjust 128;
BA_ "GenSigSendType" SG_ 376 IDCM_SmartLightEnable 5;
BA_ "GenSigSendType" SG_ 376 IDCM_LightPedestriansWarnFunctionEn 5;
BA_ "GenSigSendType" SG_ 376 IDCM_ADBEnable 5;
BA_ "GenSigSendType" SG_ 376 IDCM_LightFrontVehicleCollisionWarnEn 5;
BA_ "GenSigSendType" SG_ 376 IDCM_LightLaneChangeWarnEn 5;
BA_ "GenSigSendType" SG_ 376 IDCM_LightTurnWarnEn 5;
BA_ "GenSigSendType" SG_ 376 IDCM_LightLaneDepartureWarnEn 5;
BA_ "GenSigSendType" SG_ 376 IDCM_LightSpeedLimitWarnEn 5;
BA_ "GenSigSendType" SG_ 376 IDCM_LightSmartNavigationPromptEn 5;
BA_ "GenSigSendType" SG_ 376 IDCM_LightDrivingLinePromptEn 5;
BA_ "GenSigSendType" SG_ 376 IDCM_LightVideoProjectPlayEn 5;
BA_ "GenSigSendType" SG_ 376 IDCM_DrivingLinePromptButton 5;
BA_ "GenSigSendType" SG_ 376 IDCM_ISDSmartNavigationPromptEn 5;
BA_ "GenSigSendType" SG_ 376 IDCM_ISDSpeedLimitPromptEN 5;
BA_ "GenSigSendType" SG_ 376 IDCM_ISDChargeCon_St 5;
BA_ "GenSigSendType" SG_ 376 IDCM_FD_16_Reserved4 5;
BA_ "GenSigSendType" SG_ 376 IDCM_FD_16_Reserved1 5;
BA_ "GenSigSendType" SG_ 376 IDCM_LightSignatureProjectEnable 5;
BA_ "GenSigSendType" SG_ 376 IDCM_LightAutomaticPiolotPromptEn 5;
BA_ "GenSigSendType" SG_ 376 IDCM_PPrjctProjectLampSelect 5;
BA_ "GenSigSendType" SG_ 376 IDCM_ProjectAreaSelect 5;
BA_ "GenSigSendType" SG_ 376 IDCM_FD_16_Reserved2 5;
BA_ "GenSigSendType" SG_ 376 IDCM_ISDEnduranceMileagePromptEn 5;
BA_ "GenSigSendType" SG_ 376 IDCM_ISDRearVehicleCollisionWarnEn 5;
BA_ "GenSigSendType" SG_ 376 IDCM_ISDHighBeamOFFRemainderEn 5;
BA_ "GenSigSendType" SG_ 376 IDCM_PedestrianFirstPromptButtonEn 5;
BA_ "GenSigSendType" SG_ 376 IDCM_ISDLockStateRemainderEn 5;
BA_ "GenSigSendType" SG_ 376 IDCM_ThanksButton 5;
BA_ "GenSigSendType" SG_ 376 IDCM_ISDChangeDrivingModeEn 5;
BA_ "GenSigSendType" SG_ 376 IDCM_ISDCustomersModeEn 5;
BA_ "GenSigSendType" SG_ 376 IDCM_ISDCustomerEditEn 5;
BA_ "GenSigSendType" SG_ 376 IDCM_ISDPedestrianFirstEn 5;
BA_ "GenSigSendType" SG_ 376 IDCM_FCSremindwayset 5;
BA_ "GenSigSendType" SG_ 376 IDCM_RCWremindwayset 5;
BA_ "GenSigSendType" SG_ 376 IDCM_LKSremindwayset 5;
BA_ "GenSigSendType" SG_ 376 IDCM_ISAremindwayset 5;
BA_ "GenSigSendType" SG_ 376 IDCM_FD_16_Reserved3 5;
BA_ "GenMsgSendType" BO_ 377 1;
BA_ "GenMsgCycleTimeFast" BO_ 377 50;
BA_ "GenMsgNrOfRepetition" BO_ 377 3;
BA_ "GenSigSendType" SG_ 377 IDCM_FD_17_Checksum1 2;
BA_ "GenSigSendType" SG_ 377 IDCM_FD_17_RollingCounter1 2;
BA_ "GenSigSendType" SG_ 377 IDCM_FD_17_Reserved1 5;
BA_ "GenSigSendType" SG_ 377 IDCM_HighBeam_Cmd 5;
BA_ "GenSigSendType" SG_ 377 IDCM_HghBeam_Cmd_Vld 5;
BA_ "GenSigSendType" SG_ 377 IDCM_LowBeam_Cmd 5;
BA_ "GenSigSendType" SG_ 377 IDCM_LowBeam_Cmd_Vld 5;
BA_ "GenSigSendType" SG_ 377 IDCM_PositionLight_Cmd 5;
BA_ "GenSigSendType" SG_ 377 IDCM_PositionLight_Cmd_Vld 5;
BA_ "GenSigSendType" SG_ 377 IDCM_RearFogLight_Cmd 5;
BA_ "GenSigSendType" SG_ 377 IDCM_RearFogLight_Cmd_Vld 5;
BA_ "GenSigSendType" SG_ 377 IDCM_HazrdWarnLamp_Cmd 5;
BA_ "GenSigSendType" SG_ 377 IDCM_HazrdWarnLamp_Cmd_Vld 5;
BA_ "GenSigSendType" SG_ 377 IDCM_FD_17_Reserved6 5;
BA_ "GenSigSendType" SG_ 377 IDCM_PositionLowBeamLightSet 5;
BA_ "GenSigSendType" SG_ 377 IDCM_FD_17_Reserved2 5;
BA_ "GenSigSendType" SG_ 377 IDCM_SaveLightShowModeChoose 5;
BA_ "GenSigSendType" SG_ 377 IDCM_PreviewSwitch 5;
BA_ "GenSigSendType" SG_ 377 IDCM_SaveButton 5;
BA_ "GenSigSendType" SG_ 377 IDCM_FestivalLightShowSet_Year 5;
BA_ "GenSigStartValue" SG_ 377 IDCM_FestivalLightShowSet_Year 255;
BA_ "GenSigSendType" SG_ 377 IDCM_FestivalLightShowSet_Month 5;
BA_ "GenSigStartValue" SG_ 377 IDCM_FestivalLightShowSet_Month 15;
BA_ "GenSigSendType" SG_ 377 IDCM_PreviewLightShowModeChoose 5;
BA_ "GenSigSendType" SG_ 377 IDCM_FestivalLightShowSet_Day 5;
BA_ "GenSigStartValue" SG_ 377 IDCM_FestivalLightShowSet_Day 63;
BA_ "GenSigSendType" SG_ 377 IDCM_LightShowEn 5;
BA_ "GenSigSendType" SG_ 377 IDCM_LightShowEnSetChoose 5;
BA_ "GenSigSendType" SG_ 377 IDCM_FestivalLightShowSet_Index 5;
BA_ "GenSigSendType" SG_ 377 IDCM_FD_17_Reserved3 5;
BA_ "GenSigSendType" SG_ 377 IDCM_FD_17_Reserved4 5;
BA_ "GenSigSendType" SG_ 377 IDCM_FD_17_Reserved5 5;
BA_ "GenMsgSendType" BO_ 753 3;
BA_ "GenMsgCycleTime" BO_ 753 100;
BA_ "GenMsgCycleTimeFast" BO_ 753 50;
BA_ "GenMsgNrOfRepetition" BO_ 753 3;
BA_ "GenSigStartValue" SG_ 753 IDCM_VehicleTotalMileage 16777215;
BA_ "GenSigSendType" SG_ 753 IDCM_LowConsumMode 5;
BA_ "GenSigSendType" SG_ 753 IDCM_CampingMode_Req 5;
BA_ "GenSigSendType" SG_ 753 IDCM_MaxSpeedLimit_Cmd 5;
BA_ "GenSigStartValue" SG_ 753 IDCM_MaxSpeedLimit_Cmd 255;
BA_ "GenSigSendType" SG_ 753 IDCM_EverydayEnergyConsume 5;
BA_ "GenSigSendType" SG_ 753 IDCM_ECall_Request 5;
BA_ "GenSigSendType" SG_ 753 IDCM_BCall_Request 5;
BA_ "GenSigSendType" SG_ 753 IDCM_CampingModeSOC_Set 5;
BA_ "GenSigStartValue" SG_ 753 IDCM_ProtocolVersion 1;
BA_ "GenSigSendType" SG_ 753 IDCM_V2X_Enable 5;
BA_ "GenMsgSendType" BO_ 881 3;
BA_ "GenMsgCycleTime" BO_ 881 500;
BA_ "GenMsgCycleTimeFast" BO_ 881 20;
BA_ "GenMsgNrOfRepetition" BO_ 881 3;
BA_ "GenSigSendType" SG_ 881 IDCM_FCSSwitch 5;
BA_ "GenSigSendType" SG_ 881 IDCM_LKSSwitch 5;
BA_ "GenSigSendType" SG_ 881 IDCM_LKSSensitivity 5;
BA_ "GenSigSendType" SG_ 881 IDCM_ELKSwitch 5;
BA_ "GenSigSendType" SG_ 881 IDCM_HWAILC_Switch 5;
BA_ "GenSigSendType" SG_ 881 IDCM_ISASwitch 5;
BA_ "GenSigSendType" SG_ 881 IDCM_AHBSwitch 5;
BA_ "GenSigSendType" SG_ 881 IDCM_LCASwitch 5;
BA_ "GenSigSendType" SG_ 881 IDCM_DOWSwitch 5;
BA_ "GenSigSendType" SG_ 881 IDCM_RCTASwitch 5;
BA_ "GenSigSendType" SG_ 881 IDCM_RCWSwitch 5;
BA_ "GenSigSendType" SG_ 881 IDCM_FCTASwitch 5;
BA_ "GenSigSendType" SG_ 881 IDCM_LKSType 5;
BA_ "GenSigSendType" SG_ 881 IDCM_ISA_WarningOffset 5;
BA_ "GenSigSendType" SG_ 881 IDCM_ValetMode_AccDisable_Cmd 5;
BA_ "GenSigSendType" SG_ 881 IDCM_FD_19_Reserved4 5;
BA_ "GenSigSendType" SG_ 881 IDCM_FD_19_Reserved5 5;
BA_ "GenSigSendType" SG_ 881 IDCM_FD_19_Reserved6 5;
VAL_ 889 IDCM_BrightnessManualAdjust_OnlyForIV2 3 "Reserved" 2 "Reduce brightness" 1 "Increase brightness" 0 "Default" ;
VAL_ 889 IDCM_AutoBrightnessSet 3 "Reserved" 2 "ON" 1 "OFF" 0 "Default" ;
VAL_ 889 IDCM_HUDPositionCtrl_OnlyForIV2 3 "Reserved" 2 "Rotate down" 1 "Rotate Up" 0 "Default" ;
VAL_ 889 IDCM_HUDPowerCtrl 3 "Reserved" 2 "ON" 1 "OFF" 0 "Default" ;
VAL_ 889 IDCM_HUDFactoryReset 3 "Reserved" 2 "Disable" 1 "Enable" 0 "Default" ;
VAL_ 889 IDCM_ARCPowerCtrl 3 "Reserved" 2 "ON" 1 "OFF" 0 "Default" ;
VAL_ 889 IDCM_HUDSnowModeSet 3 "Reserved" 2 "ON" 1 "OFF" 0 "Default" ;
VAL_ 889 IDCM_DispUnitSet 3 "Reserved" 2 "Metric System" 1 "British System" 0 "Default" ;
VAL_ 889 IDCM_LanguageSet 3 "Reserved" 2 "English" 1 "Chinese" 0 "Default" ;
VAL_ 889 IDCM_TextDispMode 3 "Small" 2 "Medium" 1 "Big" 0 "Default" ;
VAL_ 889 IDCM_ARCDispPageSet_OnlyForIV2 7 "Reserved" 6 "Reserved" 5 "Reserved" 4 "Reserved" 3 "Page3" 2 "Page2" 1 "Page1" 0 "Default" ;
VAL_ 889 IDCM_ARCDispSet 7 "Reserved" 6 "Reserved" 5 "Reserved" 4 "Reserved" 3 "Reserved" 2 "AR mode" 1 "normal" 0 "Default" ;
VAL_ 889 IDCM_BrightnessManualAdjust 31 "Invalid" 20 "Level 20" 19 "Level 19" 18 "Level 18" 17 "Level 17" 16 "Level 16" 15 "Level 15" 14 "Level 14" 13 "Level 13" 12 "Level 12" 11 "Level 11" 10 "Level 10" 9 "Level 9" 8 "Level 8" 7 "Level 7" 6 "Level 6" 5 "Level 5" 4 "Level 4" 3 "Level 3" 2 "Level 2" 1 "Level 1" 0 "Level 0" ;
VAL_ 889 IDCM_HUDPositionCtrl 31 "Invalid" 20 "Position 20" 19 "Position 19" 18 "Position 18" 17 "Position 17" 16 "Position 16" 15 "Position 15" 14 "Position 14" 13 "Position 13" 12 "Position 12" 11 "Position 11" 10 "Position 10" 9 "Position 9" 8 "Position 8" 7 "Position 7" 6 "Position 6" 5 "Position 5" 4 "Position 4" 3 "Position 3" 2 "Position 2" 1 "Position 1" 0 "Position 0" ;
VAL_ 889 IDCM_SpeedUnitDispSet 3 "Reserved" 2 "Display" 1 "No Display" 0 "Default" ;
VAL_ 889 IDCM_LanguageDispSet 3 "Reserved" 2 "Display" 1 "No Display" 0 "Default" ;
VAL_ 889 IDCM_HUDSpeedManageDispSet 3 "Reserved" 2 "Display" 1 "No Display" 0 "Default" ;
VAL_ 889 IDCM_HUDWarningDispSet 3 "Reserved" 2 "Display" 1 "No Display" 0 "Default" ;
VAL_ 889 IDCM_HUDSOCDispSet 3 "Reserved" 2 "Display" 1 "No Display" 0 "Default" ;
VAL_ 889 IDCM_LaneDepartureWarningDispSet 3 "Reserved" 2 "Display" 1 "No Display" 0 "Default" ;
VAL_ 889 IDCM_ForwardInformationDispSet 3 "Reserved" 2 "Display" 1 "No Display" 0 "Default" ;
VAL_ 889 IDCM_NavigationDispSet 3 "Reserved" 2 "Display" 1 "No Display" 0 "Default" ;
VAL_ 889 IDCM_VehicleInformationDispSet 3 "Reserved" 2 "Display" 1 "No Display" 0 "Default" ;
VAL_ 889 IDCM_PhoneInformationDispSet_OnlyForIV2 3 "Reserved" 2 "Display" 1 "No Display" 0 "Default" ;
VAL_ 889 IDCM_TotalMileageDispSet 3 "Reserved" 2 "Display" 1 "No Display" 0 "Default" ;
VAL_ 889 IDCM_ARNavigationDisplaySet 3 "Reserved" 2 "Display" 1 "No Display" 0 "Default" ;
VAL_ 889 IDCM_HUDARWarningDispSet 3 "Reserved" 2 "Display" 1 "No Display" 0 "Default" ;
VAL_ 894 IDCM_PhoneTextLength_OnlyForIV2 255 "Invalid" ;
VAL_ 894 IDCM_PhoneCallNumber_OnlyForIV2 18446744073709551615 "Invalid" ;
VAL_ 894 IDCM_PhoneCallName_OnlyForIV2 1099511627775 "Invalid" ;
VAL_ 894 IDCM_PhoneCallType_OnlyForIV2 3 "Idle" 2 "Calling" 1 "Outgoing Call" 0 "Incoming Call" ;
VAL_ 894 IDCM_PhoneCallWaitType_OnlyForIV2 1 "New Call Entry" 0 "No New Call" ;
VAL_ 759 IDCM_FLOutletUpDownAngle 255 "Invalid" ;
VAL_ 759 IDCM_FLOutletLeftRightAngle 255 "Invalid" ;
VAL_ 759 IDCM_LCOutletUpDownAngle 255 "Invalid" ;
VAL_ 759 IDCM_LCOutletLeftRightAngle 255 "Invalid" ;
VAL_ 759 IDCM_RCOutletUpDownAngle 255 "Invalid" ;
VAL_ 759 IDCM_RCOutletLeftRightAngle 255 "Invalid" ;
VAL_ 759 IDCM_PanelOutletUpDownAngle 255 "Invalid" ;
VAL_ 759 IDCM_PanelOutletLeftRightAngle 255 "Invalid" ;
VAL_ 759 IDCM_FROutletUpDownAngle 255 "Invalid" ;
VAL_ 759 IDCM_FROutletLeftRightAngle 255 "Invalid" ;
VAL_ 759 IDCM_FLOutletSwitch_Cmd 3 "Reserved" 2 "Close" 1 "Open" 0 "Default" ;
VAL_ 759 IDCM_LCOutletSwitch_Cmd 3 "Reserved" 2 "Close" 1 "Open" 0 "Default" ;
VAL_ 759 IDCM_PanelOutletSwitch_Cmd 3 "Reserved" 2 "Close" 1 "Open" 0 "Default" ;
VAL_ 759 IDCM_RCOutletSwitch_Cmd 3 "Reserved" 2 "Close" 1 "Open" 0 "Default" ;
VAL_ 759 IDCM_FROutletSwitch_Cmd 3 "Reserved" 2 "Close" 1 "Open" 0 "Default" ;
VAL_ 759 IDCM_AirOutletMode_Cmd 7 "Reserved" 6 "Reserved" 5 "Reserved" 4 "Fast temperature control" 3 "Avoiding people blowing" 2 "Circulation blowing" 1 "Normal" 0 "Default" ;
VAL_ 756 IDCM_ChargeCtrl 7 "Invalid" 6 "Reserved" 5 "Reserved" 4 "Reservationchargeoff" 3 "Reservationchargeon" 2 "Chargeoff" 1 "Chargeon" 0 "Default" ;
VAL_ 756 IDCM_PowerSaveModeSet 3 "Reserved" 2 "Enable" 1 "Disable" 0 "Default" ;
VAL_ 756 IDCM_ChargeCutOffSet 255 "Invalid" ;
VAL_ 756 IDCM_DischargeSOCCutOffSet 255 "Invalid" ;
VAL_ 756 IDCM_CreepModeSet 3 "Reserved" 2 "Active" 1 "Inactive" 0 "Default" ;
VAL_ 756 IDCM_HVOffConfirmFeedback 1 "Shutdown confirmed" 0 "None" ;
VAL_ 756 IDCM_MaintenanceModeSwitch 3 "Reserved" 2 "On" 1 "OFF" 0 "Default" ;
VAL_ 756 IDCM_CoastRegenStrengthSet 255 "Invalid" ;
VAL_ 756 IDCM_DischargeRangeCutOffSet 1023 "Invalid" ;
VAL_ 756 IDCM_LocalCharge_Req 3 "Reserved" 2 "Request OFF" 1 "Request ON" 0 "Default" ;
VAL_ 756 IDCM_LocalDischarge_Req 3 "Reserved" 2 "Request OFF" 1 "Request ON" 0 "Default" ;
VAL_ 756 IDCM_PTModeChange_Cmd_OnlyForIV2 15 "Invalid" 14 "Reserved" 13 "Reserved" 12 "Reserved" 11 "Reserved" 10 "Reserved" 9 "Reserved" 8 "Reserved" 7 "Reserved" 6 "Reserved" 5 "Reserved" 4 "Reserved" 3 "Reserved" 2 "Sport" 1 "Comfort" 0 "Standard" ;
VAL_ 756 IDCM_SoftsandModeEnable_OnlyForIV2 3 "Reserved" 2 "Reserved" 1 "Active" 0 "Inactive" ;
VAL_ 756 IDCM_OffRoadModeEnable_OnlyForIV2 3 "Reserved" 2 "Reserved" 1 "Active" 0 "Inactive" ;
VAL_ 756 IDCM_TargetVehicleMode_OnlyForIV2 15 "Invalid" 14 "Reserved" 13 "Reserved" 12 "Reserved" 11 "Reserved" 10 "Reserved" 9 "Reserved" 8 "Reserved" 7 "Auto" 6 "Offroad" 5 "Soft sand" 4 "Winter" 3 "Individual" 2 "Sport" 1 "Comfort" 0 "ECO" ;
VAL_ 756 IDCM_WinterModeEnable_OnlyForIV2 3 "Reserved" 2 "Reserved" 1 "Active" 0 "Inactive" ;
VAL_ 756 IDCM_EPSModeChange_Cmd_OnlyForIV2 7 "Invalid" 6 "Reserved 0x7: Invalid" 5 "Reserved 0x7: Invalid" 4 "Reserved 0x7: Invalid" 3 "Reserved 0x7: Invalid" 1 "Mid 0x2: Light" 0 "Heavy" ;
VAL_ 756 IDCM_AirSModeChange_Cmd_OnlyForIV2 7 "Invalid" 6 "Reserved 0x7: Invalid" 5 "Reserved 0x7: Invalid" 4 "Reserved 0x7: Invalid" 3 "Reserved 0x7: Invalid" 1 "Normal 0x2: Low" 0 "Off road" ;
VAL_ 756 IDCM_SWSMode_OnlyForIV2 1 "Regen mode 0x2~0x3: Reserved" 0 "Drive mode" ;
VAL_ 756 IDCM_CDCModeChangeCmd_OnlyForIV2 7 "Invalid" 6 "Reserved 0x7: Invalid" 5 "Reserved 0x7: Invalid" 4 "Reserved 0x7: Invalid" 3 "Reserved 0x7: Invalid" 1 "Soft 0x2: Hard" 0 "Standard" ;
VAL_ 756 IDCM_ACModeChange_Cmd_OnlyForIV2 7 "Invalid" 1 "Comfort 0x2~0x6: Reserved 0x7: Invalid" 0 "Standard" ;
VAL_ 756 IDCM_ReservationChargeEnaable 3 "Reserved" 2 "Enable" 1 "Disable" 0 "Default" ;
VAL_ 756 IDCM_ReserveChargeTimeMin 63 "Invalid" ;
VAL_ 756 IDCM_ReserveChargeDurationSet 65535 "Invalid" ;
VAL_ 756 IDCM_ReserveChargeCutoffSOCSet 255 "Invalid" ;
VAL_ 756 IDCM_ReserveChargeTimeHour 31 "Invalid" ;
VAL_ 756 IDCM_Offroadmode_Req 3 "Reserved" 2 "ON" 1 "OFF" 0 "No Request" ;
VAL_ 756 IDCM_TractionModeSetting 3 "Invalid" 2 "ON" 1 "OFF" 0 "No Request" ;
VAL_ 756 IDCM_ReserveChargeEndTimeMin 63 "Invalid" ;
VAL_ 756 IDCM_ReserveChargeEndTimeHour 31 "Invalid" ;
VAL_ 756 IDCM_Android_Ready 3 "Reserved" 2 "active" 1 "inactive" 0 "No Request" ;
VAL_ 756 IDCM_ControllerFaultStatus 1 "Fault" 0 "No Fault" ;
VAL_ 755 IDCM_PTModeChange_Cmd 15 "Invalid" 14 "Reserved" 13 "Reserved" 12 "Reserved" 11 "Reserved" 10 "Reserved" 9 "Reserved" 8 "Reserved" 7 "Reserved" 6 "Reserved" 5 "Reserved" 4 "Reserved" 3 "Sport" 2 "Comfort" 1 "Standard" 0 "No Request" ;
VAL_ 755 IDCM_SoftsandModeEnable 3 "Reserved" 2 "Active" 1 "Inactive" 0 "No Request" ;
VAL_ 755 IDCM_OffRoadModeEnable 3 "Reserved" 2 "Active" 1 "Inactive" 0 "No Request" ;
VAL_ 755 IDCM_TargetVehicleMode 15 "Invalid" 14 "Reserved" 13 "Reserved" 12 "Reserved" 11 "Reserved" 10 "Reserved" 9 "Reserved" 8 "Reserved" 7 "Auto" 6 "Soft sand" 5 "Winter" 4 "Individual" 3 "Sport" 2 "Comfort" 1 "ECO" 0 "No Request" ;
VAL_ 755 IDCM_WinterModeEnable 3 "Reserved" 2 "Active" 1 "Inactive" 0 "No Request" ;
VAL_ 755 IDCM_EPSModeChange_Cmd 7 "Invalid" 6 "Reserved" 5 "Reserved" 4 "Reserved" 3 "Light" 2 "Mid" 1 "Heavy" 0 "No Request" ;
VAL_ 755 IDCM_AirSModeChange_Cmd 7 "Invalid" 6 "Reserved" 5 "Reserved" 4 "Reserved" 3 "Low" 2 "Normal" 1 "Off road" 0 "No Request" ;
VAL_ 755 IDCM_SWSMode 3 "Reserved" 2 "Regen Mode" 1 "Drive Mode" 0 "No Request" ;
VAL_ 755 IDCM_CDCModeChangeCmd 7 "Invalid" 6 "Reserved" 5 "Reserved" 4 "Reserved" 3 "Hard" 2 "Soft" 1 "Standard" 0 "No Request" ;
VAL_ 755 IDCM_ACModeChange_Cmd 7 "Invalid" 6 "Reserved" 5 "Reserved" 4 "Reserved" 3 "Reserved" 2 "Comfort" 1 "Standard" 0 "No Request" ;
VAL_ 370 IDCM_TCSSwitch 3 "Reserved" 2 "ON" 1 "OFF" 0 "Default" ;
VAL_ 370 IDCM_AVHSwitch 3 "Reserved" 2 "ON" 1 "OFF" 0 "Default" ;
VAL_ 370 IDCM_EBBrakeModeSet 7 "Invalid" 6 "Reserved" 5 "Reserved" 4 "Reserved" 3 "Hard" 2 "Middle" 1 "Light" 0 "Default" ;
VAL_ 370 IDCM_HDCSwitch 3 "Reserved" 2 "ON" 1 "OFF" 0 "Default" ;
VAL_ 370 IDCM_PassengerAirbagSet_OnlyForIV2 1 "PassengerAirbagOFF" 0 "PassengerAirbagON" ;
VAL_ 370 IDCM_PassengerAirbagSet 3 "Invalid" 2 "Reserved" 1 "PassengerAirbagOFF" 0 "PassengerAirbagON" ;
VAL_ 370 IDCM_LiftMode_Req 3 "Reserved" 2 "Request" 1 "No Request" 0 "None" ;
VAL_ 370 IDCM_EasyloadMode_Req 3 "Reserved" 2 "Request" 1 "No Request" 0 "None" ;
VAL_ 370 IDCM_VehicleSpeedDependentLevelSwitch_Req 3 "Reserved" 2 "vehicle speed dependent leveling off" 1 "vehicle speed dependent leveling on" 0 "None" ;
VAL_ 371 IDCM_DriverSideApproachOpenDoorSet 3 "Reserved" 2 "Enable" 1 "Disable" 0 "No Request" ;
VAL_ 371 IDCM_PassengerSideApproachOpenDoorSet 3 "Reserved" 2 "Enable" 1 "Disable" 0 "No Request" ;
VAL_ 371 IDCM_ApprchUnLockSet_OnlyForIV2 3 "Reserved" 2 "Enable" 1 "Disable" 0 "No Request" ;
VAL_ 371 IDCM_WalkAwayLockCloseDoorSet 3 "Reserved" 2 "Enable" 1 "Disable" 0 "No Request" ;
VAL_ 371 IDCM_UnLockModeSet 15 "Reserved" 14 "Reserved" 13 "Reserved" 12 "Reserved" 11 "Reserved" 10 "Reserved" 9 "Reserved" 8 "Reserved" 7 "Reserved" 6 "Reserved" 5 "Reserved" 4 "Reserved" 3 "Reserved" 2 "unlockdriverdoor" 1 "unlockallDoor" 0 "No Request" ;
VAL_ 371 IDCM_ApprchUnLockSet 7 "Reserved" 6 "Reserved" 5 "Reserved" 4 "Auto Mode" 3 "Four Doors" 2 "Driver Side" 1 "OFF" 0 "No Request" ;
VAL_ 371 IDCM_RemoteLowPressureWarnSet 3 "Reserved" 2 "Active" 1 "Inactive" 0 "No Request" ;
VAL_ 371 IDCM_RearDefrostCtrl_Cmd 3 "Reserved" 2 "Close" 1 "Open" 0 "No Request" ;
VAL_ 371 IDCM_WelcomeModeSet 3 "Reserved" 2 "OFF" 1 "ON" 0 "No Request" ;
VAL_ 371 IDCM_LightDelayCloseTimeSet 7 "Reserved" 6 "Reserved" 5 "Reserved" 4 "60s" 3 "30s" 2 "15s" 1 "0s" 0 "No Request" ;
VAL_ 371 IDCM_TopLightModeSet 3 "Reserved" 2 "AUTO" 1 "MANUAL" 0 "No Request" ;
VAL_ 371 IDCM_TopLightSwitch 3 "Reserved" 2 "ON" 1 "OFF" 0 "No Request" ;
VAL_ 371 IDCM_BackLghtIntensityAdjust_Cmd 255 "Reserved" 254 "Reserved" 253 "Reserved" 252 "Reserved" 251 "Reserved" 250 "Reserved" 249 "Reserved" 248 "Reserved" 247 "Reserved" 246 "Reserved" 245 "Reserved" 244 "Reserved" 243 "Reserved" 242 "Reserved" 241 "Reserved" 240 "Reserved" 239 "Reserved" 238 "Reserved" 237 "Reserved" 236 "Reserved" 235 "Reserved" 234 "Reserved" 233 "Reserved" 232 "Reserved" 231 "Reserved" 230 "Reserved" 229 "Reserved" 228 "Reserved" 227 "Reserved" 226 "Reserved" 225 "Reserved" 224 "Reserved" 223 "Reserved" 222 "Reserved" 221 "Reserved" 220 "Reserved" 219 "Reserved" 218 "Reserved" 217 "Reserved" 216 "Reserved" 215 "Reserved" 214 "Reserved" 213 "Reserved" 212 "Reserved" 211 "Reserved" 210 "Reserved" 209 "Reserved" 208 "Reserved" 207 "Reserved" 206 "Reserved" 205 "Reserved" 204 "Reserved" 203 "Reserved" 202 "Reserved" 201 "Reserved" 200 "Reserved" 199 "Reserved" 198 "Reserved" 197 "Reserved" 196 "Reserved" 195 "Reserved" 194 "Reserved" 193 "Reserved" 192 "Reserved" 191 "Reserved" 190 "Reserved" 189 "Reserved" 188 "Reserved" 187 "Reserved" 186 "Reserved" 185 "Reserved" 184 "Reserved" 183 "Reserved" 182 "Reserved" 181 "Reserved" 180 "Reserved" 179 "Reserved" 178 "Reserved" 177 "Reserved" 176 "Reserved" 175 "Reserved" 174 "Reserved" 173 "Reserved" 172 "Reserved" 171 "Reserved" 170 "Reserved" 169 "Reserved" 168 "Reserved" 167 "Reserved" 166 "Reserved" 165 "Reserved" 164 "Reserved" 163 "Reserved" 162 "Reserved" 161 "Reserved" 160 "Reserved" 159 "Reserved" 158 "Reserved" 157 "Reserved" 156 "Reserved" 155 "Reserved" 154 "Reserved" 153 "Reserved" 152 "Reserved" 151 "Reserved" 150 "Reserved" 149 "Reserved" 148 "Reserved" 147 "Reserved" 146 "Reserved" 145 "Reserved" 144 "Reserved" 143 "Reserved" 142 "Reserved" 141 "Reserved" 140 "Reserved" 139 "Reserved" 138 "Reserved" 137 "Reserved" 136 "Reserved" 135 "Reserved" 134 "Reserved" 133 "Reserved" 132 "Reserved" 131 "Reserved" 130 "Reserved" 129 "Reserved" 128 "Reserved" 127 "Reserved" 126 "Reserved" 125 "Reserved" 124 "Reserved" 123 "Reserved" 122 "Reserved" 121 "Reserved" 120 "Reserved" 119 "Reserved" 118 "Reserved" 117 "Reserved" 116 "Reserved" 115 "Reserved" 114 "Reserved" 113 "Reserved" 112 "Reserved" 111 "Reserved" 110 "Reserved" 109 "Reserved" 108 "Reserved" 107 "Reserved" 106 "Reserved" 105 "Reserved" 104 "Reserved" 103 "Reserved" 102 "Reserved" 101 "Reserved" 100 "Reserved" 99 "Reserved" 98 "Reserved" 97 "Reserved" 96 "Reserved" 95 "Reserved" 94 "Reserved" 93 "Reserved" 92 "Reserved" 91 "Reserved" 90 "Reserved" 89 "Reserved" 88 "Reserved" 87 "Reserved" 86 "Reserved" 85 "Reserved" 84 "Reserved" 83 "Reserved" 82 "Reserved" 81 "Reserved" 80 "Reserved" 79 "Reserved" 78 "Reserved" 77 "Reserved" 76 "Reserved" 75 "Reserved" 74 "Reserved" 73 "Reserved" 72 "Reserved" 71 "Reserved" 70 "Reserved" 69 "Reserved" 68 "Reserved" 67 "Reserved" 66 "Reserved" 65 "Reserved" 64 "Reserved" 63 "Reserved" 62 "Reserved" 61 "Reserved" 60 "Reserved" 59 "Reserved" 58 "Reserved" 57 "Reserved" 56 "Reserved" 55 "Reserved" 54 "Reserved" 53 "Reserved" 52 "Reserved" 51 "Reserved" 50 "Reserved" 49 "Reserved" 48 "Reserved" 47 "Reserved" 46 "Reserved" 45 "Reserved" 44 "Reserved" 43 "Reserved" 42 "Reserved" 41 "Reserved" 40 "Reserved" 39 "Reserved" 38 "Reserved" 37 "Reserved" 36 "Reserved" 35 "Reserved" 34 "Reserved" 33 "Reserved" 32 "Reserved" 31 "Reserved" 30 "Reserved" 29 "Reserved" 28 "Reserved" 27 "Reserved" 26 "Reserved" 25 "Reserved" 24 "Reserved" 23 "Reserved" 22 "Reserved" 21 "Reserved" 20 "Reserved" 19 "Reserved" 18 "Reserved" 17 "Reserved" 16 "Reserved" 15 "Reserved" 14 "Reserved" 13 "Reserved" 12 "Reserved" 11 "Level10" 10 "Level9" 9 "Level8" 8 "Level7" 7 "Level6" 6 "Level5" 5 "Level4" 4 "Level3" 3 "Level2" 2 "Level1" 1 "OFF" 0 "No Request" ;
VAL_ 371 IDCM_AutoLightSet 3 "Reserved" 2 "ON" 1 "OFF" 0 "No Request" ;
VAL_ 371 IDCM_AutoLightSet_Vld 1 "Valid" 0 "Invalid" ;
VAL_ 371 IDCM_RainAutoCloseWindowSet 3 "Reserved" 2 "Active" 1 "Inactive" 0 "No Request" ;
VAL_ 371 IDCM_AutoHighBeam_Cmd 3 "Reserved" 2 "ON" 1 "OFF" 0 "No Request" ;
VAL_ 371 IDCM_AVASEnable 3 "Reserved" 2 "AVAS Enable" 1 "AVAS Disable" 0 "No Request" ;
VAL_ 371 IDCM_AVASSoundType 7 "Invalid" 6 "Reserved" 5 "Reserved" 4 "Reserved" 3 "Type3" 2 "Type2" 1 "Type1" 0 "No Request" ;
VAL_ 371 IDCM_HornModeSet 3 "Reserved" 2 "Mute Mode" 1 "Normal Mode" 0 "No Request" ;
VAL_ 371 IDCM_BonusModeSet 3 "Reserved" 2 "Active" 1 "Inactive" 0 "No Request" ;
VAL_ 371 IDCM_FLSeatAjustMode_OnlyForIV2 7 "Invalid" 6 "Reserved" 5 "Reserved" 4 "Display Operation to Target" 3 "Voice Control to Target" 2 "FaceID - Memory Export" 1 "Memory Export" 0 "No Request" ;
VAL_ 371 IDCM_FRSeatAdjustMode_OnlyForIV2 7 "Invalid" 6 "Reserved" 5 "Reserved" 4 "Display Operation to Target" 3 "Voice Control to Target" 2 "FaceID - Memory Export" 1 "Memory Export" 0 "No Request" ;
VAL_ 371 IDCM_FrdCanCvr 3 "Invalid" 2 "ON" 1 "OFF" 0 "No Request" ;
VAL_ 371 IDCM_Guard_Mode_Alarm 3 "Invalid" 2 "ON" 1 "OFF" 0 "No Request" ;
VAL_ 371 IDCM_BackMirrorAutoFoldSet 3 "Reserved" 2 "Active" 1 "Inactive" 0 "No Request" ;
VAL_ 371 IDCM_BackMirrorAutoTurnOverSet 3 "RightOnly" 2 "LeftandRight" 1 "OFF" 0 "No Request" ;
VAL_ 371 IDCM_BackMirrorAutoUnfoldSet 3 "Reserved" 2 "ON" 1 "OFF" 0 "NoRequest" ;
VAL_ 371 IDCM_SteerWheelHeat_Cmd 7 "Reserved" 6 "Reserved" 5 "Reserved" 4 "Level3" 3 "Level2" 2 "Level1" 1 "OFF" 0 "No Request" ;
VAL_ 371 IDCM_SteerWheelHeatTemp_Cmd 63 "Invalid" ;
VAL_ 371 IDCM_BDCMPowerCtrl_Cmd 3 "Reserved" 2 "Power OFF" 1 "Power ON" 0 "No Request" ;
VAL_ 371 IDCM_HoodLockCtrl_Cmd 3 "Reserved" 2 "Active" 1 "Inactive" 0 "No Request" ;
VAL_ 371 IDCM_LockCtrl_Cmd 3 "Reserved" 2 "Unlock" 1 "Lock" 0 "No Request" ;
VAL_ 371 IDCM_ChargeCapCtrl_Cmd 3 "Reserved" 2 "Close" 1 "Open" 0 "No Request" ;
VAL_ 371 IDCM_FrontWiperService_Cmd 3 "Reserved" 2 "Active" 1 "Inactive" 0 "No Request" ;
VAL_ 371 IDCM_FrontWiperMode_Cmd 3 "Auto" 2 "Intermit" 1 "Initial" 0 "No Request" ;
VAL_ 371 IDCM_SafetyLockSet_Req 3 "Left and Right" 2 "Right side" 1 "Left side" 0 "No Request" ;
VAL_ 494 IDCM_FLFrontBackAdjust_Cmd_OnlyForIV2 3 "Reserved" 2 "Back" 1 "Front" 0 "NoRequest" ;
VAL_ 494 IDCM_FLSeatHeightAdjust_Cmd_OnlyForIV2 3 "Reserved" 2 "Down" 1 "Up" 0 "NoRequest" ;
VAL_ 494 IDCM_FLSeatBackCushionAdjust_Cmd_OnlyForIV2 3 "Reserved" 2 "Back" 1 "Front" 0 "NoRequest" ;
VAL_ 494 IDCM_FLSeatCushionAngleAdjust_Cmd_OnlyForIV2 3 "Reserved" 2 "Down" 1 "Up" 0 "NoRequest" ;
VAL_ 494 IDCM_FLSeatHeatGear_Cmd 7 "Reserved" 6 "Reserved" 5 "Reserved" 4 "High" 3 "Medium" 2 "Low" 1 "OFF" 0 "NoRequest" ;
VAL_ 494 IDCM_FLSeatVentilation_Cmd 7 "Reserved" 6 "Reserved" 5 "Reserved" 4 "High" 3 "Medium" 2 "Low" 1 "OFF" 0 "NoRequest" ;
VAL_ 494 IDCM_FLSeatFrontBackPosition_Cmd 255 "Invalid" ;
VAL_ 494 IDCM_FLSeatHeightPosition_Cmd 255 "Invalid" ;
VAL_ 494 IDCM_FLSeatBackCushionPosition_Cmd 255 "Invalid" ;
VAL_ 494 IDCM_FLSeatCushionAnglePosition_Cmd 255 "Invalid" ;
VAL_ 494 IDCM_FLSeatMassageMode_Cmd 7 "Invalid" 6 "Reserved" 5 "Reserved" 4 "Mode3" 3 "Mode2" 2 "Mode1" 1 "OFF" 0 "NoRequest" ;
VAL_ 494 IDCM_FLLumbarSupportFrontBackAdjust_Cmd 3 "invalid" 2 "Backward" 1 "Forward" 0 "NoRequest" ;
VAL_ 494 IDCM_FLLumbarSupportUpDownAdjust_Cmd 3 "invalid" 2 "Down" 1 "Up" 0 "No Request" ;
VAL_ 494 IDCM_FLSeatMassageStrength_Cmd 7 "Invalid" 6 "Reserved" 5 "Reserved" 4 "Reserved" 3 "High" 2 "Medium" 1 "Low" 0 "NoRequest" ;
VAL_ 494 IDCM_FLSeatAjustMode 7 "Invalid" 6 "Reserved" 5 "Reserved" 4 "Reserved" 3 "Reserved" 2 "Manual" 1 "Memory Export" 0 "No Request" ;
VAL_ 494 IDCM_FRSeatFrontBackAdjust_Cmd 3 "Reserved" 2 "Back" 1 "Front" 0 "NoRequest" ;
VAL_ 494 IDCM_FRSeatHeightAdjust_Cmd 3 "Reserved" 2 "Down" 1 "Up" 0 "NoRequest" ;
VAL_ 494 IDCM_FRSeatBackCushionAdjust_Cmd 3 "Reserved" 2 "Back" 1 "Front" 0 "NoRequest" ;
VAL_ 494 IDCM_FRSeatLegSupportAdjust_Cmd 3 "Reserved" 2 "Down" 1 "Up" 0 "NoRequest" ;
VAL_ 494 IDCM_FRSeatHeatGear_Cmd 7 "Reserved" 6 "Reserved" 5 "Reserved" 4 "High" 3 "Medium" 2 "Low" 1 "OFF" 0 "NoRequest" ;
VAL_ 494 IDCM_FRSeatVentilation_Cmd 7 "Reserved" 6 "Reserved" 5 "Reserved" 4 "High" 3 "Medium" 2 "Low" 1 "OFF" 0 "NoRequest" ;
VAL_ 494 IDCM_FRSeatFrontBackPosition_Cmd 255 "Invalid" ;
VAL_ 494 IDCM_FRSeatBackCushionPosition_Cmd 255 "Invalid" ;
VAL_ 494 IDCM_FRSeatHeightPosition_Cmd 255 "Invalid" ;
VAL_ 494 IDCM_FRSeatLegSupportPosition_Cmd 255 "Invalid" ;
VAL_ 494 IDCM_FRLumbarSupportFrontBackAdjust_Cmd 3 "invalid" 2 "Backward" 1 "Forward" 0 "NoRequest" ;
VAL_ 494 IDCM_FRLumbarSupportUpDownAdjust_Cmd 3 "invalid" 2 "Down" 1 "Up" 0 "No Request" ;
VAL_ 494 IDCM_FRSeatMassageMode_Cmd 7 "Invalid" 6 "Reserved" 5 "Reserved" 4 "Mode3" 3 "Mode2" 2 "Mode1" 1 "OFF" 0 "NoRequest" ;
VAL_ 494 IDCM_FRSeatMassageStrength_Cmd 7 "Invalid" 6 "Reserved" 5 "Reserved" 4 "Reserved" 3 "High" 2 "Medium" 1 "Low" 0 "NoRequest" ;
VAL_ 494 IDCM_FRSeatAdjustMode 7 "Invalid" 6 "Reserved" 5 "Reserved" 4 "Reserved" 3 "Reserved" 2 "Manual" 1 "Memory Export" 0 "No Request" ;
VAL_ 494 IDCM_DriverPositionMemoryID 255 "Invalid" ;
VAL_ 494 IDCM_DriverPositionMemory_Cmd 3 "Reserved" 2 "Recover" 1 "Save" 0 "NoRequest" ;
VAL_ 494 IDCM_PassengerPositionMemory_Cmd 3 "Reserved" 2 "Recover" 1 "Save" 0 "NoRequest" ;
VAL_ 494 IDCM_DriverMemoryExportPosition 15 "Position15" 14 "Position14" 13 "Position13" 12 "Position12" 11 "Position11" 10 "Position10" 9 "Position9" 8 "Position8" 7 "Position7" 6 "Position6" 5 "Position5" 4 "Position4" 3 "Position3" 2 "Position2" 1 "Position1" 0 "Norequest" ;
VAL_ 494 IDCM_PssengerMemoryExportPosition 15 "Position15" 14 "Position14" 13 "Position13" 12 "Position12" 11 "Position11" 10 "Position10" 9 "Position9" 8 "Position8" 7 "Position7" 6 "Position6" 5 "Position5" 4 "Position4" 3 "Position3" 2 "Position2" 1 "Position1" 0 "Norequest" ;
VAL_ 494 IDCM_PassengerSeatSoftPointSet_Cmd 3 "Reserved" 2 "active" 1 "inactive" 0 "NoRequest" ;
VAL_ 494 IDCM_SCAMTiltPositionSet 65535 "Invalid" ;
VAL_ 494 IDCM_SCAMTelescopePositionSet 65535 "Invalid" ;
VAL_ 494 IDCM_FLFrontBackAdjust_Cmd 3 "Reserved" 2 "Back" 1 "Front" 0 "NoRequest" ;
VAL_ 494 IDCM_FLSeatHeightAdjust_Cmd 3 "Reserved" 2 "Down" 1 "Up" 0 "NoRequest" ;
VAL_ 494 IDCM_FLSeatBackCushionAdjust_Cmd 3 "Reserved" 2 "Back" 1 "Front" 0 "NoRequest" ;
VAL_ 494 IDCM_FLSeatCushionAngleAdjust_Cmd 3 "Reserved" 2 "Down" 1 "Up" 0 "NoRequest" ;
VAL_ 495 IDCM_SRLSeatFrontBackAdjust_Cmd 3 "Reserved" 2 "Back" 1 "Front" 0 "NoRequest" ;
VAL_ 495 IDCM_SRLSeatBackCushionAdjust_Cmd 3 "Reserved" 2 "Back" 1 "Front" 0 "NoRequest" ;
VAL_ 495 IDCM_SRLSeatLegSupportAdjust_Cmd 3 "Reserved" 2 "Down" 1 "Up" 0 "NoRequest" ;
VAL_ 495 IDCM_SRLSeatLateralAdjust_Cmd 3 "Reserved" 2 "Right" 1 "Left" 0 "NoRequest" ;
VAL_ 495 IDCM_SRLSeatHeatGear_Cmd 7 "Reserved" 6 "Reserved" 5 "Reserved" 4 "High" 3 "Medium" 2 "Low" 1 "OFF" 0 "NoRequest" ;
VAL_ 495 IDCM_SRLSeatVentilationGear_Cmd 7 "Reserved" 6 "Reserved" 5 "Reserved" 4 "High" 3 "Medium" 2 "Low" 1 "OFF" 0 "NoRequest" ;
VAL_ 495 IDCM_SRLSeatMassageMode_Cmd 7 "Invalid" 6 "Reserved" 5 "Reserved" 4 "Mode3" 3 "Mode2" 2 "Mode1" 1 "OFF" 0 "NoRequest" ;
VAL_ 495 IDCM_SRLLumbarSupportFrontBackAdjust_Cmd 3 "invalid" 2 "Backward" 1 "Forward" 0 "NoRequest" ;
VAL_ 495 IDCM_SRLLumbarSupportUpDwnAdjust_Cmd 3 "invalid" 2 "Down" 1 "Up" 0 "NoRequest" ;
VAL_ 495 IDCM_SRLSeatFrontBackPosition_Cmd 255 "Invalid" ;
VAL_ 495 IDCM_SRLSeatSidePosition_Cmd 255 "Invalid" ;
VAL_ 495 IDCM_SRLSeatBackCushionPosition_Cmd 255 "Invalid" ;
VAL_ 495 IDCM_SRLSeatLegSupportPosition_Cmd 255 "Invalid" ;
VAL_ 495 IDCM_SRRSeatFrontBackAdjust_Cmd 3 "Reserved" 2 "Back" 1 "Front" 0 "NoRequest" ;
VAL_ 495 IDCM_SRRSeatBackCushionAdjust_Cmd 3 "Reserved" 2 "Back" 1 "Front" 0 "NoRequest" ;
VAL_ 495 IDCM_SRRSeatLegSupportAdjust_Cmd 3 "Reserved" 2 "Down" 1 "Up" 0 "NoRequest" ;
VAL_ 495 IDCM_SRRSeatLateralAdjust_Cmd 3 "Reserved" 2 "Right" 1 "Left" 0 "NoRequest" ;
VAL_ 495 IDCM_SRRSeatHeatGear_Cmd 7 "Reserved" 6 "Reserved" 5 "Reserved" 4 "High" 3 "Medium" 2 "Low" 1 "OFF" 0 "NoRequest" ;
VAL_ 495 IDCM_SRRSeatVentilation_Cmd 7 "Reserved" 6 "Reserved" 5 "Reserved" 4 "High" 3 "Medium" 2 "Low" 1 "OFF" 0 "NoRequest" ;
VAL_ 495 IDCM_SRRSeatMassageMode_Cmd 7 "Invalid" 6 "Reserved" 5 "Reserved" 4 "Mode3" 3 "Mode2" 2 "Mode1" 1 "OFF" 0 "NoRequest" ;
VAL_ 495 IDCM_SRRLumbarSupportFrontBackAdjust_Cmd 3 "invalid" 2 "Backward" 1 "Forward" 0 "NoRequest" ;
VAL_ 495 IDCM_SRRLumbarSupportUpDownAdjust_Cmd 3 "invalid" 2 "Down" 1 "Up" 0 "NoRequest" ;
VAL_ 495 IDCM_SRRSeatFrontBackPosition_Cmd 255 "Invalid" ;
VAL_ 495 IDCM_SRRSeatSidePosition_Cmd 255 "Invalid" ;
VAL_ 495 IDCM_SRRSeatBackCushionPosition_Cmd 255 "Invalid" ;
VAL_ 495 IDCM_SRRSeatLegSupportPosition_Cmd 255 "Invalid" ;
VAL_ 495 IDCM_SRLZeroGravity_Cmd 7 "Reserved" 6 "Reserved" 5 "Reserved" 4 "Reserved" 3 "Recovery" 2 "Mode1" 1 "Stop" 0 "NoRequest" ;
VAL_ 495 IDCM_SRRZeroGravity_Cmd 7 "Reserved" 6 "Reserved" 5 "Reserved" 4 "Reserved" 3 "Recovery" 2 "Mode1" 1 "Stop" 0 "NoRequest" ;
VAL_ 495 IDCM_SRLEasyEntry_Cmd 3 "Stop" 2 "Recover" 1 "Easy-Entry" 0 "NoRequest" ;
VAL_ 495 IDCM_SRREasyEntry_Cmd 3 "Stop" 2 "Recover" 1 "Easy-Entry" 0 "NoRequest" ;
VAL_ 495 IDCM_SRLSeatMassageStrength_Cmd 7 "Invalid" 6 "Reserved" 5 "Reserved" 4 "Reserved" 3 "High" 2 "Medium" 1 "Low" 0 "NoRequest" ;
VAL_ 495 IDCM_SRRSeatMassageStrength_Cmd 7 "Invalid" 6 "Reserved" 5 "Reserved" 4 "Reserved" 3 "High" 2 "Medium" 1 "Low" 0 "NoRequest" ;
VAL_ 374 IDCM_FDoorOpenAngleSet 255 "Invalid" ;
VAL_ 374 IDCM_RDoorOpenAngleSet 255 "Invalid" ;
VAL_ 374 IDCM_NTOpenAngleSet 255 "Invalid" ;
VAL_ 374 IDCM_NTTourModOpenAngleSet 255 "Invalid" ;
VAL_ 374 IDCM_FLDoorOpenAngleCtrl_Cmd 255 "Invalid" ;
VAL_ 374 IDCM_FRDoorOpenAngleCtrl_Cmd 255 "Invalid" ;
VAL_ 374 IDCM_RLDoorOpenAngleCtrl_Cmd 255 "Invalid" ;
VAL_ 374 IDCM_RRDoorOpenAngleCtrl_Cmd 255 "Invalid" ;
VAL_ 374 IDCM_LNTOpenAngleCtrl_Cmd 255 "Invalid" ;
VAL_ 374 IDCM_RNTOpenAngleCtrl_Cmd 255 "Invalid" ;
VAL_ 374 IDCM_TailNormOpenAngleSet 255 "Invalid" ;
VAL_ 374 IDCM_TailGarageOpenAngleSet 255 "Invalid" ;
VAL_ 374 IDCM_FLDoorCtrl_Cmd_OnlyForIV2 3 "Stop" 2 "Close" 1 "Open" 0 "NoRequest" ;
VAL_ 374 IDCM_FRDoorCtrl_Cmd_OnlyForIV2 3 "Stop" 2 "Close" 1 "Open" 0 "NoRequest" ;
VAL_ 374 IDCM_RLDoorCtrl_Cmd_OnlyForIV2 3 "Stop" 2 "Close" 1 "Open" 0 "NoRequest" ;
VAL_ 374 IDCM_RRDoorCtrl_Cmd_OnlyForIV2 3 "Stop" 2 "Close" 1 "Open" 0 "NoRequest" ;
VAL_ 374 IDCM_LNTCtrl_Cmd_OnlyForIV2 3 "Stop" 2 "Close" 1 "Open" 0 "NoRequest" ;
VAL_ 374 IDCM_RNTCtrl_Cmd_OnlyForIV2 3 "Stop" 2 "Close" 1 "Open" 0 "NoRequest" ;
VAL_ 374 IDCM_NTModeSet 3 "Reserved" 2 "Linkage" 1 "Traditional" 0 "NoRequest" ;
VAL_ 374 IDCM_FDoorVariableRateSet 7 "Invalid" 6 "Reserved" 5 "Reserved" 4 "慢" 3 "中" 2 "快" 1 "Initial" 0 "NoRequest" ;
VAL_ 374 IDCM_RDoorVariableRateSet 7 "Invalid" 6 "Reserved" 5 "Reserved" 4 "慢" 3 "中" 2 "快" 1 "Initial" 0 "NoRequest" ;
VAL_ 374 IDCM_NTVariableRateSet 7 "Invalid" 6 "Reserved" 5 "Reserved" 4 "慢" 3 "中" 2 "快" 1 "Initial" 0 "NoRequest" ;
VAL_ 374 IDCM_TailgateCtrl_Cmd 7 "Reserved" 6 "Reserved" 5 "Reserved" 4 "Stop" 3 "Garge" 2 "Close" 1 "Open" 0 "NoRequest" ;
VAL_ 374 IDCM_TailOpenModeSet 3 "Reserved" 2 "Garage" 1 "Max" 0 "NoRequest" ;
VAL_ 374 IDCM_TailgateFootOpenSet 3 "Reserved" 2 "Enable" 1 "Disable" 0 "NoRequest" ;
VAL_ 374 IDCM_FLDoorCtrl_Cmd 3 "Stop" 2 "Close" 1 "Open" 0 "NoRequest" ;
VAL_ 374 IDCM_FRDoorCtrl_Cmd 3 "Stop" 2 "Close" 1 "Open" 0 "NoRequest" ;
VAL_ 374 IDCM_RLDoorCtrl_Cmd 3 "Stop" 2 "Close" 1 "Open" 0 "NoRequest" ;
VAL_ 374 IDCM_RRDoorCtrl_Cmd 3 "Stop" 2 "Close" 1 "Open" 0 "NoRequest" ;
VAL_ 374 IDCM_LNTCtrl_Cmd 3 "Stop" 2 "Close" 1 "Open" 0 "NoRequest" ;
VAL_ 374 IDCM_RNTCtrl_Cmd 3 "Stop" 2 "Close" 1 "Open" 0 "NoRequest" ;
VAL_ 375 IDCM_FLWindowCtrl_Cmd 7 "Reserved" 6 "Reserved" 5 "Reserved" 4 "Stop" 3 "Freshair" 2 "Close" 1 "Open" 0 "NoRequest" ;
VAL_ 375 IDCM_FRWindowCtrl_Cmd 7 "Reserved" 6 "Reserved" 5 "Reserved" 4 "Stop" 3 "Freshair" 2 "Close" 1 "Open" 0 "NoRequest" ;
VAL_ 375 IDCM_RLWindowSwitchForbid 3 "Reserved" 2 "Forbidden" 1 "Not Forbidden" 0 "NoRequest" ;
VAL_ 375 IDCM_RRWindowSwitchForbid 3 "Reserved" 2 "Forbidden" 1 "Not Forbidden" 0 "NoRequest" ;
VAL_ 375 IDCM_RLWindowCtrl_Cmd 7 "Reserved" 6 "Reserved" 5 "Reserved" 4 "Stop" 3 "Freshair" 2 "Close" 1 "Open" 0 "NoRequest" ;
VAL_ 375 IDCM_RRWindowCtrl_Cmd 7 "Reserved" 6 "Reserved" 5 "Reserved" 4 "Stop" 3 "Freshair" 2 "Close" 1 "Open" 0 "NoRequest" ;
VAL_ 375 IDCM_FLWindowPosition_Cmd 255 "Invalid" ;
VAL_ 375 IDCM_FRWindowPosition_Cmd 255 "Invalid" ;
VAL_ 375 IDCM_RLWindowPosition_Cmd 255 "Invalid" ;
VAL_ 375 IDCM_RRWindowPosition_Cmd 255 "Invalid" ;
VAL_ 375 IDCM_FLBackMirrorUpDownPositionSet 255 "Invalid" ;
VAL_ 375 IDCM_FLBackMirrorLeftRightPositionSet 255 "Invalid" ;
VAL_ 375 IDCM_FRBackMirrorUpDownPositionSet 255 "Invalid" ;
VAL_ 375 IDCM_FRBackMirrorLeftRightPositionSet 255 "Invalid" ;
VAL_ 375 IDCM_ReverseFLBackMirrorUDPositionSet 255 "Invalid" ;
VAL_ 375 IDCM_ReverseFLBackMirrorLRPositionSet 255 "Invalid" ;
VAL_ 375 IDCM_ReverseFRBackMirrorUDPositionSet 255 "Invalid" ;
VAL_ 375 IDCM_ReverseFRBackMirrorLRPositionSet 255 "Invalid" ;
VAL_ 376 IDCM_LeftProjectAUpDownAdjust 0 "Invalid" ;
VAL_ 376 IDCM_LeftProjectALeftRightAdjust 0 "Invalid" ;
VAL_ 376 IDCM_LeftProjectBUpDownAdjust 0 "Invalid" ;
VAL_ 376 IDCM_LeftProjectBLeftRightAdjust 0 "Invalid" ;
VAL_ 376 IDCM_LeftProjectCUpDownAdjust 0 "Invalid" ;
VAL_ 376 IDCM_LeftProjectCLeftRightAdjust 0 "Invalid" ;
VAL_ 376 IDCM_LeftProjectDUpDownAdjust 0 "Invalid" ;
VAL_ 376 IDCM_LeftProjectDLeftRightAdjust 0 "Invalid" ;
VAL_ 376 IDCM_RightProjectAUpDownAdjust 0 "Invalid" ;
VAL_ 376 IDCM_RightProjectALeftRightAdjust 0 "Invalid" ;
VAL_ 376 IDCM_RightProjectBUpDownAdjust 0 "Invalid" ;
VAL_ 376 IDCM_RightProjectBLeftRightAdjust 0 "Invalid" ;
VAL_ 376 IDCM_RightProjectCUpDownAdjust 0 "Invalid" ;
VAL_ 376 IDCM_RightProjectCLeftRightAdjust 0 "Invalid" ;
VAL_ 376 IDCM_RightProjectDUpDownAdjust 0 "Invalid" ;
VAL_ 376 IDCM_RightProjectDLeftRightAdjust 0 "Invalid" ;
VAL_ 376 IDCM_SmartLightEnable 3 "Reserved" 2 "Not AUTO" 1 "Auto" 0 "Default" ;
VAL_ 376 IDCM_LightPedestriansWarnFunctionEn 3 "Reserved" 2 "ON" 1 "OFF" 0 "Default" ;
VAL_ 376 IDCM_ADBEnable 3 "Reserved" 2 "ON" 1 "OFF" 0 "Default" ;
VAL_ 376 IDCM_LightFrontVehicleCollisionWarnEn 3 "Reserved" 2 "ON" 1 "OFF" 0 "Default" ;
VAL_ 376 IDCM_LightLaneChangeWarnEn 3 "Reserved" 2 "ON" 1 "OFF" 0 "Default" ;
VAL_ 376 IDCM_LightTurnWarnEn 3 "Reserved" 2 "ON" 1 "OFF" 0 "Default" ;
VAL_ 376 IDCM_LightLaneDepartureWarnEn 3 "Reserved" 2 "ON" 1 "OFF" 0 "Default" ;
VAL_ 376 IDCM_LightSpeedLimitWarnEn 3 "Reserved" 2 "ON" 1 "OFF" 0 "Default" ;
VAL_ 376 IDCM_LightSmartNavigationPromptEn 3 "Reserved" 2 "ON" 1 "OFF" 0 "Default" ;
VAL_ 376 IDCM_LightDrivingLinePromptEn 3 "Reserved" 2 "ON" 1 "OFF" 0 "Default" ;
VAL_ 376 IDCM_LightVideoProjectPlayEn 3 "Pause" 2 "ON" 1 "OFF" 0 "Default" ;
VAL_ 376 IDCM_DrivingLinePromptButton 3 "Reserved" 2 "active" 1 "No Request" 0 "Default" ;
VAL_ 376 IDCM_ISDSmartNavigationPromptEn 3 "Reserved" 2 "ON" 1 "OFF" 0 "Default" ;
VAL_ 376 IDCM_ISDSpeedLimitPromptEN 3 "Reserved" 2 "ON" 1 "OFF" 0 "Default" ;
VAL_ 376 IDCM_ISDChargeCon_St 3 "Reserved" 2 "ON" 1 "OFF" 0 "Default" ;
VAL_ 376 IDCM_LightSignatureProjectEnable 3 "Reserved" 2 "ON" 1 "OFF" 0 "Default" ;
VAL_ 376 IDCM_LightAutomaticPiolotPromptEn 3 "Reserved" 2 "ON" 1 "OFF" 0 "Default" ;
VAL_ 376 IDCM_PPrjctProjectLampSelect 7 "Reserved" 6 "Reserved" 5 "Reserved" 4 "LeftandRight" 3 "RightLampOnly" 2 "LeftLampOnly" 1 "NoLampProjection" 0 "Default" ;
VAL_ 376 IDCM_ProjectAreaSelect 3 "Projectiontotheground" 2 "ProjectiontotheWall" 1 "NoProjection" 0 "Default" ;
VAL_ 376 IDCM_ISDEnduranceMileagePromptEn 3 "Reserved" 2 "ON" 1 "OFF" 0 "Default" ;
VAL_ 376 IDCM_ISDRearVehicleCollisionWarnEn 3 "Reserved" 2 "ON" 1 "OFF" 0 "Default" ;
VAL_ 376 IDCM_ISDHighBeamOFFRemainderEn 3 "Reserved" 2 "ON" 1 "OFF" 0 "Default" ;
VAL_ 376 IDCM_PedestrianFirstPromptButtonEn 3 "Reserved" 2 "ON" 1 "OFF" 0 "Default" ;
VAL_ 376 IDCM_ISDLockStateRemainderEn 3 "Reserved" 2 "ON" 1 "OFF" 0 "Default" ;
VAL_ 376 IDCM_ThanksButton 3 "Reserved" 2 "Press" 1 "No Press" 0 "Default" ;
VAL_ 376 IDCM_ISDChangeDrivingModeEn 3 "Reserved" 2 "ON" 1 "OFF" 0 "Default" ;
VAL_ 376 IDCM_ISDCustomersModeEn 3 "Reserved" 2 "ON" 1 "OFF" 0 "Default" ;
VAL_ 376 IDCM_ISDCustomerEditEn 3 "Reserved" 2 "ON" 1 "OFF" 0 "Default" ;
VAL_ 376 IDCM_ISDPedestrianFirstEn 3 "Reserved" 2 "ON" 1 "OFF" 0 "Default" ;
VAL_ 376 IDCM_FCSremindwayset 3 "Reserved" 2 "Heighten" 1 "Basic" 0 "No Request" ;
VAL_ 376 IDCM_RCWremindwayset 3 "Reserved" 2 "Heighten" 1 "Basic" 0 "No Request" ;
VAL_ 376 IDCM_LKSremindwayset 3 "Reserved" 2 "Heighten" 1 "Basic" 0 "No Request" ;
VAL_ 376 IDCM_ISAremindwayset 3 "Reserved" 2 "Heighten" 1 "Basic" 0 "No Request" ;
VAL_ 377 IDCM_HighBeam_Cmd 3 "Reserved" 2 "ON" 1 "OFF" 0 "Default" ;
VAL_ 377 IDCM_HghBeam_Cmd_Vld 1 "Valid" 0 "Invalid" ;
VAL_ 377 IDCM_LowBeam_Cmd 3 "Reserved" 2 "ON" 1 "OFF" 0 "Default" ;
VAL_ 377 IDCM_LowBeam_Cmd_Vld 1 "Valid" 0 "Invalid" ;
VAL_ 377 IDCM_PositionLight_Cmd 3 "Reserved" 2 "ON" 1 "OFF" 0 "Default" ;
VAL_ 377 IDCM_PositionLight_Cmd_Vld 1 "Valid" 0 "Invalid" ;
VAL_ 377 IDCM_RearFogLight_Cmd 3 "Reserved" 2 "ON" 1 "OFF" 0 "Default" ;
VAL_ 377 IDCM_RearFogLight_Cmd_Vld 1 "Valid" 0 "Invalid" ;
VAL_ 377 IDCM_HazrdWarnLamp_Cmd 3 "Reserved" 2 "ON" 1 "OFF" 0 "Default" ;
VAL_ 377 IDCM_HazrdWarnLamp_Cmd_Vld 1 "Valid" 0 "Invalid" ;
VAL_ 377 IDCM_PositionLowBeamLightSet 7 "Reserved" 6 "Reserved" 5 "Reserved" 4 "OFF" 3 "Low beam" 2 "Position light" 1 "AUTO light" 0 "Default" ;
VAL_ 377 IDCM_SaveLightShowModeChoose 15 "Reserved" 14 "Reserved" 13 "Reserved" 12 "Reserved" 11 "Reserved" 10 "Reserved" 9 "ISD Customers Mode" 8 "Signature" 7 "Farewell Mode" 6 "Welcome Mode" 5 "Festival Mode5" 4 "Festival Mode4" 3 "Festival Mode3" 2 "Festival Mode2" 1 "Festival Mode1" 0 "Default" ;
VAL_ 377 IDCM_PreviewSwitch 3 "Reserved" 2 "ON" 1 "OFF" 0 "Default" ;
VAL_ 377 IDCM_SaveButton 3 "Reserved" 2 "ON" 1 "OFF" 0 "Default" ;
VAL_ 377 IDCM_FestivalLightShowSet_Year 255 "Invalid" ;
VAL_ 377 IDCM_FestivalLightShowSet_Month 15 "Invalid" ;
VAL_ 377 IDCM_PreviewLightShowModeChoose 15 "Reserved" 14 "Reserved" 13 "Reserved" 12 "Reserved" 11 "Reserved" 10 "Reserved" 9 "ISD Customers Mode" 8 "Signature" 7 "Farewell Mode" 6 "Welcome Mode" 5 "Festival5" 4 "Festival4" 3 "Festival3" 2 "Festival2" 1 "Festival1" 0 "Default" ;
VAL_ 377 IDCM_FestivalLightShowSet_Day 63 "Invalid" ;
VAL_ 377 IDCM_LightShowEn 3 "Reserved" 2 "ON" 1 "OFF" 0 "Default" ;
VAL_ 377 IDCM_LightShowEnSetChoose 15 "Reserved Light Mode 8" 14 "Reserved Light Mode 7" 13 "Reserved Light Mode 6" 12 "Reserved Light Mode 5" 11 "Reserved Light Mode 4" 10 "Reserved Light Mode 3" 9 "Reserved Light Mode 2" 8 "Reserved Light Mode 1" 7 "Farewell Mode" 6 "Welcome Mode" 5 "Festival5" 4 "Festival4" 3 "Festival3" 2 "Festival2" 1 "Festival1" 0 "Default" ;
VAL_ 377 IDCM_FestivalLightShowSet_Index 15 "Reserved" 14 "Reserved" 13 "Reserved" 12 "Reserved" 11 "Reserved" 10 "Reserved" 9 "Reserved" 8 "Reserved" 7 "Reserved" 6 "Reserved" 5 "Festival5" 4 "Festival4" 3 "Festival3" 2 "Festival2" 1 "Festival1" 0 "Default" ;
VAL_ 753 IDCM_VehicleTotalMileage 16777215 "Invalid" ;
VAL_ 753 IDCM_SystemFailure 1 "System Normal" 0 "System Failure" ;
VAL_ 753 IDCM_DisplayError 1 "No Error" 0 "Error" ;
VAL_ 753 IDCM_LowConsumMode_OnlyForIV2 3 "Reserved" 2 "Reserved" 1 "Active Low Consumption Mode" 0 "No Active" ;
VAL_ 753 IDCM_ValetMode_St 3 "Reserved" 2 "Reserved" 1 "ON" 0 "OFF" ;
VAL_ 753 IDCM_InstrumentLeftSidePage 3 "HH Pilot page" 2 "ACC page" 1 "Other pages" 0 "Default" ;
VAL_ 753 IDCM_LowConsumMode 3 "Reserved" 2 "Active LowConsumMode" 1 "No Active" 0 "No Request" ;
VAL_ 753 IDCM_LowVolt_Keep_Req 3 "Invalid" 2 "ON" 1 "OFF" 0 "No Request" ;
VAL_ 753 IDCM_CampingMode_Req 3 "invalid" 2 "ON" 1 "OFF" 0 "No Request" ;
VAL_ 753 IDCM_MaxSpeedLimit_Cmd 255 "Invalid" ;
VAL_ 753 IDCM_EverydayEnergyConsume 1048575 "Invalid" ;
VAL_ 753 IDCM_ECall_Request 3 "Reserved" 2 "Hang up" 1 "Call" 0 "No Request" ;
VAL_ 753 IDCM_BCall_Request 3 "Reserved" 2 "Hang up" 1 "Call" 0 "No Request" ;
VAL_ 753 IDCM_CampingModeSOC_Set 1023 "Invalid" ;
VAL_ 753 IDCM_ProtocolVersion 3 "Reserved" 2 "PPV" 1 "NCT" 0 "IV2" ;
VAL_ 753 IDCM_V2X_Enable 3 "Reserved" 2 "Disable" 1 "Enable" 0 "No Request" ;
VAL_ 881 IDCM_IFCISDRestDistance 1023 "Invalid" 701 "Over 70km" 0 "No in ISD" ;
VAL_ 881 IDCM_IFCRoadType 15 "Reserved" 14 "Reserved" 13 "Reserved" 12 "Reserved" 11 "Non navi road" 10 "Common road" 9 "Secondary road" 8 "Main road" 7 "City speed way" 6 "In county road" 5 "Rural road" 4 "County road" 3 "Provincial road" 2 "National road" 1 "High way" 0 "Unknown" ;
VAL_ 881 IDCM_IFCSpeedLimtType 15 "Reserved" 14 "Reserved" 13 "Reserved" 12 "Reserved" 11 "Reserved" 10 "Reserved" 9 "Reserved" 8 "Reserved" 7 "Reserved" 6 "Reserved" 5 "Reserved" 4 "Reserved" 3 "Reserved" 2 "Interval speed detectionlimit" 1 "Speed limit camera detection" 0 "Not specific" ;
VAL_ 881 IDCM_IFCSpeedLimitUnit 3 "Reserved" 2 "Reserved" 1 "Km/h" 0 "Invalid Signal" ;
VAL_ 881 IDCM_IFCNavigationSt 3 "Reserved" 2 "Navigate" 1 "Cruise" 0 "Unknown" ;
VAL_ 881 IDCM_IFCSLCAheadDistance 6001 "Over 6000m" 0 "No SLC ahead" ;
VAL_ 881 IDCM_IFCZoneCode 7 "Reserved" 6 "Reserved" 5 "Reserved" 4 "Reserved" 3 "Reserved" 2 "Reserved" 1 "China" 0 "None" ;
VAL_ 881 IDCM_FCSSwitch 3 "Reserved" 2 "OFF" 1 "ON" 0 "No command" ;
VAL_ 881 IDCM_LKSSwitch 3 "Reserved" 2 "OFF" 1 "ON" 0 "No command" ;
VAL_ 881 IDCM_LKSSensitivity 3 "High" 2 "Middle" 1 "Low" 0 "No command" ;
VAL_ 881 IDCM_ELKSwitch 3 "Reserved" 2 "OFF" 1 "ON" 0 "No command" ;
VAL_ 881 IDCM_HWAILC_Switch 3 "Reserved" 2 "OFF" 1 "ON" 0 "No command" ;
VAL_ 881 IDCM_ISASwitch 3 "Reserved" 2 "OFF" 1 "ON" 0 "No command" ;
VAL_ 881 IDCM_AHBSwitch 3 "Reserved" 2 "OFF" 1 "ON" 0 "No command" ;
VAL_ 881 IDCM_LCASwitch 3 "Reserved" 2 "OFF" 1 "ON" 0 "No command" ;
VAL_ 881 IDCM_DOWSwitch 3 "Reserved" 2 "OFF" 1 "ON" 0 "No command" ;
VAL_ 881 IDCM_RCTASwitch 3 "Reserved" 2 "OFF" 1 "ON" 0 "No command" ;
VAL_ 881 IDCM_RCWSwitch 3 "Reserved" 2 "OFF" 1 "ON" 0 "No command" ;
VAL_ 881 IDCM_FCTASwitch 3 "Reserved" 2 "OFF" 1 "ON" 0 "No command" ;
VAL_ 881 IDCM_LKSType 3 "Steering and Warning" 2 "Warning" 1 "Steering" 0 "No command" ;
VAL_ 881 IDCM_ISA_WarningOffset 7 "Reserved" 6 "Reserved" 5 "+10" 4 "+5" 3 "0" 2 "-5" 1 "-10" 0 "No command" ;
VAL_ 881 IDCM_ValetMode_AccDisable_Cmd 3 "Invalid" 2 "ON" 1 "OFF" 0 "No Request" ;
VAL_ 1016 ARC_ONOFF_St 1 "Output Image" 0 "No Image Output" ;
VAL_ 1016 ARC_HUDSnowMode_St 1 "ON" 0 "OFF" ;
VAL_ 1016 ARC_DispUnit_St 1 "Metric System" 0 "British System" ;
VAL_ 1016 ARC_Language_St 1 "English" 0 "Chinese" ;
VAL_ 1016 ARC_ARHUDPowerCtrl 1 "ON" 0 "OFF" ;
VAL_ 1016 ARC_DispPage_St_OnlyForIV2 7 "Invalid" 6 "Reserved" 5 "Reserved" 4 "Reserved" 3 "Reserved" 2 "Page3" 1 "Page2" 0 "Page1" ;
VAL_ 1016 ARC_TextDispMode_St 3 "Reserved" 2 "Small" 1 "Medium" 0 "Big" ;
VAL_ 1016 ARC_Disp_St 7 "Invalid" 6 "Reserved" 5 "Reserved" 4 "Reserved" 3 "Reserved" 2 "Reserved" 1 "AR mode" 0 "normal" ;
VAL_ 1016 ARC_SpeedUnitDisp_St 1 "Display" 0 "No Display" ;
VAL_ 1016 ARC_LanguageDispSet_St 1 "Display" 0 "No Display" ;
VAL_ 1016 ARC_SpeedManageDisp_St 1 "Display" 0 "No Display" ;
VAL_ 1016 ARC_WarningDisp_St 1 "Display" 0 "No Display" ;
VAL_ 1016 ARC_HUDSOCDisp_St 1 "Display" 0 "No Display" ;
VAL_ 1016 ARC_LaneDepartureWarningDisp_St 1 "Display" 0 "No Display" ;
VAL_ 1016 ARC_ForwardInformationDisp_St 1 "Display" 0 "No Display" ;
VAL_ 1016 ARC_NavigationDisp_St 1 "Display" 0 "No Display" ;
VAL_ 1016 ARC_VehicleInformationDisp_St 1 "Display" 0 "No Display" ;
VAL_ 1016 ARC_PhoneInformationDisp_St 1 "Display" 0 "No Display" ;
VAL_ 1016 ARC_TotalMileageDisp_St 1 "Display" 0 "No Display" ;
VAL_ 1016 ARC_ARNavigationDisp_St 1 "Display" 0 "No Display" ;
VAL_ 1016 ARC_ARWarningDisp_St 1 "Display" 0 "No Display" ;
VAL_ 1016 ARC_ProtocolVersion 3 "Reserved" 2 "PPV" 1 "NCT" 0 "IV2" ;
VAL_ 1017 ARHUD_ONOFF_St 1 "Projectable" 0 "Not Ready to Project" ;
VAL_ 1017 ARHUD_DispBrightness_OnlyForIV2 15 "Invalid" 14 "Reserved" 13 "Reserved" 12 "Reserved" 11 "Reserved" 10 "Level 10" 9 "Level 9" 8 "Level 8" 7 "Level 7" 6 "Level 6" 5 "Level 5" 4 "Level 4" 3 "Level 3" 2 "Level 2" 1 "Level 1" 0 "Level 0" ;
VAL_ 1017 ARHUD_AutoBrightness_St 1 "ON" 0 "OFF" ;
VAL_ 1017 ARHUD_DispPosition 31 "Invalid" 30 "Reserved" 29 "Reserved" 28 "Reserved" 27 "Reserved" 26 "Reserved" 25 "Reserved" 24 "Reserved" 23 "Reserved" 22 "Reserved" 21 "Reserved" 20 "Position 20" 19 "Position 19" 18 "Position 18" 17 "Position 17" 16 "Position 16" 15 "Position 15" 14 "Position 14" 13 "Position 13" 12 "Position 12" 11 "Position 11" 10 "Position 10" 9 "Position 9" 8 "Position 8" 7 "Position 7" 6 "Position 6" 5 "Position 5" 4 "Position 4" 3 "Position 3" 2 "Position 2" 1 "Position 1" 0 "Position 0" ;
VAL_ 1017 ARHUD_DispBrightness 31 "Invalid" 20 "Level 20" 19 "Level 19" 18 "Level 18" 17 "Level 17" 16 "Level 16" 15 "Level 15" 14 "Level 14" 13 "Level 13" 12 "Level 12" 11 "Level 11" 10 "Level 10" 9 "Level 9" 8 "Level 8" 7 "Level 7" 6 "Level 6" 5 "Level 5" 4 "Level 4" 3 "Level 3" 2 "Level 2" 1 "Level 1" 0 "Level 0" ;
VAL_ 1017 ARHUD_Warning 7 "Invalid" 6 "Reserved" 5 "Reserved" 4 "Reserved" 3 "Commfalut" 2 "HUDmotorfault" 1 "HUDtempH" 0 "No Fault" ;
VAL_ 1017 ARHUD_ProtocolVersion 3 "Reserved" 2 "PPV" 1 "NCT" 0 "IV2" ;
VAL_ 1018 WHUD_ONOFF_St 1 "Projectable" 0 "Not Ready to Project" ;
VAL_ 1018 WHUD_AutoBrightness_St 1 "ON" 0 "OFF" ;
VAL_ 1018 WHUD_DispUnitSet_St 1 "Metric System" 0 "British System" ;
VAL_ 1018 WHUD_LanguageSet_St 1 "English" 0 "Chinese" ;
VAL_ 1018 WHUD_DispBrightness_OnlyForIV2 15 "Invalid" 14 "Reserved" 13 "Reserved" 12 "Reserved" 11 "Reserved" 10 "Level 10" 9 "Level 9" 8 "Level 8" 7 "Level 7" 6 "Level 6" 5 "Level 5" 4 "Level 4" 3 "Level 3" 2 "Level 2" 1 "Level 1" 0 "Level 0" ;
VAL_ 1018 WHUD_DispPosition 31 "Invalid" 20 "Position 20" 19 "Position 19" 18 "Position 18" 17 "Position 17" 16 "Position 16" 15 "Position 15" 14 "Position 14" 13 "Position 13" 12 "Position 12" 11 "Position 11" 10 "Position 10" 9 "Position 9" 8 "Position 8" 7 "Position 7" 6 "Position 6" 5 "Position 5" 4 "Position 4" 3 "Position 3" 2 "Position 2" 1 "Position 1" 0 "Position 0" ;
VAL_ 1018 WHUD_HUDSnowMode_st 1 "ON" 0 "OFF" ;
VAL_ 1018 WHUD_TextDispMode_St 3 "Reserved" 2 "Small" 1 "Medium" 0 "Big" ;
VAL_ 1018 WHUD_DispPage_St 7 "Invalid" 6 "Reserved" 5 "Reserved" 4 "Reserved" 3 "Reserved" 2 "Page3" 1 "Page2" 0 "Page1" ;
VAL_ 1018 WHUD_DispBrightness 31 "Invalid" 20 "Level 20" 19 "Level 19" 18 "Level 18" 17 "Level 17" 16 "Level 16" 15 "Level 15" 14 "Level 14" 13 "Level 13" 12 "Level 12" 11 "Level 11" 10 "Level 10" 9 "Level 9" 8 "Level 8" 7 "Level 7" 6 "Level 6" 5 "Level 5" 4 "Level 4" 3 "Level 3" 2 "Level 2" 1 "Level 1" 0 "Level 0" ;
VAL_ 1018 WHUD_SpeedUnitDispSet_St 1 "Display" 0 "No Display" ;
VAL_ 1018 WHUD_LanguageDispSet_St 1 "Display" 0 "No Display" ;
VAL_ 1018 WHUD_SpeedManageDisp_St 1 "Display" 0 "No Display" ;
VAL_ 1018 WHUD_WarningDisp_St 1 "Display" 0 "No Display" ;
VAL_ 1018 WHUD_SOCDisp_St 1 "Display" 0 "No Display" ;
VAL_ 1018 WHUD_LaneDepartureWarningDisp_St 1 "Display" 0 "No Display" ;
VAL_ 1018 WHUD_ForwardInformationDisp_St 1 "Display" 0 "No Display" ;
VAL_ 1018 WHUD_NavigationDisp_St 1 "Display" 0 "No Display" ;
VAL_ 1018 WHUD_VehicleInformationDisp_St 1 "Display" 0 "No Display" ;
VAL_ 1018 WHUD_PhoneInformationDisp_St 1 "Display" 0 "No Display" ;
VAL_ 1018 WHUD_TotalMileageDisp_St 1 "Display" 0 "No Display" ;
VAL_ 1018 WHUD_Warning 7 "Invalid" 6 "Reserved" 5 "Reserved" 4 "Reserved" 3 "Commfalut" 2 "HUDmotorfault" 1 "HUDtempH" 0 "No Fault" ;
VAL_ 1018 WHUD_ProtocolVersion 3 "Reserved" 2 "PPV" 1 "NCT" 0 "IV2" ;
